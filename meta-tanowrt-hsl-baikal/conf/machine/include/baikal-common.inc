## meta-tanowrt-hsl-baikal/conf/machine/include/baikal-common.inc
```bitbake
#
# SPDX-License-Identifier: MIT
# Copyright (c) 2021 Tano Systems LLC. All rights reserved.
#

MACHINEOVERRIDES =. "baikal-common:"
```

## meta-tanowrt-hsl-baikal/conf/machine/include/baikal-m.inc
```bitbake
#
# SPDX-License-Identifier: MIT
# Copyright (c) 2021-2022 Tano Systems LLC. All rights reserved.
#

MACHINEOVERRIDES =. "baikal-m:"

MACHINE_EXTRA_RRECOMMENDS:append = "\
	baikal-scp \
"

require conf/machine/include/baikal-common.inc
require conf/machine/include/arm/armv8a/tune-cortexa57.inc
```

## meta-tanowrt-hsl-baikal/conf/machine/include/mbm10.inc
```bitbake
#
# SPDX-License-Identifier: MIT
# Copyright (c) 2021 Tano Systems LLC. All rights reserved.
#

require conf/machine/include/mitx.inc

OPENWRT_VERSION_PRODUCT = "Baikal Electronics MBM 1.0 Board"
```

## meta-tanowrt-hsl-baikal/conf/machine/include/mbm20.inc
```bitbake
#
# SPDX-License-Identifier: MIT
# Copyright (c) 2021 Tano Systems LLC. All rights reserved.
#

require conf/machine/include/mitx.inc

OPENWRT_VERSION_PRODUCT = "Baikal Electronics MBM 2.0 Board"
```

## meta-tanowrt-hsl-baikal/conf/machine/include/mitx.inc
```bitbake
#
# SPDX-License-Identifier: MIT
# Copyright (c) 2021 Tano Systems LLC. All rights reserved.
#

require conf/machine/include/baikal-be-m1000.inc

MACHINEOVERRIDES =. "mitx:"

TANOWRT_PARTUUID_BOOT        = "6468acf8-db09-4a44-8a28-1277390934ba "
TANOWRT_PARTUUID_OVERLAY     = "25a56de0-1873-4c27-b228-b5ff9a1f82bb"
TANOWRT_PARTUUID_ROOTDEV_A   = "66430133-7e75-404d-8714-241922f9eca7"
TANOWRT_PARTUUID_ROOTDEV_B   = "a55febe1-5b24-465c-a7e2-3070cf3a22a8"
TANOWRT_PARTUUID_KERNELDEV_A = "88bfbf5d-75ea-42e2-b605-b6faef0db41e"
TANOWRT_PARTUUID_KERNELDEV_B = "2c3d2555-fb65-41a6-9d8c-cf835ff030ee"

TANOWRT_PARTUUID_VARS = "\
	TANOWRT_PARTUUID_BOOT \
	TANOWRT_PARTUUID_OVERLAY \
	TANOWRT_PARTUUID_ROOTDEV_A \
	TANOWRT_PARTUUID_ROOTDEV_B \
	TANOWRT_PARTUUID_KERNELDEV_A \
	TANOWRT_PARTUUID_KERNELDEV_B \
"

#
# Machine
#
MACHINE_FEATURES = "\
	pci \
	apm \
	usbhost \
	vfat \
	ext2 \
	ethernet \
	wifi \
	cgroup \
	stp \
	lldp \
	crypto \
	efi \
	screen \
	swupdate \
"

MACHINE_EXTRA_RRECOMMENDS_append = "\
	nvme-cli \
"

#
# Image generation
#
ROOTFS_IMAGE_FSTYPE = "squashfs-lzo"
IMAGE_FSTYPES = "wic ${ROOTFS_IMAGE_FSTYPE}"
MACHINE_EXTRA_RDEPENDS_append = " usbutils-ids "

SPLASH = "psplash"
IMAGE_FEATURES += "${@bb.utils.contains('MACHINE_FEATURES', 'screen', 'splash', '', d)}"

EFI_PROVIDER = "grub-efi"

WKS_FILE = "image-baikal-m-swu-a-b.wks.in"
WKS_FILE_DEPENDS = "syslinux-native e2fsprogs-native dosfstools-native mtools-native squashfs-tools-native"
WIC_CREATE_EXTRA_ARGS = "--no-fstab-update"
WIC_DO_IMAGE_DEPENDS = "\
	${IMAGE_BASENAME}:do_image_squashfs_lzo \
	${EFI_PROVIDER}:do_deploy \
	virtual/grub-bootconf:do_deploy \
"
do_image_wic[depends] += "${WIC_DO_IMAGE_DEPENDS}"

# These variables are used in image-baikal-m-swu-a-b.wks.in
WKS_IMAGE_ROOTFS_BINARY = "${IMAGE_BASENAME}-${MACHINE}.${ROOTFS_IMAGE_FSTYPE}"
WKS_IMAGE_KERNEL_BINARY = "${KERNEL_IMAGETYPE}-${MACHINE}.ext4"
WKS_IMAGE_GRUB_CONFIG = "grub.cfg"

TANOWRT_ENABLE_OVERLAY_RESIZE = "1"

# Remove /boot from root filesystem
ROOTFS_RM_BOOT_DIR_DISABLE = "0"

IMAGE_INSTALL_append = "\
	grub-editenv \
	efibootmgr \
"

PACKAGECONFIG_append_pn-fstools = " ovl-rootdisk-part "

#
# Initramfs (used for factory installation image)
#
## TODO:
##INITRAMFS_IMAGE = "tanowrt-image-initramfs-swu-factory"
##INITRAMFS_IMAGE_NAME = "${INITRAMFS_IMAGE}-${MACHINE}"
##INITRAMFS_IMAGE_BUNDLE = "0"

##INITRD = "${DEPLOY_DIR_IMAGE}/${INITRAMFS_IMAGE_NAME}.cpio.gz"

#
# SWUpdate
#
SWU_BOOTLOADER = "grub-efi"
SWU_OVERLAY_CONTAINER = "blkdev"
SWU_OVERLAY_FS = "ext4"

SWU_IMAGE_MEDIA_TYPE = "USB/SATA/NVMe Drive"

SWU_IMAGE_EXTRA_ARTIFACTS += "kernel bootloader"

SWU_IMAGE_ARTIFACT_kernel[fname] = "${KERNEL_IMAGETYPE}"
SWU_IMAGE_ARTIFACT_kernel[ftype] = "ext4"
SWU_IMAGE_ARTIFACT_kernel[depends] = "virtual/kernel:do_deploy"
SWU_IMAGE_ARTIFACT_kernel[verextract] = "1"
SWU_IMAGE_ARTIFACT_kernel[verextract-cmd] = "strings"
SWU_IMAGE_ARTIFACT_kernel[verextract-filter-cmd] = "grep -m 2 'oe-user@oe-host' | tail -n1 | awk '{ print $3 }'"
SWU_IMAGE_ARTIFACT_kernel[sw-desc-type] = "raw"
SWU_IMAGE_ARTIFACT_kernel[sw-desc-device-a] = "/dev/swu-kernel-a"
SWU_IMAGE_ARTIFACT_kernel[sw-desc-device-b] = "/dev/swu-kernel-b"

SWU_IMAGE_ARTIFACT_rootfs[sw-desc-type] = "raw"
SWU_IMAGE_ARTIFACT_rootfs[sw-desc-device-a] = "/dev/swu-rootfs-a"
SWU_IMAGE_ARTIFACT_rootfs[sw-desc-device-b] = "/dev/swu-rootfs-b"

SWU_IMAGE_ARTIFACT_bootloader[name] = "grub"
SWU_IMAGE_ARTIFACT_bootloader[fname] = "grub-efi-${@os.path.splitext(d.getVar('EFI_BOOT_IMAGE', True))[0]}"
SWU_IMAGE_ARTIFACT_bootloader[ftype] = "efi"
SWU_IMAGE_ARTIFACT_bootloader[depends] = "grub-efi:do_deploy"
SWU_IMAGE_ARTIFACT_bootloader[verextract] = "1"
SWU_IMAGE_ARTIFACT_bootloader[verextract-cmd] = "strings"
SWU_IMAGE_ARTIFACT_bootloader[verextract-filter-cmd] = "sed -n '/GNU GRUB  version %s/{n;p;}'"
SWU_IMAGE_ARTIFACT_bootloader[sw-desc-type] = "rawfile"
SWU_IMAGE_ARTIFACT_bootloader[sw-desc-path] = "${EFI_FILES_PATH}/${EFI_BOOT_IMAGE}"

# Extra dependencies for factory installation script
SWU_INSTALL_EXTRA_RDEPENDS += "parted"

#
# Other
#

# Enable tty1
PROCD_ENABLED_TTYS ?= "1"

TANOWRT_DHCPS_CONFIGURE = "1"
TANOWRT_DHCPS_LAN_ENABLE = "1"

PACKAGECONFIG_append_pn-collectd = " cpufreq sensors "
PACKAGE_ARCH_pn-collectd = "${MACHINE_ARCH}"

OPENWRT_VERSION_HWREV = "${SWU_REVISION}"
```

## meta-tanowrt-hsl-baikal/conf/machine/mbm10.conf
```bitbake
#@TYPE: Machine
#@Name: Baikal Electronics Baikal-M MBM 1.0 Board
#@DESCRIPTION: Machine configuration for Baikal Electronics Baikal-M MBM 1.0 Board

#
# SPDX-License-Identifier: MIT
# Copyright (c) 2021 Tano Systems LLC. All rights reserved.
#

require conf/machine/include/mbm10.inc

#
# Image
#
KERNEL_DEVICETREE ?= "\
	baikal/bm1000-mbm10.dtb \
"

#
# SWUpdate
#
SWU_BOARD = "mbm10"
SWU_REVISION = "1.0"
```

## meta-tanowrt-hsl-baikal/conf/machine/mbm20.conf
```bitbake
#@TYPE: Machine
#@Name: Baikal Electronics Baikal-M MBM 2.0 Board
#@DESCRIPTION: Machine configuration for Baikal Electronics Baikal-M MBM 2.0 Board

#
# SPDX-License-Identifier: MIT
# Copyright (c) 2021 Tano Systems LLC. All rights reserved.
#

require conf/machine/include/mbm20.inc

#
# Image
#
KERNEL_DEVICETREE ?= "\
	baikal/bm1000-mbm20.dtb \
"

#
# SWUpdate
#
SWU_BOARD = "mbm20"
SWU_REVISION = "1.0"
```

## meta-tanowrt-hsl-brcm/conf/layer.conf
```bitbake
#
# SPDX-License-Identifier: MIT
# Copyright (c) 2020 Tano Systems LLC. All rights reserved.
#

# Layer version
LAYERVERSION = "1"

# We have a conf and classes directory, append to BBPATH
BBPATH .= ":${LAYERDIR}"

# We have a recipes directory, add to BBFILES
BBFILES += "${LAYERDIR}/recipes*/*/*.bb \
            ${LAYERDIR}/recipes*/*/*.bbappend"

BBFILE_COLLECTIONS += "meta-tanowrt-hsl-brcm"
BBFILE_PATTERN_meta-tanowrt-hsl-brcm := "^${LAYERDIR}/"
BBFILE_PRIORITY_meta-tanowrt-hsl-brcm = "17"

LICENSE_PATH += "${LAYERDIR}/licenses"

LAYERDEPENDS_meta-tanowrt-hsl-brcm = "\
	meta-tanowrt \
	raspberrypi \
"

LAYERSERIES_COMPAT_meta-tanowrt-hsl-brcm = "hardknott"

# Set a variable to get the top of the metadata location
TANOWRT_HSL_BASE = '${@os.path.normpath("${LAYERDIR}/")}'
```

## meta-tanowrt-hsl-brcm/conf/machine/rpi3-sd.conf
```bitbake
#
# SPDX-License-Identifier: MIT
# Copyright (c) 2020 Tano Systems LLC. All rights reserved.
#

#@TYPE: Machine
#@NAME: RaspberryPi 3 Model B+ Development Board (32bit)
#@DESCRIPTION: Machine configuration for the RaspberryPi 3 Model B/B+ (32 bit) runnig on SD card

require conf/machine/include/rpi3.inc

RPI_KERNEL_DEVICETREE = " \
    bcm2710-rpi-3-b.dtb \
    bcm2710-rpi-3-b-plus.dtb \
    bcm2837-rpi-3-b.dtb \
    bcm2837-rpi-3-b-plus.dtb \
"

TANOWRT_ENABLE_OVERLAY_RESIZE = "1"

UBOOT_MACHINE = "rpi_3_32b_config"
ARMSTUB = "armstub7.bin"
```

## meta-tanowrt-hsl-intel/conf/layer.conf
```bitbake
# Layer version
LAYERVERSION = "1"

# We have a conf and classes directory, append to BBPATH
BBPATH .= ":${LAYERDIR}"

# We have a recipes directory, add to BBFILES
BBFILES += "${LAYERDIR}/recipes*/*/*.bb \
            ${LAYERDIR}/recipes*/*/*.bbappend"

BBFILE_COLLECTIONS += "meta-tanowrt-hsl-intel"
BBFILE_PATTERN_meta-tanowrt-hsl-intel := "^${LAYERDIR}/"
BBFILE_PRIORITY_meta-tanowrt-hsl-intel = "17"

LAYERDEPENDS_meta-tanowrt-hsl-intel = "\
	meta-tanowrt \
	intel \
"

LAYERSERIES_COMPAT_meta-tanowrt-hsl-intel = "kirkstone"

# Set a variable to get the top of the metadata location
TANOWRT_HSL_BASE = '${@os.path.normpath("${LAYERDIR}/")}'
```

## meta-tanowrt-hsl-intel/conf/machine/include/intel-common-tanowrt-gfx.inc
```bitbake
#
# SPDX-License-Identifier: MIT
# Copyright (c) 2022 Tano Systems LLC. All rights reserved.
#

#
# Machine/distro features
#
MACHINE_FEATURES:append = "\
	screen \
	opengl \
"

#
# Psplash
#
IMAGE_FEATURES += "splash"
SPLASH = "psplash"

#
# QEMU options (runqemu)
#
QB_OPT_APPEND:append = "\
	-device usb-tablet \
	-serial mon:stdio \
	-serial null \
"

QB_OPT_APPEND:append = " -vga std "

#
# Enable SDL display in QEMU
#
PACKAGECONFIG:append:pn-qemu-system-native = " sdl"
PACKAGECONFIG:append:pn-nativesdk-qemu = " sdl"
```

## meta-tanowrt-hsl-intel/conf/machine/include/intel-common-tanowrt-qemu.inc
```bitbake
#
# SPDX-License-Identifier: MIT
# Copyright (c) 2022 Tano Systems LLC. All rights reserved.
#

# For runqemu
IMAGE_CLASSES += "qemuboot"

QB_DEFAULT_FSTYPE = "wic"

QB_SYSTEM_NAME:intel-x86-64-corei7 = "qemu-system-x86_64"
QB_CPU:intel-x86-64-corei7 = "-cpu Nehalem"
QB_CPU_KVM:intel-x86-64-corei7 = "-cpu kvm64"

QB_SYSTEM_NAME:intel-x86-64-skylake = "qemu-system-x86_64"
QB_CPU:intel-x86-64-skylake = "-cpu Skylake-Client"
QB_CPU_KVM:intel-x86-64-skylake = "-cpu Skylake-Client"

QB_AUDIO_DRV = "alsa"
QB_AUDIO_OPT = "-soundhw ac97,es1370"
QB_KERNEL_CMDLINE_APPEND = " oprofile.timer=1"
# Add the 'virtio-rng-pci' device otherwise the guest may run out of entropy
QB_OPT_APPEND = " -usb -usbdevice tablet -device virtio-rng-pci"

#
# QEMU options (runqemu)
#
QB_OPT_APPEND:append = "\
	-device usb-tablet \
	-serial mon:stdio \
	-serial null \
"

QB_OPT_APPEND:append = " -vga std "

#
# Enable SDL display in QEMU
#
PACKAGECONFIG:append:pn-qemu-system-native = " sdl"
PACKAGECONFIG:append:pn-nativesdk-qemu = " sdl"
```

## meta-tanowrt-hsl-intel/conf/machine/include/intel-common-tanowrt-swu.inc
```bitbake
#
# SPDX-License-Identifier: MIT
# Copyright (c) 2022 Tano Systems LLC. All rights reserved.
#

#
# Machine/distro features
#
MACHINE_FEATURES:append = "\
	swupdate \
"

SWU_BOOTLOADER = "grub-efi"
SWU_OVERLAY_CONTAINER = "blkdev"
SWU_OVERLAY_FS = "ext4"

SWU_IMAGE_MEDIA_TYPE = "HDD"

SWU_IMAGE_EXTRA_ARTIFACTS += "bootloader"

SWU_IMAGE_ARTIFACT_rootfs[sw-desc-type] = "raw"
SWU_IMAGE_ARTIFACT_rootfs[sw-desc-device-a] = "/dev/swu-system-a"
SWU_IMAGE_ARTIFACT_rootfs[sw-desc-device-b] = "/dev/swu-system-b"

SWU_IMAGE_ARTIFACT_bootloader[name] = "grub"
SWU_IMAGE_ARTIFACT_bootloader[fname] = "grub-efi-${@os.path.splitext(d.getVar('EFI_BOOT_IMAGE', True))[0]}"
SWU_IMAGE_ARTIFACT_bootloader[ftype] = "efi"
SWU_IMAGE_ARTIFACT_bootloader[depends] = "grub-efi:do_deploy"
SWU_IMAGE_ARTIFACT_bootloader[verextract] = "1"
SWU_IMAGE_ARTIFACT_bootloader[verextract-cmd] = "strings"
SWU_IMAGE_ARTIFACT_bootloader[verextract-filter-cmd] = "sed -n '/GNU GRUB  version %s/{n;p;}'"
SWU_IMAGE_ARTIFACT_bootloader[sw-desc-type] = "rawfile"
SWU_IMAGE_ARTIFACT_bootloader[sw-desc-path] = "${EFI_FILES_PATH}/${EFI_BOOT_IMAGE}"
```

## meta-tanowrt-hsl-intel/conf/machine/include/intel-common-tanowrt.inc
```bitbake
#
# SPDX-License-Identifier: MIT
# Copyright (c) 2022 Tano Systems LLC. All rights reserved.
#

#
# Kernel
#
KERNEL_IMAGETYPE = "bzImage"

PREFERRED_PROVIDER_virtual/kernel = "linux-tano-intel"

PREFERRED_VERSION_linux-tano-intel = "5.15%"
PREFERRED_VERSION_linux-tano-intel-rt = "5.15%"

PREFERRED_VERSION_xtables-addons = "3.13%"

LINUXLIBCVERSION = "5.10%"
SDKLINUXLIBCVERSION = "5.10%"

# Set to "1" for kernels 5.6+
TANOWRT_WIREGUARD_IN_KERNEL = "1"

# Enable tty0
PROCD_ENABLED_TTYS ?= "0"

MACHINE_FEATURES:append = " hwrng "

# Do not install all firmwares (> 700 MiB), install only specified
MACHINE_EXTRA_RRECOMMENDS:remove = "linux-firmware"

###########################################

#
# PACKAGECONFIG's
#
PACKAGECONFIG:append_pn-fstools = " ovl-rootdisk-part "

#
# Kernel
#
SERIAL_CONSOLES ?= "115200;ttyS0"

KERNEL_CLASSES = "kernel-tn-mkimage"
KERNEL_MKIMAGE_TYPES = ""

#
# Image
#
TANOWRT_PARTUUID_BOOT      = "617d05fc-e3ca-4427-842b-18355497a0db"
TANOWRT_PARTUUID_OVERLAY   = "5f198da7-09e9-426b-ab5a-8791bc3fdc77"
TANOWRT_PARTUUID_ROOTDEV_A = "cd5da453-1fc1-4eb1-ba16-d32672642f77"
TANOWRT_PARTUUID_ROOTDEV_B = "a4ab17b2-49fb-48c9-a0f6-f14be8c11515"

TANOWRT_PARTUUID_VARS = "\
	TANOWRT_PARTUUID_BOOT \
	TANOWRT_PARTUUID_OVERLAY \
	TANOWRT_PARTUUID_ROOTDEV_A \
	TANOWRT_PARTUUID_ROOTDEV_B \
"

KERNEL_MODULE_AUTOLOAD:append = " i2c-dev"

TANOWRT_NETIFD_CONFIGURE_INTERFACES = "lan"
TANOWRT_NETIFD_CONFIGURE_INTERFACE_lan = "proto=dhcp device=br-lan"

TANOWRT_DHCPS_CONFIGURE ?= "1"
TANOWRT_DHCPS_LAN_ENABLE = "0"

ROOTFS_IMAGE_FSTYPE = "squashfs-lzo"
IMAGE_FSTYPES = "wic wic.vmdk ${ROOTFS_IMAGE_FSTYPE}"
IMAGE_CLASSES += "rootfs-mv-kernel-to-root"

TANOWRT_ENABLE_OVERLAY_RESIZE = "1"

EFI_PROVIDER = "grub-efi"
EFI_STARTUP_DEVICE = "fs1"

WKS_FILE = "intel-common-tanowrt-image.wks.in"
WKS_FILE_DEPENDS = "syslinux syslinux-native e2fsprogs-native dosfstools-native mtools-native squashfs-tools-native"
WIC_CREATE_EXTRA_ARGS = "--no-fstab-update"
WIC_DO_IMAGE_DEPENDS = "\
	${IMAGE_BASENAME}:do_image_squashfs_lzo \
	${EFI_PROVIDER}:do_deploy \
	virtual/grub-bootconf:do_deploy \
"
do_image_wic[depends] += "${WIC_DO_IMAGE_DEPENDS}"

WKS_IMAGE_ROOTFS_BINARY = "${IMAGE_BASENAME}-${MACHINE}.${ROOTFS_IMAGE_FSTYPE}"
WKS_IMAGE_KERNEL_BINARY = "${KERNEL_IMAGETYPE}-${MACHINE}.ext4"
WKS_IMAGE_GRUB_CONFIG = "grub.cfg"

# Remove /boot from root filesystem
ROOTFS_RM_BOOT_DIR_DISABLE = "0"

IMAGE_INSTALL:append = "\
	grub-editenv \
"

#
# Image
#
IMAGE_INSTALL:append = "\
	i2c-tools \
	pmtools \
	nvme-cli \
	dmidecode \
	pciutils-ids \
	usbutils-ids \
	efivar \
	iperf2 \
	iperf3 \
	lmsensors \
	tmux \
	spitools \
	hdparm \
	parted \
	util-linux-lsblk \
	gptfdisk \
	tcpdump \
"

#
# Machine/distro features
#
MACHINE_FEATURES = "\
	pci \
	apm \
	usbhost \
	vfat \
	ext2 \
	ethernet \
	cgroup \
	stp \
	lldp \
	crypto \
	pcbios \
	efi \
	psample \
"

#
# OpenWrt specific
#
OPENWRT_VERSION_PRODUCT = "Intel x86_64"
OPENWRT_VERSION_HWREV = "1.0"
```

## meta-tanowrt-hsl-intel/conf/machine/include/intel-x86-64-corei7.inc
```bitbake
#
# SPDX-License-Identifier: MIT
# Copyright (c) 2022 Tano Systems LLC. All rights reserved.
#

require conf/machine/include/meta-intel.inc
require conf/machine/include/intel-corei7-64-common.inc
require conf/machine/include/intel-common-pkgarch.inc

require conf/machine/include/intel-common-tanowrt.inc
require conf/machine/include/intel-common-tanowrt-swu.inc
require conf/machine/include/intel-common-tanowrt-gfx.inc
require conf/machine/include/intel-common-tanowrt-qemu.inc

#
# Kernel
#
PREFERRED_VERSION_linux-tano-intel = "5.10%"
PREFERRED_VERSION_linux-tano-intel-rt = "5.10%"

#
# Other
#
MACHINE_FEATURES += "intel-ucode"
MACHINE_HWCODECS ?= "${@bb.utils.contains('TUNE_FEATURES', 'mx32', '', 'intel-media-driver intel-mediasdk', d)} gstreamer1.0-vaapi"

XSERVER ?= "${XSERVER_X86_BASE} \
            ${XSERVER_X86_EXT} \
            ${XSERVER_X86_FBDEV} \
            ${XSERVER_X86_I915} \
            ${XSERVER_X86_I965} \
            ${XSERVER_X86_MODESETTING} \
            ${XSERVER_X86_VESA} \
            ${XSERVER_X86_ASPEED_AST} \
           "
```
