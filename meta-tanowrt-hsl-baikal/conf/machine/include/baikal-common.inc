## meta-tanowrt-hsl-nxp/conf/machine/ls1028ardb-sd.conf
```bitbake
#
# SPDX-License-Identifier: MIT
# Copyright (c) 2020-2021 Tano Systems LLC. All rights reserved.
#

#@TYPE: Machine
#@NAME: NXP LS1028A RDB
#@SOC: LSCH3
#@DESCRIPTION: Machine configuration for running NXP LS1028A RDB board running on SD card

require ${TANOWRT_HSL_BASE}/conf/machine/include/ls1028ardb-common.inc

OPENWRT_VERSION_PRODUCT:append = " (SD)"

#
# Bootloader
#
UBOOT_CONFIG = "sdcard-defconfig"
UBOOT_CONFIG[sdcard-defconfig] = "ls1028ardb_sdcard_defconfig,,u-boot-with-spl.bin"

#
# RCW
#
RCW_BINARY = "${RCW_BINARY_SD_BOOT}"

#
# Machine/distro features
#

#
# Image
#
IMAGE_CLASSES += "wic-sdcard-img"
IMAGE_FSTYPES += "wic"

# WIC
WKS_FILE = "sdimage-ls1028ardb-swu-a-b.wks.in"
WIC_CREATE_EXTRA_ARGS = "--no-fstab-update"

WIC_DO_IMAGE_DEPENDS = "\
	${IMAGE_BASENAME}:do_image_squashfs_lzo \
	u-boot-startup-script:do_deploy \
	virtual/bootloader:do_deploy \
	virtual/kernel:do_deploy \
	ppa:do_deploy \
	rcw:do_deploy \
	dosfstools-native:do_populate_sysroot \
	mtools-native:do_populate_sysroot \
"
do_image_wic[depends] += "${WIC_DO_IMAGE_DEPENDS}"

#
# SWUPDATE
#
SWU_BOARD = "ls1028ardb-sd"
SWU_REVISION = "1.0"

SWU_IMAGE_MEDIA_TYPE = "SD Card"
SWU_IMAGE_MMCDEV = "/dev/mmcblk0"
```

## meta-tanowrt-hsl-nxp/conf/machine/nxp-ls1028ardb.conf
```bitbake
#@TYPE: Machine
#@NAME: NXP LS1028ARDB
#@SOC: LSCH3
#@DESCRIPTION: Machine configuration for running LS1028ARDB in 64-bit mode

KERNEL_IMAGETYPE ?= "Image"

SERIAL_CONSOLES ?= "115200;ttyS0 115200;ttyS1 115200;ttyAMA0"
SERIAL_CONSOLES_CHECK ?= ""

PREFERRED_PROVIDER_u-boot ?= "u-boot-openil"
PREFERRED_PROVIDER_u-boot-fw-utils ?= "${PREFERRED_PROVIDER_u-boot}-fw-utils"
PREFERRED_PROVIDER_virtual/bootloader ?= "u-boot-openil"
PREFERRED_PROVIDER_virtual/kernel ?= "linux-tano-openil"

PREFERRED_VERSION_linux-tano-openil = "4.14%"
LINUXLIBCVERSION = "openil-4.14%"
SDKLINUXLIBCVERSION = "openil-4.14%"

require conf/machine/ls1028ardb.conf

UBOOT_CONFIG = "sdcard-defconfig"
UBOOT_CONFIG[sdcard-defconfig] = "ls1028ardb_sdcard_defconfig,,u-boot-with-spl.bin"

UBOOT_BINARY = "u-boot.bin"

UBOOT_IMAGE_ENV_SIZE ?= "0x2000"
UBOOT_IMAGE_ENV_BINARY = "u-boot-env.bin"

UBOOT_IMAGE_BINARY = "${UBOOT_BINARY}"

RCW_BINARY = "rcw/ls1028ardb/R_SQPP_0x85bb/rcw_1300_sdboot.bin"

EXTRA_IMAGEDEPENDS += "u-boot-image-env-binary ppa"
MACHINE_EXTRA_RRECOMMENDS_remove = "udev-extraconf"

#
# Machine/distro features
#
MACHINE_FEATURES += "pci usbhost vfat wifi cgroup"

#
# Other
#
OPENWRT_VERSION_PRODUCT = "NXP LS1028ARDB"
OPENWRT_VERSION_HWREV = "v1"

PACKAGECONFIG_append_pn-fstools = " ovl-f2fs ovl-rootdisk-part "

#
# Image
#
IMAGE_INSTALL_append = " pciutils "
IMAGE_INSTALL_append = " usbutils-ids "

EXTRA_IMAGEDEPENDS_remove = "atf"

IMAGE_CLASSES += "sdimage-nxp-helper"
IMAGE_FSTYPES += "wic"
IMAGE_BOOT_FILES = "${KERNEL_IMAGETYPE} dp/ls1028a-dp-fw.bin ${@parse_dtbs(d)}"

# WIC
WKS_FILE = "sdimage-ls1028ardb.wks.in"
WIC_CREATE_EXTRA_ARGS = "--no-fstab-update"
```
