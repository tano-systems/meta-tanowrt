## meta-tanowrt-hsl-intel/conf/machine/include/intel-x86-64-skylake.inc
```bitbake
#
# SPDX-License-Identifier: MIT
# Copyright (c) 2022 Tano Systems LLC. All rights reserved.
#

X86_TUNE_DIR ?= "include/x86"

require conf/machine/include/meta-intel.inc
require conf/machine/${X86_TUNE_DIR}/x86-base.inc
require conf/machine/include/tune-skylake.inc
require conf/machine/include/intel-common-pkgarch.inc

require conf/machine/include/intel-common-tanowrt.inc
require conf/machine/include/intel-common-tanowrt-swu.inc
require conf/machine/include/intel-common-tanowrt-gfx.inc
require conf/machine/include/intel-common-tanowrt-qemu.inc

#
# Kernel
#
PREFERRED_VERSION_linux-tano-intel = "5.10%"
PREFERRED_VERSION_linux-tano-intel-rt = "5.10%"

#
# Other
#
MACHINE_FEATURES += "intel-ucode"
MACHINE_HWCODECS ?= "intel-media-driver intel-mediasdk gstreamer1.0-vaapi"

XSERVER ?= "${XSERVER_X86_BASE} \
            ${XSERVER_X86_EXT} \
            ${XSERVER_X86_FBDEV} \
            ${XSERVER_X86_I915} \
            ${XSERVER_X86_I965} \
            ${XSERVER_X86_MODESETTING} \
            ${XSERVER_X86_VESA} \
            ${XSERVER_X86_ASPEED_AST} \
           "
```

## meta-tanowrt-hsl-intel/conf/machine/intel-x86-64-corei7.conf
```bitbake
#
# SPDX-License-Identifier: MIT
# Copyright (c) 2022 Tano Systems LLC. All rights reserved.
#
# Machine configuration for 64 bit Intel Core i7 CPU (and later)
# with MMX, SSE, SSE2, SSE3, and SSSE3 instruction set support.
# Supports a moderately wide range of drivers that should boot
# and be usable on "typical" hardware.
#

#@TYPE: Machine
#@NAME: intel-x86-64-corei7
#@DESCRIPTION: Machine configuration for 64 bit Intel Core i7 CPU (and later)

#
# CPU
#
require conf/machine/include/intel-x86-64-corei7.inc

#
# SWUPDATE
#
SWU_BOARD = "${MACHINE}"
SWU_REVISION = "1.0"
SWU_HW_COMPATIBILITY = '"1.0"'
```

## meta-tanowrt-hsl-intel/conf/machine/intel-x86-64-skylake.conf
```bitbake
#
# SPDX-License-Identifier: MIT
# Copyright (c) 2022 Tano Systems LLC. All rights reserved.
#
# Machine configuration for 64 bit Intel Skylake CPU (and later)
# with MMX, SSE, SSE2, SSE3, SSE4.1, SSE4.2, AVX, and AVX2
# instruction set support. Supports a moderately wide range
# of drivers that should boot and be usable on "typical" hardware.
#

#@TYPE: Machine
#@NAME: intel-x86-64-skylake
#@DESCRIPTION: Machine configuration for 64 bit Intel Skylake CPU (and later)

#
# CPU
#
require conf/machine/include/intel-x86-64-skylake.inc

#
# SWUPDATE
#
SWU_BOARD = "${MACHINE}"
SWU_REVISION = "1.0"
SWU_HW_COMPATIBILITY = '"1.0"'
```

## meta-tanowrt-hsl-nxp/conf/layer.conf
```bitbake
# Layer version
LAYERVERSION = "1"

# We have a conf and classes directory, append to BBPATH
BBPATH .= ":${LAYERDIR}"

# We have a recipes directory, add to BBFILES
BBFILES += "${LAYERDIR}/recipes*/*/*.bb \
            ${LAYERDIR}/recipes*/*/*.bbappend"

BBFILE_COLLECTIONS += "meta-tanowrt-hsl-nxp"
BBFILE_PATTERN_meta-tanowrt-hsl-nxp := "^${LAYERDIR}/"
BBFILE_PRIORITY_meta-tanowrt-hsl-nxp = "17"

LICENSE_PATH += "${LAYERDIR}/licenses"

LAYERDEPENDS_meta-tanowrt-hsl-nxp = "\
	meta-tanowrt \
	freescale-layer \
	core \
	openembedded-layer \
	networking-layer \
	meta-python \
	multimedia-layer \
"

LAYERSERIES_COMPAT_meta-tanowrt-hsl-nxp = "dunfell"

# Set a variable to get the top of the metadata location
TANOWRT_HSL_BASE = '${@os.path.normpath("${LAYERDIR}/")}'

# Dunfell branch has no recipes for opencv 4.x
BBMASK += "recipes-support/opencv/opencv_4.%.bbappend"

#
# Dynamic layers
#
BBFILES_DYNAMIC += "\
	qt5-layer:${LAYERDIR}/layers-dynamic/meta-qt5/*/*/*.bb \
	qt5-layer:${LAYERDIR}/layers-dynamic/meta-qt5/*/*/*.bbappend \
"
```

## meta-tanowrt-hsl-nxp/conf/machine/include/ls1028a-gpu.inc
```bitbake
#
# SPDX-License-Identifier: MIT
# Copyright (c) 2020 Tano Systems LLC. All rights reserved.
#
MACHINEOVERRIDES =. "imxgpu:imxgpu2d:imxgpu3d:imxdrm:"

PREFERRED_PROVIDER_virtual/xserver = "xserver-xorg"
XSERVER_DRIVER_imxgpu2d = "xf86-video-imx-vivante"

# Graphics libraries
PREFERRED_PROVIDER_virtual/egl           ?= "imx-gpu-viv"
PREFERRED_PROVIDER_virtual/libgl         ?= "imx-gpu-viv"
PREFERRED_PROVIDER_virtual/libgles1      ?= "imx-gpu-viv"
PREFERRED_PROVIDER_virtual/libgles2      ?= "imx-gpu-viv"
PREFERRED_PROVIDER_virtual/libgbm        ?= "imx-gpu-viv"
PREFERRED_PROVIDER_virtual/libg2d        ?= "imx-gpu-g2d"
PREFERRED_PROVIDER_virtual/libg2d_imxdpu ?= "imx-dpu-g2d"

PREFERRED_VERSION_libdrm = "2.4.99.imx"
PREFERRED_VERSION_wayland-protocols = "1.18.imx"

MACHINE_HAS_VIVANTE_KERNEL_DRIVER_SUPPORT = "1"

#PREFERRED_PROVIDER_virtual/egl_imxgpu        ?= "imx-gpu-viv"
#PREFERRED_PROVIDER_virtual/libgl_imxgpu3d    ?= "imx-gpu-viv"
#PREFERRED_PROVIDER_virtual/libgles1_imxgpu3d ?= "imx-gpu-viv"
#PREFERRED_PROVIDER_virtual/libgles2_imxgpu3d ?= "imx-gpu-viv"

# Graphics
#XSERVER += "xf86-input-tslib"
MACHINE_GUI_CLASS = "largescreen"
QT_PROVIDER = "qt5"

#
# Graphics (Qt5) configuration
#
#PREFERRED_PROVIDER_virtual/egl      = "mesa-gl"
#PREFERRED_PROVIDER_virtual/libgl    = "mesa-gl"
#PREFERRED_PROVIDER_virtual/libgles1 = "mesa-gl"
#PREFERRED_PROVIDER_virtual/libgles2 = "mesa-gl"

#PREFERRED_PROVIDER_virtual/egl = "ti-sgx-ddk-um"
#PREFERRED_PROVIDER_virtual/libgles1 = "ti-sgx-ddk-um"
#PREFERRED_PROVIDER_virtual/libgles2 = "ti-sgx-ddk-um"
#PREFERRED_PROVIDER_virtual/libgl = "mesa-gl"
#PREFERRED_PROVIDER_libgbm = "libgbm"
#PREFERRED_PROVIDER_libgbm-dev = "libgbm-dev"

# Configure Qt5 flags (GLES is still required for qtdeclarative and qtwebkit)
#PACKAGECONFIG_GL:pn-qtbase = "gles2 linuxfb"
#PACKAGECONFIG_DISTRO:pn-qtbase = "icu accessibility"
#PACKAGECONFIG_FONTS:pn-qtbase = "fontconfig"

# Add gstreamer in package configuration to enable video
#PACKAGECONFIG:append:pn-qtmultimedia  = " gstreamer"
```

## meta-tanowrt-hsl-nxp/conf/machine/include/ls1028ardb-common.inc
```bitbake
#
# SPDX-License-Identifier: MIT
# Copyright (c) 2020-2021 Tano Systems LLC. All rights reserved.
#

#
# Architecture/machine
#
require conf/machine/include/qoriq-arm64.inc
require conf/machine/include/arm/arch-arm64.inc

SERIAL_CONSOLES = "115200;ttyS0 115200;ttyS1 115200;ttyAMA0"
SERIAL_CONSOLES_CHECK = ""

SOC_DEFAULT_IMAGE_FSTYPES = "tar.gz ext4.gz"
MACHINE_FEATURES_remove = "ext2"

MACHINEOVERRIDES =. "ls1028ardb:fsl-lsch3:ls1028a:"

MACHINE_FEATURES += "\
	optee pci usbhost vfat wifi cgroup stp lldp \
	screen crypto hwrng watchdog touchscreen swupdate \
"

#
# Bootloader
#
PREFERRED_PROVIDER_u-boot = "u-boot-openil"
PREFERRED_PROVIDER_virtual/bootloader = "u-boot-openil"

UBOOT_DTB_LOADADDRESS = "0x90000000"
UBOOT_ENTRYPOINT = "0x80080000"

UBOOT_DTBO_LOADADDRESS = "0x97f00000"
UBOOT_DTBO_OFFSET      = "0x00010000"
UBOOT_RD_LOADADDRESS   = "0x94000000"
UBOOT_RD_ENTRYPOINT    = "0x94000000"

UBOOT_ENV_SIZE      = "0x2000"
UBOOT_ENV_REDUNDANT = "1"
UBOOT_INITIAL_ENV = "u-boot-initial-env"

UBOOT_SUFFIX = "bin"
UBOOT_BINARY = "u-boot-${MACHINE}.${UBOOT_SUFFIX}"

#
# Kernel
#
KERNEL_IMAGETYPE ?= "fitImage"

PREFERRED_PROVIDER_virtual/kernel = "linux-tano-openil"

PREFERRED_VERSION_linux-tano-openil = "5.4%"
LINUXLIBCVERSION = "openil-5.4%"
SDKLINUXLIBCVERSION = "openil-5.4%"

KERNEL_IMAGETYPES = "fitImage"
KERNEL_CLASSES = "kernel-tn-fitimage kernel-tn-mkimage"
KERNEL_MKIMAGE_TYPES = "ext4"

KERNEL_DEVICETREE ?= "freescale/fsl-ls1028a-rdb.dtb"
KERNEL_DEFCONFIG ?= "defconfig"

#
# RCW
#
RCW_BINARY_EMMC_BOOT = "rcw/ls1028ardb/R_SQPH_0x85be/rcw_1300_emmcboot.bin"
RCW_BINARY_SD_BOOT = "rcw/ls1028ardb/R_SQPH_0x85be/rcw_1300_sdboot.bin"

RCWSD ?= "R_SQPP_0x85bb/rcw_1500_gpu600"
RCWXSPI ?= "R_SQPP_0x85bb/rcw_1500_gpu600"
RCWEMMC ?= "R_SQPP_0x85bb/rcw_1500_gpu600"

#
# Image
#
EXTRA_IMAGEDEPENDS += "rcw dp-firmware-cadence ppa"
USE_VT = "0"
MACHINE_EXTRA_RRECOMMENDS_remove = "udev-extraconf"

ROOTFS_IMAGE_FSTYPE = "squashfs-lzo"
IMAGE_FSTYPES += "${ROOTFS_IMAGE_FSTYPE}"
MACHINE_EXTRA_RDEPENDS_append = " usbutils-ids "

# Enable irqbalance
IRQBALANCE_CONFIG_ENABLED = "1"
MACHINE_EXTRA_RDEPENDS_append = " irqbalance "

# Add support for Intel Wi-Fi modules
MACHINE_EXTRA_RRECOMMENDS_append = " linux-firmware-iwlwifi "
MACHINE_EXTRA_RDEPENDS_append = " linux-backports "
LINUX_BACKPORTS_CONFIGS = "iwlwifi"

SPLASH = "psplash"
IMAGE_FEATURES += "splash"

# These variables are used in sdimage-ls1028ardb-swu-a-b.wks.in
WKS_IMAGE_UBOOT_BINARY = "${UBOOT_BINARY}"
WKS_IMAGE_DPFW_BINARY = "ls1028a-dp-fw.bin"
WKS_IMAGE_PPAFW_BINARY = "ppa.itb"
WKS_IMAGE_STARTUP_BINARY = "startup-${MACHINE}.img"
WKS_IMAGE_UBOOT_INITIAL_ENV_BINARY = "u-boot-initial-env-${MACHINE}-sdcard-defconfig.bin"
WKS_IMAGE_RCW_BINARY = "rcw.bin"
WKS_IMAGE_KERNEL_BINARY = "fitImage-${MACHINE}.ext4"
WKS_IMAGE_ROOTFS_BINARY = "${IMAGE_BASENAME}-${MACHINE}.${ROOTFS_IMAGE_FSTYPE}"

#
# SWUPDATE
#
SWU_BOOTLOADER = "uboot"
SWU_OVERLAY_CONTAINER = "blkdev"
SWU_OVERLAY_FS = "ext4"

require ${TANOWRT_HSL_BASE}/conf/machine/include/ls1028ardb-swu.inc

#
# Other
#
OPENWRT_VERSION_PRODUCT = "NXP LS1028A RDB"
OPENWRT_VERSION_HWREV = "${SWU_REVISION}"

PACKAGECONFIG_append_pn-fstools = " ovl-rootdisk-part "

PACKAGECONFIG_append_pn-collectd = " cpufreq sensors "
PACKAGE_ARCH_pn-collectd = "${MACHINE_ARCH}"

OPENWRT_HWCLOCK_DEV       = "/dev/rtc0"
OPENWRT_HWCLOCK_LOCALTIME = "0"

TANOWRT_ENABLE_OVERLAY_RESIZE = "1"

#
# Disable DHCP server on LAN interface
#
TANOWRT_DHCPS_CONFIGURE ?= "1"
TANOWRT_DHCPS_LAN_ENABLE ?= "0"
```

## meta-tanowrt-hsl-nxp/conf/machine/include/ls1028ardb-swu.inc
```bitbake
#
# SPDX-License-Identifier: MIT
# Copyright (c) 2021 Tano Systems LLC. All rights reserved.
#

SWU_IMAGE_MMCDEV ?= "${SWU_IMAGE_MMCDEV}"
SWU_IMAGE_MEDIA_TYPE ?= "SD Card"

SWU_IMAGE_EXTRA_ARTIFACTS += "uboot kernel startup ppafw dpfw"

SWU_IMAGE_ARTIFACT_rootfs[sw-desc-type] = "raw"
SWU_IMAGE_ARTIFACT_rootfs[sw-desc-device-a] = "${SWU_IMAGE_MMCDEV}p2"
SWU_IMAGE_ARTIFACT_rootfs[sw-desc-device-b] = "${SWU_IMAGE_MMCDEV}p4"

SWU_IMAGE_ARTIFACT_uboot[name] = "uboot"
SWU_IMAGE_ARTIFACT_uboot[fname] = "u-boot-${MACHINE}"
SWU_IMAGE_ARTIFACT_uboot[ftype] = "bin-sdcard-defconfig"
SWU_IMAGE_ARTIFACT_uboot[depends] = "virtual/bootloader:do_deploy"
SWU_IMAGE_ARTIFACT_uboot[verextract] = "1"
SWU_IMAGE_ARTIFACT_uboot[verextract-cmd] = "strings"
SWU_IMAGE_ARTIFACT_uboot[verextract-filter-cmd] = "grep -m 2 'U-Boot 20' | tail -n1 | awk '{print $2}'"
SWU_IMAGE_ARTIFACT_uboot[sw-desc-type] = "raw"
SWU_IMAGE_ARTIFACT_uboot[sw-desc-device] = "${SWU_IMAGE_MMCDEV}"
SWU_IMAGE_ARTIFACT_uboot[sw-desc-offset] = "1048576"

SWU_IMAGE_ARTIFACT_startup[fname] = "startup"
SWU_IMAGE_ARTIFACT_startup[ftype] = "img"
SWU_IMAGE_ARTIFACT_startup[depends] = "u-boot-startup-script:do_deploy"
SWU_IMAGE_ARTIFACT_startup[verextract] = "1"
SWU_IMAGE_ARTIFACT_startup[verextract-input] = "${DEPLOY_DIR_IMAGE}/startup-${MACHINE}.img.version"
SWU_IMAGE_ARTIFACT_startup[sw-desc-type] = "raw"
SWU_IMAGE_ARTIFACT_startup[sw-desc-device] = "${SWU_IMAGE_MMCDEV}"
SWU_IMAGE_ARTIFACT_startup[sw-desc-offset] = "3670016"

SWU_IMAGE_ARTIFACT_kernel[fname] = "fitImage"
SWU_IMAGE_ARTIFACT_kernel[ftype] = "ext4"
SWU_IMAGE_ARTIFACT_kernel[depends] = "virtual/kernel:do_deploy"
SWU_IMAGE_ARTIFACT_kernel[verextract] = "1"
SWU_IMAGE_ARTIFACT_kernel[verextract-cmd] = "strings"
SWU_IMAGE_ARTIFACT_kernel[verextract-filter-cmd] = "grep -e 'U-Boot fitImage for TanoWrt/.*/${MACHINE}' | awk -F '/' '{ print $2 }'"
SWU_IMAGE_ARTIFACT_kernel[sw-desc-type] = "raw"
SWU_IMAGE_ARTIFACT_kernel[sw-desc-device-a] = "${SWU_IMAGE_MMCDEV}p1"
SWU_IMAGE_ARTIFACT_kernel[sw-desc-device-b] = "${SWU_IMAGE_MMCDEV}p3"

SWU_IMAGE_ARTIFACT_ppafw[fname] = "ppa"
SWU_IMAGE_ARTIFACT_ppafw[ftype] = "itb"
SWU_IMAGE_ARTIFACT_ppafw[depends] = "ppa:do_deploy"
SWU_IMAGE_ARTIFACT_ppafw[verextract] = "1"
SWU_IMAGE_ARTIFACT_ppafw[verextract-cmd] = "strings"
SWU_IMAGE_ARTIFACT_ppafw[verextract-filter-cmd] = "grep 'PPA Firmware: Version' | awk '{ print $4 }'"
SWU_IMAGE_ARTIFACT_ppafw[sw-desc-type] = "raw"
SWU_IMAGE_ARTIFACT_ppafw[sw-desc-device] = "${SWU_IMAGE_MMCDEV}"
SWU_IMAGE_ARTIFACT_ppafw[sw-desc-offset] = "3407872"

SWU_IMAGE_ARTIFACT_dpfw[fname] = "ls1028a-dp-fw"
SWU_IMAGE_ARTIFACT_dpfw[ftype] = "bin"
SWU_IMAGE_ARTIFACT_dpfw[depends] = "dp-firmware-cadence:do_deploy"
SWU_IMAGE_ARTIFACT_dpfw[verextract] = "1"
SWU_IMAGE_ARTIFACT_dpfw[verextract-cmd] = "strings"
SWU_IMAGE_ARTIFACT_dpfw[verextract-filter-cmd] = "grep -E '\$Revision: [0-9]+ \$' | sed -e 's/\$Revision: \([0-9]\+\) \$/\1/' | tr '\n' '.' | sed 's/.$/\n/'"
SWU_IMAGE_ARTIFACT_dpfw[sw-desc-type] = "raw"
SWU_IMAGE_ARTIFACT_dpfw[sw-desc-device] = "${SWU_IMAGE_MMCDEV}"
SWU_IMAGE_ARTIFACT_dpfw[sw-desc-offset] = "3145728"
```

## meta-tanowrt-hsl-nxp/conf/machine/ls1028ardb-emmc.conf
```bitbake
#
# SPDX-License-Identifier: MIT
# Copyright (c) 2021 Tano Systems LLC. All rights reserved.
#

#@TYPE: Machine
#@NAME: NXP LS1028A RDB
#@SOC: LSCH3
#@DESCRIPTION: Machine configuration for running NXP LS1028A RDB board running on eMMC internal flash with bootloader in NOR flash memory

require ${TANOWRT_HSL_BASE}/conf/machine/include/ls1028ardb-common.inc

OPENWRT_VERSION_PRODUCT:append = " (eMMC)"

#
# Bootloader
#
UBOOT_CONFIG = "sdcard-defconfig emmc-defconfig"
UBOOT_CONFIG[emmc-defconfig] = "ls1028ardb_emmc_defconfig,,u-boot-with-spl.bin"
UBOOT_CONFIG[sdcard-defconfig] = "ls1028ardb_sdcard_defconfig,,u-boot-with-spl.bin"

#
# RCW
#
RCW_BINARY = "${RCW_BINARY_EMMC_BOOT}"

#
# Machine/distro features
#
MACHINE_FEATURES += "swupdate-factory"

#
# Image
#

# Initramfs (used for factory installation image)
INITRAMFS_IMAGE = "tanowrt-image-initramfs-swu-factory"
INITRAMFS_IMAGE_NAME = "${INITRAMFS_IMAGE}-${MACHINE}"
INITRAMFS_IMAGE_BUNDLE = "0"

#
# SWUPDATE
#
SWU_BOARD = "ls1028ardb-emmc"
SWU_REVISION = "1.0"

SWU_IMAGE_MEDIA_TYPE = "eMMC"
SWU_IMAGE_MMCDEV = "/dev/mmcblk1"

# Extra dependencies for factory installation script
SWU_INSTALL_EXTRA_RDEPENDS += "parted mmc-utils"

SWU_IMAGE_ARTIFACT_uboot[fname] = "u-boot-${MACHINE}"
SWU_IMAGE_ARTIFACT_uboot[ftype] = "bin-emmc-defconfig"

#
# Factory image
#
SWU_FACTORY_WKS_FILE ?= "sdimage-ls1028ardb-swu-factory.wks.in"
SWU_FACTORY_EXTRA_DEPENDS += "\
	u-boot-startup-script:do_deploy \
	virtual/bootloader:do_deploy \
	virtual/kernel:do_deploy \
	rcw:do_deploy \
	dp-firmware-cadence:do_deploy \
	ppa:do_deploy \
"

SWU_FACTORY_EXTRA_FILES = "\
	u-boot-initial-env-emmc-defconfig.bin;u-boot-initial-env.bin \
	${RCW_BINARY};rcw.bin \
"

# These variables are used in sdimage-ls1028ardb-swu-factory.wks.in
WKS_FACTORY_IMAGE_DPFW_BINARY = "${WKS_IMAGE_DPFW_BINARY}"
WKS_FACTORY_IMAGE_PPAFW_BINARY = "${WKS_IMAGE_PPAFW_BINARY}"

WKS_FACTORY_IMAGE_UBOOT_BINARY = "u-boot-${MACHINE}.bin-sdcard-defconfig"
WKS_FACTORY_IMAGE_STARTUP_BINARY = "startup-factory-${MACHINE}.img"
WKS_FACTORY_IMAGE_UBOOT_INITIAL_ENV_BINARY = "u-boot-initial-env-${MACHINE}-sdcard-defconfig.bin"
WKS_FACTORY_IMAGE_RCW_BINARY = "rcw/ls1028ardb/R_SQPH_0x85be/rcw_1300_sdboot.bin"
WKS_FACTORY_IMAGE_KERNEL_BINARY = "fitImage-${INITRAMFS_IMAGE}-${MACHINE}.ext4"

#
# Other
#

# Do not need auto overlay resizing for eMMC
TANOWRT_ENABLE_OVERLAY_RESIZE = "0"
```
