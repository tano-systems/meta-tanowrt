## meta-tanowrt-hsl-ti/conf/machine/include/am335x-evm.inc
```bitbake
#
# SPDX-License-Identifier: MIT
# Copyright (c) 2020 Tano Systems LLC. All rights reserved.
#

MACHINEOVERRIDES =. "am335x-evm:"

#
# CPU
#
require conf/machine/include/tano-am335x.inc

#
# Graphics
#
PREFERRED_PROVIDER_virtual/xserver = "xserver-xorg"

# For built-in LCD, add xf86-input-tslib
XSERVER = "xserver-xorg \
           xf86-input-evdev \
           xf86-input-mouse \
           xf86-video-fbdev \
           xf86-input-keyboard"

# Default to external video, change to smallscreen for built-in LCD
MACHINE_GUI_CLASS = "bigscreen"

#
# Image
#

# Remove /boot directory from image
ROOTFS_RM_BOOT_DIR_DISABLE = "0"
ROOTFS_RM_BOOT_DIR_KEEP_DTB = "0"

# Install device tree files
IMAGE_INSTALL_append = " kernel-devicetree "

#
# Kernel
#

# Can be 5.4 or 5.10
TI_STAGING_KERNEL_VERSION ?= "5.4"

# Set to "1" for kernels 5.6+
TANOWRT_WIREGUARD_IN_KERNEL = "0"

PREFERRED_PROVIDER_virtual/kernel = "${@oe.utils.conditional('TANOWRT_HSL_TI_SDK_KERNEL', '1', 'linux-tano-ti-sdk-rt', 'linux-tano-ti-staging-rt', d)}"
PREFERRED_VERSION_linux-tano-ti-staging-rt = "${TI_STAGING_KERNEL_VERSION}%"
PREFERRED_VERSION_linux-tano-ti-sdk-rt = "4.19%"
LINUXLIBCVERSION = "${@oe.utils.conditional('TANOWRT_HSL_TI_SDK_KERNEL', '1', 'ti-4.19%', 'ti-${TI_STAGING_KERNEL_VERSION}%', d)}"
SDKLINUXLIBCVERSION = "${@oe.utils.conditional('TANOWRT_HSL_TI_SDK_KERNEL', '1', 'ti-4.19%', 'ti-${TI_STAGING_KERNEL_VERSION}%', d)}"
PREFERRED_VERSION_xtables-addons = "${@oe.utils.conditional('TANOWRT_HSL_TI_SDK_KERNEL', '1', '3.3', '3.13', d)}"

#
# Bootloader
#
PREFERRED_PROVIDER_virtual/bootloader = "u-boot-ti-staging"
PREFERRED_PROVIDER_virtual/bootloader_beaglebone-black = "u-boot-ti-staging"
PREFERRED_PROVIDER_u-boot = "u-boot-ti-staging"
PREFERRED_PROVIDER_u-boot_beaglebone-black = "u-boot-ti-staging"
PREFERRED_VERSION_u-boot-ti-staging = "2020.01%"

UBOOT_ARCH = "arm"
UBOOT_ENTRYPOINT = "0x80008000"
UBOOT_LOADADDRESS = "0x80008000"
UBOOT_MACHINE = "am335x_evm_defconfig"

EXTRA_IMAGEDEPENDS += "u-boot"

#
# QEMU options (runqemu)
#

# No qemu support, yet
MACHINE_FEATURES_remove = "qemu-usermode"
QEMU_TARGETS = "arm"
```

## meta-tanowrt-hsl-ti/conf/machine/include/am574x-idk.inc
```bitbake
#
# SPDX-License-Identifier: MIT
# Copyright (c) 2020 Tano Systems LLC. All rights reserved.
#

require conf/machine/include/am574x-evm.inc

#
# Machine/distro features
#
MACHINEOVERRIDES =. "am574x-idk:"

MACHINE_FEATURES = "\
	apm usbgadget usbhost vfat ext2 ext4 screen \
	touchscreen graphics gpu mmip dsp gc320 pci \
	sgx ethernet cgroup lldp stp watchdog \
	mbusgw crypto swupdate \
"

MACHINE_EXTRA_RDEPENDS += "\
	${@bb.utils.contains('MACHINE_FEATURES', 'mmip', 'ipumm-fw', '', d)} \
	ffmpeg \
"

# Enable tty1
PROCD_ENABLED_TTYS ?= "1"

#
# Graphics
#
MACHINE_GUI_CLASS = "smallscreen"

#
# Kernel
#
ENABLE_TI_UIO_DEVICES ?= "0"

KERNEL_IMAGETYPE = "fitImage"
KERNEL_CLASSES = "kernel-tn-fitimage kernel-tn-mkimage"
KERNEL_MKIMAGE_TYPES = "ext4"
KERNEL_DEVICETREE = " \
	am57xx-evm.dtb \
	am57xx-beagle-x15.dtb \
	am57xx-beagle-x15-revb1.dtb \
	am57xx-beagle-x15-revc.dtb \
	am571x-idk.dtb \
	am572x-idk.dtb \
	am574x-idk.dtb \
"

KERNEL_DEVICETREE += "${@oe.utils.conditional('ENABLE_TI_UIO_DEVICES', '1', 'am574x-idk-pru-excl-uio.dtb am572x-idk-pru-excl-uio.dtb am571x-idk-pru-excl-uio.dtb', '', d)}"

SERIAL_CONSOLES = "115200;ttyS2"

# Use SDK kernel
TANOWRT_HSL_TI_SDK_KERNEL ?= "1"

#
# Bootloader
#
UBOOT_MACHINE = "am57xx_evm_defconfig"

UBOOT_DTB_LOADADDRESS  = "0x87e00000"
UBOOT_DTBO_LOADADDRESS = "0x87f00000"
UBOOT_DTBO_OFFSET      = "0x00010000"
UBOOT_RD_LOADADDRESS   = "0x84000000"
UBOOT_RD_ENTRYPOINT    = "0x84000000"

UBOOT_ENV_SIZE      = "0x20000"
UBOOT_ENV_REDUNDANT = "1"

UBOOT_SPL_MULTIPLE_COUNT_SD = "3"
UBOOT_SPL_MULTIPLE_COUNT_EMMC = "4"

UBOOT_SPL_MULTIPLE = "1"
UBOOT_SPL_MULTIPLE_COUNT = "${UBOOT_SPL_MULTIPLE_COUNT_SD} ${UBOOT_SPL_MULTIPLE_COUNT_EMMC}"
UBOOT_SPL_MULTIPLE_BLOCK_SIZE = "131072"

UBOOT_INITIAL_ENV = "u-boot-initial-env"

#
# Image
#
ROOTFS_IMAGE_FSTYPE = "squashfs-lzo"

IMAGE_FSTYPES = "${ROOTFS_IMAGE_FSTYPE}"

PACKAGECONFIG:append:pn-fstools = " ovl-f2fs ovl-rootdisk-part "

IMAGE_FEATURES += "splash"
SPLASH = "psplash"

IMAGE_FEATURES:remove = "modem"

#
# SWUPDATE
#
SWU_BOOTLOADER = "uboot"
SWU_OVERLAY_CONTAINER = "blkdev"
SWU_OVERLAY_FS = "ext4"

require ${TANOWRT_HSL_BASE}/conf/machine/include/swu-ti-common.inc

#
# OpenWrt specific
#
OPENWRT_VERSION_PRODUCT = "AM574x IDK EVM"
OPENWRT_VERSION_HWREV = "${SWU_REVISION}"

#
# Other
#

# Refine the list of device targets for ti-pdk class recipes
# Set the list of device targets for ti-pdk class recipes
TI_PDK_LIMIT_SOCS = "am571x am572x am574x"
TI_PDK_LIMIT_BOARDS = "evmAM571x evmAM572x idkAM571x idkAM572x idkAM574x"
```

## meta-tanowrt-hsl-ti/conf/machine/include/swu-ti-common.inc
```bitbake
#
# SPDX-License-Identifier: MIT
# Copyright (c) 2021 Tano Systems LLC. All rights reserved.
#

SWU_IMAGE_MMCDEV ?= "/dev/mmcblk0"
SWU_IMAGE_MEDIA_TYPE ?= "SD Card"

SWU_IMAGE_EXTRA_ARTIFACTS += "kernel uboot spl startup"

SWU_IMAGE_ARTIFACT_rootfs[sw-desc-type] = "raw"
SWU_IMAGE_ARTIFACT_rootfs[sw-desc-device-a] = "${SWU_IMAGE_MMCDEV}p2"
SWU_IMAGE_ARTIFACT_rootfs[sw-desc-device-b] = "${SWU_IMAGE_MMCDEV}p4"

SWU_IMAGE_ARTIFACT_kernel[fname] = "fitImage"
SWU_IMAGE_ARTIFACT_kernel[ftype] = "ext4"
SWU_IMAGE_ARTIFACT_kernel[depends] = "virtual/kernel:do_deploy"
SWU_IMAGE_ARTIFACT_kernel[verextract] = "1"
SWU_IMAGE_ARTIFACT_kernel[verextract-cmd] = "strings"
SWU_IMAGE_ARTIFACT_kernel[verextract-filter-cmd] = "grep -e 'U-Boot fitImage for TanoWrt/.*/${MACHINE}' | awk -F '/' '{ print $2 }'"
SWU_IMAGE_ARTIFACT_kernel[sw-desc-type] = "raw"
SWU_IMAGE_ARTIFACT_kernel[sw-desc-device-a] = "${SWU_IMAGE_MMCDEV}p1"
SWU_IMAGE_ARTIFACT_kernel[sw-desc-device-b] = "${SWU_IMAGE_MMCDEV}p3"

SWU_IMAGE_ARTIFACT_spl[fname] = "MLO-x${UBOOT_SPL_MULTIPLE_COUNT}"
SWU_IMAGE_ARTIFACT_spl[ftype] = ""
SWU_IMAGE_ARTIFACT_spl[depends] = "virtual/bootloader:do_deploy"
SWU_IMAGE_ARTIFACT_spl[sw-desc-type] = "raw"
SWU_IMAGE_ARTIFACT_spl[sw-desc-device] = "${SWU_IMAGE_MMCDEV}"
SWU_IMAGE_ARTIFACT_spl[sw-desc-offset] = "131072"

SWU_IMAGE_ARTIFACT_uboot[fname] = "u-boot-${MACHINE}"
SWU_IMAGE_ARTIFACT_uboot[ftype] = "img"
SWU_IMAGE_ARTIFACT_uboot[depends] = "virtual/bootloader:do_deploy"
SWU_IMAGE_ARTIFACT_uboot[verextract] = "1"
SWU_IMAGE_ARTIFACT_uboot[verextract-cmd] = "strings"
SWU_IMAGE_ARTIFACT_uboot[verextract-filter-cmd] = "grep -m 2 'U-Boot 20' | tail -n1 | awk '{print $2}'"
SWU_IMAGE_ARTIFACT_uboot[sw-desc-type] = "raw"
SWU_IMAGE_ARTIFACT_uboot[sw-desc-device] = "${SWU_IMAGE_MMCDEV}"
SWU_IMAGE_ARTIFACT_uboot[sw-desc-offset] = "524288"

SWU_IMAGE_ARTIFACT_startup[fname] = "startup"
SWU_IMAGE_ARTIFACT_startup[ftype] = "img"
SWU_IMAGE_ARTIFACT_startup[depends] = "u-boot-startup-script:do_deploy"
SWU_IMAGE_ARTIFACT_startup[verextract] = "1"
SWU_IMAGE_ARTIFACT_startup[verextract-input] = "${DEPLOY_DIR_IMAGE}/startup-${MACHINE}.img.version"
SWU_IMAGE_ARTIFACT_startup[sw-desc-type] = "raw"
SWU_IMAGE_ARTIFACT_startup[sw-desc-device] = "${SWU_IMAGE_MMCDEV}"
SWU_IMAGE_ARTIFACT_startup[sw-desc-offset] = "2621440"
```

## meta-tanowrt-hsl-ti/conf/machine/include/tano-am335x.inc
```bitbake
#
# SPDX-License-Identifier: MIT
# Copyright (c) 2020 Tano Systems LLC. All rights reserved.
#
require conf/machine/include/ti-soc.inc
SOC_FAMILY:append = ":ti33x"
DEFAULTTUNE ?= "cortexa8thf-neon"

require conf/machine/include/arm/armv7a/tune-cortexa8.inc

# RTC hwclock parameters
OPENWRT_HWCLOCK_DEV       = "/dev/rtc0"
OPENWRT_HWCLOCK_LOCALTIME = "1"

PREFERRED_PROVIDER_virtual/egl = "ti-sgx-ddk-um"
PREFERRED_PROVIDER_virtual/libgles1 = "ti-sgx-ddk-um"
PREFERRED_PROVIDER_virtual/libgles2 = "ti-sgx-ddk-um"
PREFERRED_PROVIDER_libgbm = "libgbm"
PREFERRED_PROVIDER_libgbm-dev = "libgbm-dev"

PREFERRED_PROVIDER_virtual/libgl = "mesa-gl"

MACHINE_FEATURES:append = " hwrng "
MACHINE_FEATURES:append = " gpu "
```

## meta-tanowrt-hsl-ti/conf/machine/include/tano-am574x.inc
```bitbake
#
# SPDX-License-Identifier: MIT
# Copyright (c) 2020 Tano Systems LLC. All rights reserved.
#
require conf/machine/include/ti-soc.inc
SOC_FAMILY:append = ":omap-a15"

DEFAULTTUNE ?= "armv7athf-neon"
require conf/machine/include/arm/armv7a/tune-cortexa15.inc

SOC_FAMILY:append = ":dra7xx"

# RTC hwclock parameters
OPENWRT_HWCLOCK_DEV       = "/dev/rtc0"
OPENWRT_HWCLOCK_LOCALTIME = "1"

PREFERRED_PROVIDER_virtual/egl = "ti-sgx-ddk-um"
PREFERRED_PROVIDER_virtual/libgles1 = "ti-sgx-ddk-um"
PREFERRED_PROVIDER_virtual/libgles2 = "ti-sgx-ddk-um"
PREFERRED_PROVIDER_libgbm = "libgbm"
PREFERRED_PROVIDER_libgbm-dev = "libgbm-dev"

PREFERRED_PROVIDER_virtual/libgl = "mesa-gl"

MACHINE_FEATURES:append = " hwrng "
MACHINE_FEATURES:append = " gpu "
```

## meta-tanowrt-hsl-ti/recipes-bsp/u-boot/u-boot-ti-staging/am335x-bbb/am335x_bbb_sdcard_defconfig
```kconfig
CONFIG_ARM=y
CONFIG_ARCH_CPU_INIT=y
CONFIG_ARCH_OMAP2PLUS=y
CONFIG_TI_COMMON_CMD_OPTIONS=y
CONFIG_AM33XX=y
CONFIG_SPL=y
CONFIG_DISTRO_DEFAULTS=y
CONFIG_SPL_LOAD_FIT=y
CONFIG_OF_BOARD_SETUP=y
CONFIG_BOOTCOMMAND="mmc dev 0; mmc read ${scriptaddr} 0x1400 0x100; source ${scriptaddr}"
CONFIG_LOGLEVEL=3
CONFIG_SYS_CONSOLE_INFO_QUIET=y
CONFIG_VERSION_VARIABLE=y
CONFIG_ARCH_MISC_INIT=y
CONFIG_SPL_FIT_IMAGE_TINY=y
# CONFIG_SPL_ETH_SUPPORT is not set
# CONFIG_SPL_FS_EXT4 is not set
# CONFIG_SPL_MTD_SUPPORT is not set
# CONFIG_SPL_MUSB_NEW_SUPPORT is not set
# CONFIG_SPL_NET_SUPPORT is not set
# CONFIG_SPL_NET_VCI_STRING is not set
# CONFIG_SPL_OS_BOOT is not set
# CONFIG_SPL_USB_GADGET is not set
# CONFIG_SPL_USB_ETHER is not set
CONFIG_CMD_SPL=y
# CONFIG_CMD_FLASH is not set
# CONFIG_SPL_EFI_PARTITION is not set
CONFIG_OF_CONTROL=y
CONFIG_DEFAULT_DEVICE_TREE="am335x-evm"
CONFIG_OF_LIST="am335x-evm am335x-bone am335x-boneblack am335x-evmsk am335x-bonegreen am335x-icev2 am335x-pocketbeagle"
CONFIG_SYS_RELOC_GD_ENV_ADDR=y
CONFIG_ENV_VARS_UBOOT_RUNTIME_CONFIG=y
CONFIG_CLK=y
CONFIG_CLK_CDCE9XX=y
CONFIG_USB_FUNCTION_FASTBOOT=y
CONFIG_DM_I2C=y
CONFIG_MISC=y
CONFIG_DM_MMC=y
# CONFIG_MMC_HW_PARTITIONING is not set
CONFIG_MMC_OMAP_HS=y
CONFIG_DM_SPI_FLASH=y
CONFIG_SF_DEFAULT_SPEED=24000000
CONFIG_SPI_FLASH_WINBOND=y
CONFIG_DM_ETH=y
CONFIG_MII=y
CONFIG_DRIVER_TI_CPSW=y
CONFIG_SPI=y
CONFIG_DM_SPI=y
CONFIG_OMAP3_SPI=y
CONFIG_TIMER=y
CONFIG_OMAP_TIMER=y
CONFIG_USB=y
CONFIG_DM_USB=y
CONFIG_DM_USB_GADGET=y
# CONFIG_SPL_DM_USB_GADGET is not set
CONFIG_USB_MUSB_HOST=y
CONFIG_USB_MUSB_GADGET=y
CONFIG_USB_MUSB_TI=y
CONFIG_USB_GADGET=y
CONFIG_USB_GADGET_MANUFACTURER="Texas Instruments"
CONFIG_USB_GADGET_VENDOR_NUM=0x0451
CONFIG_USB_GADGET_PRODUCT_NUM=0xd022
CONFIG_USB_ETHER=y
CONFIG_WDT=y
# CONFIG_SPL_WDT is not set
CONFIG_DYNAMIC_CRC_TABLE=y
CONFIG_RSA=y
CONFIG_LZO=y
# CONFIG_OF_LIBFDT_OVERLAY is not set

# CONFIG_SPL_NAND_SUPPORT is not set
# CONFIG_SPL_FS_FAT is not set
# CONFIG_SPL_DM_USB is not set
CONFIG_SPL_FIT=y
# CONFIG_SPL_DM_USB_GADGET is not set
# CONFIG_SPL_ENV_SUPPORT is not set

CONFIG_EFI_PARTITION=y
CONFIG_CMD_SETEXPR=y
CONFIG_CMD_SOURCE=y
CONFIG_ENV_SIZE=0x20000
CONFIG_FIT=y
CONFIG_FIT_VERBOSE=y

CONFIG_ENV_IS_IN_MMC=y
# CONFIG_ENV_IS_IN_FAT is not set
CONFIG_ENV_OFFSET=0x2c0000
CONFIG_ENV_OFFSET_REDUND=0x2e0000
CONFIG_SYS_REDUNDAND_ENVIRONMENT=y

CONFIG_SYS_MMCSD_RAW_MODE_U_BOOT_USE_SECTOR=y
CONFIG_SYS_MMCSD_RAW_MODE_U_BOOT_SECTOR=0x400

# CONFIG_BOOTCOUNT_LIMIT is not set
# CONFIG_BOOTCOUNT_ENV is not set
# CONFIG_CMD_SPL_NAND_OFS is not set
# CONFIG_CMD_NAND is not set
# CONFIG_CMD_MTDPARTS is not set
# CONFIG_MTDIDS_DEFAULT is not set
# CONFIG_MTDPARTS_DEFAULT is not set
# CONFIG_DFU_NAND is not set
# CONFIG_DFU_MMC is not set
# CONFIG_DFU_RAM is not set
# CONFIG_MTD is not set
# CONFIG_MTD_RAW_NAND is not set
# CONFIG_SPL_OS_BOOT is not set
```

## meta-tanowrt-hsl-ti/recipes-bsp/u-boot/u-boot-ti-staging/am574x-idk/am574x_idk_emmc_defconfig
```kconfig
CONFIG_ARM=y
CONFIG_ARCH_OMAP2PLUS=y
CONFIG_TI_COMMON_CMD_OPTIONS=y
CONFIG_SYS_MALLOC_F_LEN=0x2000
CONFIG_OMAP54XX=y
CONFIG_TARGET_AM57XX_EVM=y
CONFIG_DRA7_DSPEVE_OPP_HIGH=y
CONFIG_DRA7_IVA_OPP_HIGH=y
CONFIG_DRA7_GPU_OPP_HIGH=y
CONFIG_SPL=y
CONFIG_SPL_SPI_FLASH_SUPPORT=y
CONFIG_SPL_SPI_SUPPORT=y
CONFIG_ARMV7_LPAE=y
CONFIG_AHCI=y
CONFIG_DISTRO_DEFAULTS=y
CONFIG_NR_DRAM_BANKS=2
# CONFIG_SPL_LOAD_FIT is not set
CONFIG_OF_BOARD_SETUP=y
# CONFIG_USE_BOOTARGS is not set
CONFIG_USE_BOOTCOMMAND=y
CONFIG_BOOTCOMMAND="sf probe; sf read ${scriptaddr} 0x380000 0x40000; source ${scriptaddr}"
CONFIG_SYS_CONSOLE_INFO_QUIET=y
# CONFIG_MISC_INIT_R is not set
CONFIG_VERSION_VARIABLE=y
CONFIG_BOARD_EARLY_INIT_F=y
CONFIG_SPL_SYS_MALLOC_SIMPLE=y
CONFIG_SPL_SEPARATE_BSS=y
CONFIG_SPL_DMA_SUPPORT=y
# CONFIG_SPL_NAND_SUPPORT is not set
CONFIG_SPL_OS_BOOT=y
CONFIG_SPL_SPI_LOAD=y
CONFIG_SPL_YMODEM_SUPPORT=y
CONFIG_CMD_SPL=y
CONFIG_CMD_SF=y
CONFIG_CMD_SOURCE=y
CONFIG_CMD_SETEXPR=y
# CONFIG_CMD_FLASH is not set
# CONFIG_CMD_PMIC is not set
# CONFIG_CMD_UBIFS is not set
CONFIG_OF_CONTROL=y
CONFIG_SPL_OF_CONTROL=y
CONFIG_DEFAULT_DEVICE_TREE="am574x-idk"
CONFIG_OF_LIST="am57xx-beagle-x15 am57xx-beagle-x15-revb1 am57xx-beagle-x15-revc am572x-idk am571x-idk am574x-idk"
CONFIG_ENV_VARS_UBOOT_RUNTIME_CONFIG=y
CONFIG_DM=y
CONFIG_SPL_DM=y
CONFIG_SPL_DM_SEQ_ALIAS=y
CONFIG_DWC_AHCI=y
CONFIG_SYSCON=y
CONFIG_SPL_REGMAP=y
CONFIG_SPL_SYSCON=y
CONFIG_SPL_OF_TRANSLATE=y
# CONFIG_DFU_MMC is not set
# CONFIG_DFU_RAM is not set
# CONFIG_DFU_SF is not set
# CONFIG_USB_FUNCTION_FASTBOOT is not set
# CONFIG_FASTBOOT_BUF_ADDR is not set
# CONFIG_FASTBOOT_BUF_SIZE is not set
# CONFIG_FASTBOOT_USB_DEV is not set
# CONFIG_FASTBOOT_FLASH is not set
# CONFIG_FASTBOOT_FLASH_MMC_DEV is not set
# CONFIG_FASTBOOT_CMD_OEM_FORMAT is not set
CONFIG_DM_GPIO=y
CONFIG_DM_I2C=y
CONFIG_MISC=y
CONFIG_DM_MMC=y
CONFIG_MMC_OMAP_HS=y
CONFIG_DM_SPI_FLASH=y
CONFIG_SPI_FLASH=y
CONFIG_SPI_FLASH_SPANSION=y
CONFIG_SPI_FLASH_MTD=y
CONFIG_SPL_SPI_FLASH_TINY=y
CONFIG_PHY_MICREL=y
CONFIG_PHY_MICREL_KSZ90X1=y
CONFIG_DM_ETH=y
CONFIG_MII=y
CONFIG_DRIVER_TI_CPSW=y
CONFIG_PHY=y
CONFIG_PIPE3_PHY=y
CONFIG_OMAP_USB2_PHY=y
CONFIG_DM_PMIC=y
CONFIG_PMIC_PALMAS=y
CONFIG_DM_REGULATOR=y
CONFIG_DM_REGULATOR_PALMAS=y
CONFIG_DM_SCSI=y
CONFIG_DM_SERIAL=y
CONFIG_SPI=y
CONFIG_DM_SPI=y
CONFIG_TI_QSPI=y
# CONFIG_TI_EDMA3 is not set
# CONFIG_DMA is not set
CONFIG_USB=y
CONFIG_DM_USB=y
CONFIG_DM_USB_GADGET=y
CONFIG_SPL_DM_USB_GADGET=y
CONFIG_USB_XHCI_HCD=y
CONFIG_USB_XHCI_DWC3=y
CONFIG_USB_DWC3=y
CONFIG_USB_DWC3_GADGET=y
CONFIG_USB_DWC3_GENERIC=y
CONFIG_USB_GADGET=y
CONFIG_USB_GADGET_MANUFACTURER="Texas Instruments"
CONFIG_USB_GADGET_VENDOR_NUM=0x0451
CONFIG_USB_GADGET_PRODUCT_NUM=0xd022

CONFIG_ENV_IS_IN_SPI_FLASH=y
# CONFIG_ENV_IS_IN_FAT is not set
CONFIG_ENV_SIZE=0x20000
CONFIG_ENV_OFFSET=0x3c0000
CONFIG_ENV_OFFSET_REDUND=0x3e0000
CONFIG_ENV_SECT_SIZE=0x10000
CONFIG_SYS_REDUNDAND_ENVIRONMENT=y

CONFIG_MTD=y
CONFIG_MTD_PARTITIONS=y
# CONFIG_SPL_MTD_SUPPORT is not set

# CONFIG_SPL_OS_BOOT is not set
# CONFIG_SPL_ENV_SUPPORT is not set
CONFIG_SYS_SPI_U_BOOT_OFFS=0x80000

CONFIG_NOR_BOOT=y
```

## meta-tanowrt-hsl-ti/wic/sdimage-am335x.wks
```
#
# short-description: Create SD card image with a boot partition
#
# long-description: Creates a partitioned SD card image:
#   - before partition 0: u-boot environment (128k + 128k redundant)
#   - partition 0: vfat partition with boot files
#   - partition 1: root filesystem
#
part   --ondisk mmcblk0 --source empty --align 128 --size 256k --no-table
part   --ondisk mmcblk0 --source bootimg-partition --fstype=vfat --label boot --active --align 1024 --fixed-size 16384k
part / --ondisk mmcblk0 --source rootfs --fstype=squashfs --align 1024

#bootloader --ptable msdos
```
