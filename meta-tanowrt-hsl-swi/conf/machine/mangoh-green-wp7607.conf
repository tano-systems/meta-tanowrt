## meta-tanowrt/conf/distro/include/tanowrt-mirrors.inc
```bitbake
#
# SPDX-License-Identifier: MIT
# Copyright (c) 2018-2020 Tano Systems LLC. All rights reserved.
#

GIT_OPENWRT_ORG = "git.openwrt.org"

#
# Official and non-official mirrors on GitHub for some OpenWrt repositories (git.openwrt.org)
# * [official]     git://github.com/openwrt/
# * [non-official] git://github.com/git-openwrt-org-mirror/
#
MIRRORS_prepend = "\
	git://${GIT_OPENWRT_ORG}/openwrt/openwrt.git  git://github.com/openwrt/openwrt.git \n\
	git://${GIT_OPENWRT_ORG}/project/luci.git     git://github.com/openwrt/luci.git \n\
	git://${GIT_OPENWRT_ORG}/(.*)/(.*)            git://github.com/git-openwrt-org-mirror/BASENAME \n\
	gitsm://${GIT_OPENWRT_ORG}/(.*)/(.*)          gitsm://github.com/git-openwrt-org-mirror/BASENAME \n\
	https://${GIT_OPENWRT_ORG}/(.*)/(.*)          https://github.com/git-openwrt-org-mirror/BASENAME \n\
"

MIRRORS_prepend = "\
	https://${SOURCEFORGE_MIRROR}/.* https://netcologne.dl.sourceforge.net/PATH \
"
```

## meta-tanowrt/conf/distro/include/tanowrt-packageconfig.inc
```bitbake
#
# SPDX-License-Identifier: MIT
# Copyright (c) 2018-2020 Tano Systems LLC. All rights reserved.
#

PACKAGECONFIG:pn-libwebsockets = "\
	client \
	server \
	ssl \
	libuv \
	${@bb.utils.filter('DISTRO_FEATURES', 'ipv6', d)} \
"

# Remove ICU dependency for xerces-c
PACKAGECONFIG:remove:pn-xerces-c = "icu"

# Prefer OpenSSL over GnuTLS for curl due to TSU exemptions
PACKAGECONFIG:pn-curl = "${@bb.utils.contains('DISTRO_FEATURES', 'ipv6', 'ipv6', '', d)} ssl zlib"

PACKAGECONFIG:pn-nano = "tiny"

# Enable UI and scripting for perf
PERF_FEATURES_ENABLE ?= "perf-scripting perf-tui"
```

## meta-tanowrt/conf/distro/include/tanowrt-prefs.inc
```bitbake
# Set preferred Qt5 versions. Different namespace from Qt4, so no conflict
include conf/distro/include/qt5-versions.inc

# Versions
PREFERRED_VERSION_iptables = "1.6.2"
PREFERRED_VERSION_usbutils = "007"
PREFERRED_VERSION_libwebsockets = "3.2%"
PREFERRED_VERSION_qrencode = "4.1.1"
PREFERRED_VERSION_rrdtool = "1.0.50"
PREFERRED_VERSION_collectd = "5.11.0"

# Providers
PREFERRED_PROVIDER_psplash = "psplash-tn"
PREFERRED_PROVIDER_os-release = "tano-version"
PREFERRED_PROVIDER_jpeg = "libjpeg-turbo"
```

## meta-tanowrt/conf/distro/include/tanowrt-repairs.inc
```bitbake
#
# SPDX-License-Identifier: MIT
# Copyright (c) 2018-2020, 2022 Tano Systems LLC. All rights reserved.
#

#
# Repairs for "No recipes available for" warnings
#

# Hide bootchart2 recipe from oe layer
BBMASK += "bootchart2_0.14.9.bb"

# Hide hostpad and wpa-supplicant
BBMASK += "recipes-connectivity/hostapd/"
BBMASK += "recipes-connectivity/wpa-supplicant/"
```

## meta-tanowrt/conf/distro/include/tanowrt-sdk.inc
```bitbake
#
# SPDX-License-Identifier: MIT
# Copyright (c) 2018-2022 Tano Systems LLC. All rights reserved.
#

# SDK paths and names
SDK_NAME_PREFIX = "tanowrt"
SDK_VERSION = "${DISTRO_VERSION}"
SDK_VENDOR = "-tano"
SDK_NAME = "${SDK_NAME_PREFIX}-${SDKMACHINE}-${IMAGE_BASENAME}-${TUNE_PKGARCH}-${MACHINE}"
SDK_INCLUDE_NATIVESDK = "1"

SDKPATH_PREFIX_DEFAULT ?= "tanowrt"
SDKPATH_PREFIX ?= "${SDKPATH_PREFIX_DEFAULT}"
SDKPATH_REAL ?= "/usr/local/${SDK_NAME_PREFIX}-${SDK_VERSION}"
SDKPATH ?= "/opt/tanowrt/${SDKPATH_PREFIX}"
SDKPATHINSTALL ?= "${SDKPATH}"
```

## meta-tanowrt/conf/distro/include/tanowrt-swupdate.inc
```bitbake
#
# SPDX-License-Identifier: MIT
# Copyright (c) 2021 Tano Systems LLC. All rights reserved.
#
# SWUPDATE configuration defaults
#

SWU_VERBOSE ?= "1"
SWU_SYSLOG ?= "0"
SWU_UBI_MTD_BLACKLIST ?= ""
SWU_LOGLEVEL ?= "3"
SWU_HOOKCMD ?= "/usr/lib/swupdate/swupdate_hook.sh"

SWU_SW_VERSIONS_FILE_TMP ?= "/tmp/sw-versions"

SWU_HW_COMPATIBILITY ?= ""${SWU_REVISION}""

SWU_SYSTEM_A_PART ?= "system_a"
SWU_SYSTEM_A_SELECTION ?= "tanowrt,system-a"

SWU_SYSTEM_B_PART ?= "system_b"
SWU_SYSTEM_B_SELECTION ?= "tanowrt,system-b"

SWU_BOOTLOADER_TRANSACTION_MARKER ?= "0"

SWU_SURICATTA ?= "0"

SWU_CONF ?= "${sysconfdir}/swupdate.conf"
```

## meta-tanowrt/conf/distro/include/tanowrt.inc
```bitbake
#
# SPDX-License-Identifier: MIT
# Copyright (c) 2018-2020 Tano Systems LLC. All rights reserved.
#

require conf/distro/include/tanowrt-toolchain.inc
require conf/distro/include/tanowrt-sdk.inc

IMAGE_CLASSES += "tanowrt-image-types"

# Required for rrdtool 1.0.50
HOSTTOOLS += "pod2man"

# Virtual runtimes
VIRTUAL-RUNTIME_dev_manager = "udev"
VIRTUAL-RUNTIME_login_manager = "busybox"
VIRTUAL-RUNTIME_init_manager = "procd"
VIRTUAL-RUNTIME_kmod_manager = "ubox"
VIRTUAL-RUNTIME_syslog = "rsyslog"
VIRTUAL-RUNTIME_base-utils = "busybox"
VIRTUAL-RUNTIME_network_manager = "netifd"

# Start with default set of distro features
DISTRO_FEATURES = "${DISTRO_FEATURES_DEFAULT} ${DISTRO_FEATURES_LIBC}"

DISTRO_FEATURES:append = " swupdate "

# Set procd as init manager
DISTRO_FEATURES:append = " procd "

# Enable cgroups support
DISTRO_FEATURES:append = " cgroup "

# Seccomp support
DISTRO_FEATURES:append = " seccomp "

# Enable wifi support
DISTRO_FEATURES:append = " wifi "

# Enable watchdog support
DISTRO_FEATURES:append = " watchdog "

# Graphics
DISTRO_FEATURES:append = " graphics screen splash opengl wayland "

# IPv6
DISTRO_FEATURES:append = " ipv6"

# Remove sysvinit and systemd from DISTRO_FEATURES
DISTRO_FEATURES_BACKFILL_CONSIDERED:append = " sysvinit systemd"

# Clean DISTRO_FEATURES
DISTRO_FEATURES:remove = "\
    3g \
    nfc \
    pulseaudio \
    bluetooth \
    irda \
    pcmcia \
    bluez5 \
    largefile \
    sysvinit \
    systemd \
    pam \
    x11 \
"

# Licenses
LICENSE_FLAGS_WHITELIST = "commercial_gst-ffmpeg commercial_gstreamer1.0-libav commercial"

# Image
IMAGE_FSTYPES:remove = "tar.xz.md5"

# Root home path
ROOT_HOME ??= "/root"

# Set preferred Qt version
QT_PROVIDER ?= "qt5"

require conf/distro/include/tanowrt-packageconfig.inc
require conf/distro/include/tanowrt-prefs.inc
require conf/distro/include/tanowrt-repairs.inc
require conf/distro/include/tanowrt-mirrors.inc
require conf/distro/include/tanowrt-swupdate.inc

# Unbreak multimachine builds
LICENSE_DIRECTORY = "${DEPLOY_DIR}/licenses/${MACHINE_ARCH}"

# Distro maintainer
MAINTAINER = "TanoWrt Developers <https://github.com/tano-systems/meta-tanowrt>"

DISTRO_EXTRA_RRECOMMENDS += "openssh-sftp-server"

# Enable cryptodev/devcrypto engine in OpenSSL
PACKAGECONFIG:append:pn-openssl = " cryptodev-linux"

INHERIT += "do-populate-lic-deps"

INHERIT += "tanowrt-paths"

#
# QEMU
#
QEMU_TARGETS = "arm aarch64 i386 x86_64"

#
# Dynamic includes
#
include conf/distro/include/tanowrt-hw.inc
```
