## meta-tanowrt-hsl-swi/conf/machine/mangoh-green-wp7607.conf
```bitbake
#@TYPE: Machine
#@NAME: mangOH Green with WP7607 (WP7607-1)
#@DESCRIPTION: Machine configuration for the mangOH Green with WP7607 (WP7607-1)

# meta-swi/meta-swi-mdm9x28/
require conf/machine/include/tano-swi-mdm9x28-wp.inc

#
# Image
#
IMAGE_FEATURES_remove = "openvpn ddns"

#
# Kernel
#
PREFERRED_PROVIDER_virtual/kernel = "linux-tano-swi"
PREFERRED_PROVIDER_virtual/kernel_mangoh-green-wp7607 = "linux-tano-swi"
PREFERRED_VERSION_linux-tano-swi = "3.18%"
LINUXLIBCVERSION = "4.19%"
SDKLINUXLIBCVERSION = "4.19%"

PREFERRED_VERSION_xtables-addons = "2.14%"

SERIAL_CONSOLE = "115200 ttyS0"

#
# Machine features
#
MACHINE_FEATURES = "apm usbgadget usbhost vfat ext2 ethernet wifi ubifs"

#
# Other
#
OPENWRT_VERSION_PRODUCT = "mangOH Green with WP7607"
OPENWRT_VERSION_HWREV = "v1"
```
