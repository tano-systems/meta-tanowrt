## meta-tanowrt-hsl-ti/conf/layer.conf
```bitbake
#
# SPDX-License-Identifier: MIT
# Copyright (c) 2020 Tano Systems LLC. All rights reserved.
#

# Layer version
LAYERVERSION = "1"

# We have a conf and classes directory, append to BBPATH
BBPATH .= ":${LAYERDIR}"

# We have a recipes directory, add to BBFILES
BBFILES += "${LAYERDIR}/recipes*/*/*.bb \
            ${LAYERDIR}/recipes*/*/*.bbappend"

BBFILE_COLLECTIONS += "meta-tanowrt-hsl-ti"
BBFILE_PATTERN_meta-tanowrt-hsl-ti := "^${LAYERDIR}/"
BBFILE_PRIORITY_meta-tanowrt-hsl-ti = "17"

LICENSE_PATH += "${LAYERDIR}/licenses"

LAYERDEPENDS_meta-tanowrt-hsl-ti = "\
	meta-tanowrt \
	meta-ti \
"

LAYERSERIES_COMPAT_meta-tanowrt-hsl-ti = "hardknott"

BBFILES_DYNAMIC += "\
	qt5-layer:${LAYERDIR}/layers-dynamic/meta-qt5/*/*/*.bb \
	qt5-layer:${LAYERDIR}/layers-dynamic/meta-qt5/*/*/*.bbappend \
"

# Set a variable to get the top of the metadata location
TANOWRT_HSL_BASE = '${@os.path.normpath("${LAYERDIR}/")}'

PREMIRRORS_prepend = "git://git\.ti\.com/.* git://github.com/git-ti-com-mirror/BASENAME \n"

# Set TI Processor SDK version to 06.03.00.106
TI_PDK_GIT_URI = "git://git.ti.com/processor-sdk/pdk.git"
TI_PDK_GIT_BRANCH = "master"
TI_PDK_GIT_PROTOCOL = "git"
TI_PDK_SRCREV ?= "9c04a8f4ac2ed95100ee50163b3189d28b9680f1"
TI_PDK_VERSION ?= "2020.4.16"
```

## meta-tanowrt-hsl-ti/conf/machine/am335x-bbb-emmc.conf
```bitbake
#
# SPDX-License-Identifier: MIT
# Copyright (c) 2021 Tano Systems LLC. All rights reserved.
#

#@TYPE: Machine
#@NAME: BeagleBone Black machine
#@DESCRIPTION: Machine configuration for the BeagleBone Black board running on eMMC

require conf/machine/include/am335x-bbb.inc

OPENWRT_VERSION_PRODUCT_append = " (eMMC)"

#
# Machine/distro features
#
MACHINE_FEATURES_append = "swupdate-factory"

#
# Bootloader
#
UBOOT_MACHINE = ""
UBOOT_CONFIG = "sdcard-defconfig emmc-defconfig"
UBOOT_CONFIG[sdcard-defconfig] = "am335x_bbb_sdcard_defconfig,,u-boot.img"
UBOOT_CONFIG[emmc-defconfig] = "am335x_bbb_emmc_defconfig,,u-boot.img"

#
# Image
#

# Do not need auto overlay resizing for eMMC
TANOWRT_ENABLE_OVERLAY_RESIZE = "0"

#
# Initramfs (used for factory installation image)
#
INITRAMFS_IMAGE = "tanowrt-image-initramfs-swu-factory"
INITRAMFS_IMAGE_NAME = "${INITRAMFS_IMAGE}-${MACHINE}"
INITRAMFS_IMAGE_BUNDLE = "0"

#
# SWUPDATE
#
SWU_BOARD = "am335x-bbb-emmc"
SWU_REVISION = "1.0"

# Extra dependencies for factory installation script
SWU_INSTALL_EXTRA_RDEPENDS += "parted mmc-utils"

SWU_IMAGE_MEDIA_TYPE = "eMMC"
SWU_IMAGE_MMCDEV = "/dev/mmcblk1"

SWU_IMAGE_ARTIFACT_spl[fname] = "MLO-emmc-defconfig-x${UBOOT_SPL_MULTIPLE_COUNT}"
SWU_IMAGE_ARTIFACT_uboot[fname] = "u-boot-${MACHINE}"
SWU_IMAGE_ARTIFACT_uboot[ftype] = "img-emmc-defconfig"

# Factory image creation
SWU_FACTORY_WKS_FILE ?= "sdimage-ti-swu-factory.wks.in"
SWU_FACTORY_EXTRA_DEPENDS += "\
	u-boot-startup-script:do_deploy \
	virtual/bootloader:do_deploy \
	virtual/kernel:do_deploy \
"
SWU_FACTORY_EXTRA_FILES = "\
	u-boot-initial-env-emmc-defconfig.bin;u-boot-initial-env.bin \
"

# These variables are used in sdimage-ti-swu-factory.wks.in
WKS_FACTORY_IMAGE_MLO_BINARY = "MLO-sdcard-defconfig"
WKS_FACTORY_IMAGE_STARTUP_BINARY = "startup-factory-${MACHINE}.img"
WKS_FACTORY_IMAGE_KERNEL_BINARY = "fitImage-${INITRAMFS_IMAGE}-${MACHINE}.ext4"
WKS_FACTORY_IMAGE_UBOOT_BINARY = "u-boot-${MACHINE}.img-sdcard-defconfig"
WKS_FACTORY_IMAGE_UBOOT_INITIAL_ENV_BINARY = "u-boot-initial-env-${MACHINE}-sdcard-defconfig.bin"
```

## meta-tanowrt-hsl-ti/conf/machine/am335x-bbb-sd.conf
```bitbake
#
# SPDX-License-Identifier: MIT
# Copyright (c) 2020-2021 Tano Systems LLC. All rights reserved.
#

#@TYPE: Machine
#@NAME: BeagleBone Black machine
#@DESCRIPTION: Machine configuration for the BeagleBond Black board running on SD card

require conf/machine/include/am335x-bbb.inc

OPENWRT_VERSION_PRODUCT_append = " (SD)"

#
# Bootloader
#
UBOOT_MACHINE = ""
UBOOT_CONFIG = "sdcard-defconfig"
UBOOT_CONFIG[sdcard-defconfig] = "am335x_bbb_sdcard_defconfig,,u-boot.img"

#
# Image
#
IMAGE_FSTYPES += "wic"
IMAGE_CLASSES += "wic-sdcard-img"

TANOWRT_ENABLE_OVERLAY_RESIZE = "1"

# These variables are used in sdimage-ti-swu-a-b.wks.in
WKS_IMAGE_MLO_BINARY = "MLO-sdcard-defconfig"
WKS_IMAGE_UBOOT_BINARY = "u-boot-${MACHINE}.img-sdcard-defconfig"
WKS_IMAGE_UBOOT_INITIAL_ENV_BINARY = "u-boot-initial-env-${MACHINE}-sdcard-defconfig.bin"

# WIC
WKS_FILE = "sdimage-ti-swu-a-b.wks.in"
WIC_CREATE_EXTRA_ARGS = "--no-fstab-update"

WIC_DO_IMAGE_DEPENDS = "\
	${IMAGE_BASENAME}:do_image_squashfs_lzo \
	u-boot-startup-script:do_deploy \
	virtual/bootloader:do_deploy \
	virtual/kernel:do_deploy \
"
do_image_wic[depends] += "${WIC_DO_IMAGE_DEPENDS}"

#
# SWUPDATE
#
SWU_BOARD = "am335x-bbb-sd"
SWU_REVISION = "1.0"

SWU_IMAGE_MEDIA_TYPE = "SD Card"
SWU_IMAGE_MMCDEV = "/dev/mmcblk0"

SWU_IMAGE_ARTIFACT_spl[fname] = "MLO-sdcard-defconfig-x${UBOOT_SPL_MULTIPLE_COUNT}"
SWU_IMAGE_ARTIFACT_uboot[fname] = "u-boot-${MACHINE}"
SWU_IMAGE_ARTIFACT_uboot[ftype] = "img-sdcard-defconfig"
```

## meta-tanowrt-hsl-ti/conf/machine/am335x-icev2-sd.conf
```bitbake
#
# SPDX-License-Identifier: MIT
# Copyright (c) 2020 Tano Systems LLC. All rights reserved.
#

#@TYPE: Machine
#@NAME: AM335x ICE v2 EVM
#@DESCRIPTION: Machine configuration for the AM335x ICE v2 EVM sdcard

require conf/machine/include/am335x-evm.inc

#
# Machine/distro features
#
MACHINEOVERRIDES =. "am335x-icev2:"

MACHINE_FEATURES = "\
	apm vfat ext2 ext4 screen graphics \
	sgx ethernet cgroup lldp stp watchdog crypto \
	swupdate \
"

MACHINE_EXTRA_RDEPENDS += "igh-ethercat"

#
# Graphics
#
MACHINE_GUI_CLASS = "smallscreen"

#
# Kernel
#
ENABLE_TI_UIO_DEVICES ?= "0"

KERNEL_IMAGETYPE = "fitImage"
KERNEL_DEVICETREE = "am335x-icev2.dtb am335x-icev2-prueth.dtb"
KERNEL_DEVICETREE += "${@oe.utils.conditional('ENABLE_TI_UIO_DEVICES', '1', 'am335x-icev2-pru-excl-uio.dtb', '', d)}"
KERNEL_CLASSES = "kernel-tn-fitimage kernel-tn-mkimage"
KERNEL_MKIMAGE_TYPES = "ext4"

SERIAL_CONSOLES = "115200;ttyS0 115200;ttyS3"

# Use latest staging kernel
TANOWRT_HSL_TI_SDK_KERNEL ?= "0"

#
# Bootloader
#
UBOOT_DTB_LOADADDRESS  = "0x87e00000"
UBOOT_DTBO_LOADADDRESS = "0x87f00000"
UBOOT_DTBO_OFFSET      = "0x00010000"
UBOOT_RD_LOADADDRESS   = "0x84000000"
UBOOT_RD_ENTRYPOINT    = "0x84000000"

UBOOT_ENV_SIZE      = "0x20000"
UBOOT_ENV_REDUNDANT = "1"

UBOOT_MACHINE = ""
UBOOT_CONFIG = "sdcard-defconfig"
UBOOT_CONFIG[sdcard-defconfig] = "am335x_icev2_sdcard_defconfig,,u-boot.img"

UBOOT_SPL_MULTIPLE = "1"
UBOOT_SPL_MULTIPLE_COUNT = "3"
UBOOT_SPL_MULTIPLE_BLOCK_SIZE = "131072"

UBOOT_INITIAL_ENV = "u-boot-initial-env"

#
# Image
#
ROOTFS_IMAGE_FSTYPE = "squashfs-lzo"

IMAGE_FSTYPES = "${ROOTFS_IMAGE_FSTYPE} wic"
IMAGE_CLASSES += "wic-sdcard-img"

TANOWRT_ENABLE_OVERLAY_RESIZE = "1"

# WIC
WKS_FILE = "sdimage-ti-swu-a-b.wks.in"
WIC_CREATE_EXTRA_ARGS = "--no-fstab-update"
WIC_DO_IMAGE_DEPENDS = "\
	${IMAGE_BASENAME}:do_image_squashfs_lzo \
	u-boot-startup-script:do_deploy \
	virtual/bootloader:do_deploy \
	virtual/kernel:do_deploy \
"
do_image_wic[depends] += "${WIC_DO_IMAGE_DEPENDS}"

# These variables are used in sdimage-ti-swu-a-b.wks.in
WKS_IMAGE_MLO_BINARY = "MLO-sdcard-defconfig"
WKS_IMAGE_UBOOT_BINARY = "u-boot-${MACHINE}.img-sdcard-defconfig"
WKS_IMAGE_UBOOT_INITIAL_ENV_BINARY = "u-boot-initial-env-${MACHINE}-sdcard-defconfig.bin"
WKS_IMAGE_STARTUP_BINARY = "startup-${MACHINE}.img"
WKS_IMAGE_KERNEL_BINARY = "fitImage-${MACHINE}.ext4"
WKS_IMAGE_ROOTFS_BINARY = "${IMAGE_BASENAME}-${MACHINE}.${ROOTFS_IMAGE_FSTYPE}"

PACKAGECONFIG_append_pn-fstools = " ovl-f2fs ovl-rootdisk-part "

IMAGE_FEATURES_remove = "modem"

#
# SWUPDATE
#
SWU_BOARD = "am335x-icev2-sd"
SWU_REVISION = "1.0"

SWU_BOOTLOADER = "uboot"
SWU_OVERLAY_CONTAINER = "blkdev"
SWU_OVERLAY_FS = "ext4"

require ${TANOWRT_HSL_BASE}/conf/machine/include/swu-ti-common.inc

SWU_IMAGE_ARTIFACT_spl[fname] = "MLO-sdcard-defconfig-x${UBOOT_SPL_MULTIPLE_COUNT}"
SWU_IMAGE_ARTIFACT_uboot[fname] = "u-boot-${MACHINE}"
SWU_IMAGE_ARTIFACT_uboot[ftype] = "img-sdcard-defconfig"

#
# OpenWrt specific
#
OPENWRT_VERSION_PRODUCT = "AM335x ICE EVM (SD)"
OPENWRT_VERSION_HWREV = "2.1"

#
# Other
#

# Refine the list of device targets for ti-pdk class recipes
TI_PDK_LIMIT_BOARDS = "icev2AM335x"
```

## meta-tanowrt-hsl-ti/conf/machine/am574x-idk-emmc.conf
```bitbake
#
# SPDX-License-Identifier: MIT
# Copyright (c) 2020 Tano Systems LLC. All rights reserved.
#

#@TYPE: Machine
#@NAME: AM574x IDK EVM
#@DESCRIPTION: Machine configuration for the AM574x IDK EVM running on eMMC internal flash

require conf/machine/include/am574x-idk.inc

OPENWRT_VERSION_PRODUCT_append = " (eMMC)"

#
# Machine/distro features
#
MACHINE_FEATURES_append = "swupdate-factory"

#
# Bootloader
#
UBOOT_MACHINE = ""
UBOOT_CONFIG = "sdcard-defconfig emmc-defconfig"
UBOOT_CONFIG[sdcard-defconfig] = "am574x_idk_sdcard_defconfig,,u-boot.img"
UBOOT_CONFIG[emmc-defconfig] = "am574x_idk_emmc_defconfig,,u-boot.img"

#
# Initramfs (used for factory installation image)
#
INITRAMFS_IMAGE = "tanowrt-image-initramfs-swu-factory"
INITRAMFS_IMAGE_NAME = "${INITRAMFS_IMAGE}-${MACHINE}"
INITRAMFS_IMAGE_BUNDLE = "0"

#
# SWUPDATE
#
SWU_BOARD = "am574x-idk-emmc"
SWU_REVISION = "1.0"

# Extra dependencies for factory installation script
SWU_INSTALL_EXTRA_RDEPENDS += "parted mmc-utils mtd-utils"

SWU_IMAGE_MEDIA_TYPE = "eMMC"
SWU_IMAGE_MMCDEV = "/dev/mmcblk1"

SWU_IMAGE_ARTIFACT_uboot[fname] = "u-boot-${MACHINE}"
SWU_IMAGE_ARTIFACT_uboot[ftype] = "img-emmc-defconfig"

#
# SPL, U-Boot and U-Boot startup script for
# am574x-idk-emmc is on SPI NOR flash
#
SWU_IMAGE_ARTIFACT_spl[fname] = "MLO-emmc-defconfig-x${UBOOT_SPL_MULTIPLE_COUNT_EMMC}"
SWU_IMAGE_ARTIFACT_spl[sw-desc-type] = "raw"
SWU_IMAGE_ARTIFACT_spl[sw-desc-device] = "/dev/mtdblock0"
SWU_IMAGE_ARTIFACT_spl[sw-desc-offset] = "0"

SWU_IMAGE_ARTIFACT_uboot[sw-desc-type] = "raw"
SWU_IMAGE_ARTIFACT_uboot[sw-desc-device] = "/dev/mtdblock1"
SWU_IMAGE_ARTIFACT_uboot[sw-desc-offset] = "0"

SWU_IMAGE_ARTIFACT_startup[sw-desc-type] = "raw"
SWU_IMAGE_ARTIFACT_startup[sw-desc-device] = "/dev/mtdblock2"
SWU_IMAGE_ARTIFACT_startup[sw-desc-offset] = "0"

# Factory image creation
SWU_FACTORY_WKS_FILE ?= "sdimage-ti-swu-factory.wks.in"
SWU_FACTORY_EXTRA_DEPENDS += "\
	u-boot-startup-script:do_deploy \
	virtual/bootloader:do_deploy \
	virtual/kernel:do_deploy \
"
SWU_FACTORY_EXTRA_FILES = "\
	u-boot-initial-env-emmc-defconfig.bin;u-boot-initial-env.bin \
"

# These variables are used in sdimage-ti-swu-factory.wks.in
WKS_FACTORY_IMAGE_MLO_BINARY = "MLO-sdcard-defconfig"
WKS_FACTORY_IMAGE_STARTUP_BINARY = "startup-factory-${MACHINE}.img"
WKS_FACTORY_IMAGE_KERNEL_BINARY = "fitImage-${INITRAMFS_IMAGE}-${MACHINE}.ext4"
WKS_FACTORY_IMAGE_UBOOT_BINARY = "u-boot-${MACHINE}.img-sdcard-defconfig"
WKS_FACTORY_IMAGE_UBOOT_INITIAL_ENV_BINARY = "u-boot-initial-env-${MACHINE}-sdcard-defconfig.bin"
```

## meta-tanowrt-hsl-ti/conf/machine/am574x-idk-sd.conf
```bitbake
#
# SPDX-License-Identifier: MIT
# Copyright (c) 2020 Tano Systems LLC. All rights reserved.
#

#@TYPE: Machine
#@NAME: AM574x IDK EVM
#@DESCRIPTION: Machine configuration for the AM574x IDK EVM running on SD card

require conf/machine/include/am574x-idk.inc

OPENWRT_VERSION_PRODUCT:append = " (SD)"

#
# Bootloader
#
UBOOT_MACHINE = ""
UBOOT_CONFIG = "sdcard-defconfig"
UBOOT_CONFIG[sdcard-defconfig] = "am574x_idk_sdcard_defconfig,,u-boot.img"

#
# Image
#
IMAGE_FSTYPES += "wic"
IMAGE_CLASSES += "wic-sdcard-img"

TANOWRT_ENABLE_OVERLAY_RESIZE = "1"

PACKAGECONFIG:append:pn-fstools = " ovl-rootdisk-part "

# These variables are used in sdimage-ti-swu-a-b.wks.in
WKS_IMAGE_MLO_BINARY = "MLO-sdcard-defconfig"
WKS_IMAGE_UBOOT_BINARY = "u-boot-${MACHINE}.img-sdcard-defconfig"
WKS_IMAGE_UBOOT_INITIAL_ENV_BINARY = "u-boot-initial-env-${MACHINE}-sdcard-defconfig.bin"
WKS_IMAGE_STARTUP_BINARY = "startup-${MACHINE}.img"
WKS_IMAGE_KERNEL_BINARY = "fitImage-${MACHINE}.ext4"
WKS_IMAGE_ROOTFS_BINARY = "${IMAGE_BASENAME}-${MACHINE}.${ROOTFS_IMAGE_FSTYPE}"

# WIC
WKS_FILE = "sdimage-ti-swu-a-b.wks.in"
WIC_CREATE_EXTRA_ARGS = "--no-fstab-update"

WIC_DO_IMAGE_DEPENDS = "\
	${IMAGE_BASENAME}:do_image_squashfs_lzo \
	u-boot-startup-script:do_deploy \
	virtual/bootloader:do_deploy \
	virtual/kernel:do_deploy \
"
do_image_wic[depends] += "${WIC_DO_IMAGE_DEPENDS}"

#
# SWUPDATE
#
SWU_BOARD = "am574x-idk-sd"
SWU_REVISION = "1.0"

SWU_IMAGE_MEDIA_TYPE = "SD Card"
SWU_IMAGE_MMCDEV = "/dev/mmcblk0"

SWU_IMAGE_ARTIFACT_spl[fname] = "MLO-sdcard-defconfig-x${UBOOT_SPL_MULTIPLE_COUNT_SD}"
SWU_IMAGE_ARTIFACT_uboot[fname] = "u-boot-${MACHINE}"
SWU_IMAGE_ARTIFACT_uboot[ftype] = "img-sdcard-defconfig"
```

## meta-tanowrt-hsl-ti/conf/machine/include/am335x-bbb.inc
```bitbake
#
# SPDX-License-Identifier: MIT
# Copyright (c) 2020-2021 Tano Systems LLC. All rights reserved.
#

require conf/machine/include/am335x-evm.inc

#
# Machine/distro features
#
MACHINEOVERRIDES =. "am335x-bbb:"

MACHINE_FEATURES = "\
	apm usbgadget usbhost vfat ext2 ext4 screen graphics \
	sgx ethernet wifi cgroup lldp watchdog crypto \
	swupdate \
"

#
# Graphics
#
MACHINE_GUI_CLASS = "bigscreen"

#
# Kernel
#
KERNEL_IMAGETYPE = "fitImage"
KERNEL_DEVICETREE = "am335x-boneblack.dtb"
KERNEL_CLASSES = "kernel-tn-fitimage kernel-tn-mkimage"
KERNEL_MKIMAGE_TYPES = "ext4"

SERIAL_CONSOLE = "115200 ttyS0"

# Use latest staging kernel
TANOWRT_HSL_TI_SDK_KERNEL ?= "0"

#
# Bootloader
#
UBOOT_DTB_LOADADDRESS  = "0x87e00000"
UBOOT_DTBO_LOADADDRESS = "0x87f00000"
UBOOT_DTBO_OFFSET      = "0x00010000"
UBOOT_RD_LOADADDRESS   = "0x84000000"
UBOOT_RD_ENTRYPOINT    = "0x84000000"

UBOOT_ENV_SIZE      = "0x20000"
UBOOT_ENV_REDUNDANT = "1"

UBOOT_SPL_MULTIPLE = "1"
UBOOT_SPL_MULTIPLE_COUNT = "3"
UBOOT_SPL_MULTIPLE_BLOCK_SIZE = "131072"

UBOOT_INITIAL_ENV = "u-boot-initial-env"

#
# Image
#
ROOTFS_IMAGE_FSTYPE = "squashfs-lzo"

IMAGE_FSTYPES = "${ROOTFS_IMAGE_FSTYPE}"

IMAGE_FEATURES += "splash"
SPLASH = "psplash"

PACKAGECONFIG_append_pn-fstools = " ovl-rootdisk-part "

# These variables are used in sdimage-ti-swu-a-b.wks.in
WKS_IMAGE_MLO_BINARY = "MLO"
WKS_IMAGE_UBOOT_BINARY = "u-boot-${MACHINE}.img"
WKS_IMAGE_UBOOT_INITIAL_ENV_BINARY = "u-boot-initial-env-${MACHINE}.bin"
WKS_IMAGE_STARTUP_BINARY = "startup-${MACHINE}.img"
WKS_IMAGE_KERNEL_BINARY = "fitImage-${MACHINE}.ext4"
WKS_IMAGE_ROOTFS_BINARY = "${IMAGE_BASENAME}-${MACHINE}.${ROOTFS_IMAGE_FSTYPE}"

#
# SWUPDATE
#
SWU_BOOTLOADER = "uboot"
SWU_OVERLAY_CONTAINER = "blkdev"
SWU_OVERLAY_FS = "ext4"

require ${TANOWRT_HSL_BASE}/conf/machine/include/swu-ti-common.inc

#
# OpenWrt specific
#
OPENWRT_VERSION_PRODUCT = "BeagleBone Black"
OPENWRT_VERSION_HWREV = "${SWU_REVISION}"

#
# Other
#

# Refine the list of device targets for ti-pdk class recipes
TI_PDK_LIMIT_BOARDS = "bbbAM335x"
```
