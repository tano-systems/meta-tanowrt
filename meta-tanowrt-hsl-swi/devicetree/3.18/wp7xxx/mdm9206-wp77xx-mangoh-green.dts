/*
 * Copyright (c) 2017, The Linux Foundation. All rights reserved.
 *
 * This program is free software; you can redistribute it and/or modify
 * it under the terms of the GNU General Public License version 2 and
 * only version 2 as published by the Free Software Foundation.
 *
 * This program is distributed in the hope that it will be useful,
 * but WITHOUT ANY WARRANTY; without even the implied warranty of
 * MERCHANTABILITY or FITNESS FOR A PARTICULAR PURPOSE.  See the
 * GNU General Public License for more details.
 */

/dts-v1/;

#include "mdm9206-wp77xx.dtsi"

/ {
	model = "Sierra Wireless, Inc. MDM 9206 WP series";
	compatible = "qcom,mdm9607-mtp", "qcom,mdm9607", "qcom,mtp";
	qcom,board-id = <8 0x81>;
};

&sdhc_2 {
	status = "ok";
	ti,non-removable;
	ti,needs-special-hs-handling;
	cap-power-off-card;
	keep-power-in-suspend;
	wlcore: wlcore@0 {
		compatible = "ti,wlcore";
		reg = <2>;
	};
};

