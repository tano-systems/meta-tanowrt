## meta-tanowrt/conf/distro/include/tcmode-internal-linaro.inc
```bitbake
#
# SPDX-License-Identifier: MIT
# Copyright (c) 2018-2020 Tano Systems LLC. All rights reserved.
#

#
# Configuration to use an internal Linaro binary toolchain
#
TARGET_VENDOR = ""

require conf/distro/include/tcmode-default.inc
```

## meta-tanowrt/conf/distro/include/toolchain-external.inc
```bitbake
#
# SPDX-License-Identifier: MIT
# Copyright (c) 2018-2020 Tano Systems LLC. All rights reserved.
#

# Original file from meta-arago-distro

# Locate the toolchain automatically from PATH
TOOLCHAIN_PATH ??= "/usr/local/sdk"
TOOLCHAIN_SYSPATH = "${TOOLCHAIN_PATH}/${TOOLCHAIN_SYS}"
EXTERNAL_TOOLCHAIN = "${TOOLCHAIN_PATH}"
```

## meta-tanowrt/conf/distro/include/toolchain-internal-linaro.inc
```bitbake
# Original file from meta-arago-distro

# Select internal gcc toolchain to be built from sources
TCMODE = "internal-linaro"
TCLIBC = "glibc"

LIBCEXTENSION = "${@['', '-gnu'][(d.getVar('ABIEXTENSION', True) or '') != '']}"

ILT_TARGET_SYS_ARMV5 ?= "arm-linux-gnueabi"
ILT_TARGET_SYS_ARMV7 ?= "arm-linux-gnueabihf"
ILT_TARGET_SYS_ARMV8 ?= "aarch64-linux-gnu"

ILT_TARGET_SYS_arm = "${ILT_TARGET_SYS_ARMV5}"
ILT_TARGET_SYS_armv7a = "${ILT_TARGET_SYS_ARMV7}"
ILT_TARGET_SYS_aarch64 = "${ILT_TARGET_SYS_ARMV8}"

TOOLCHAIN_SYS := "${ILT_TARGET_SYS}"
TOOLCHAIN_PREFIX := "${TOOLCHAIN_SYS}-"

PREFERRED_PROVIDER_gcc-cross-canadian-${TRANSLATED_TARGET_ARCH} ?= "gcc-cross-canadian-${TRANSLATED_TARGET_ARCH}"
PREFERRED_PROVIDER_binutils-cross-canadian-${TRANSLATED_TARGET_ARCH} ?= "binutils-cross-canadian-${TRANSLATED_TARGET_ARCH}"
PREFERRED_PROVIDER_gdb-cross-canadian-${TRANSLATED_TARGET_ARCH} = "gdb-cross-canadian-${TRANSLATED_TARGET_ARCH}"

# Set Cross and SDK toolchain preferences
SDKGCCVERSION ?= "linaro-7.2%"
SDKBINUVERSION ?= "linaro-2.27%"
SDKGLIBCVERSION ?= "linaro-2.26%"
SDKLINUXLIBCVERSION ?= "4.14%"

PREFERRED_VERSION_gcc-crosssdk-${SDK_SYS} ?= "${SDKGCCVERSION}"
PREFERRED_VERSION_gcc-crosssdk-initial-${SDK_SYS} ?= "${SDKGCCVERSION}"
PREFERRED_VERSION_binutils-crosssdk-${SDK_SYS} ?= "${SDKBINUVERSION}"

PREFERRED_VERSION_nativesdk-gcc-runtime ?= "${SDKGCCVERSION}"
PREFERRED_VERSION_nativesdk-libgcc ?= "${SDKGCCVERSION}"
PREFERRED_VERSION_nativesdk-libgcc-initial ?= "${SDKGCCVERSION}"
PREFERRED_VERSION_nativesdk-linux-libc-headers ?= "${SDKLINUXLIBCVERSION}"
PREFERRED_VERSION_nativesdk-glibc ?= "${SDKGLIBCVERSION}"
PREFERRED_VERSION_nativesdk-glibc-initial ?= "${SDKGLIBCVERSION}"

# Set target toolchain preferences to match Cross/SDK by default
# Can be overwritten globally, if needed
GCCVERSION ?= "linaro-7.2%"
BINUVERSION ?= "linaro-2.27%"
GLIBCVERSION ?= "linaro-2.26%"
GLIBCINITVERSION ?= "linaro-2.26%"
LINUXLIBCVERSION ?= "4.14%"

PREFERRED_VERSION_gcc ?= "${GCCVERSION}"
PREFERRED_VERSION_binutils ?= "${BINUVERSION}"
PREFERRED_VERSION_linux-libc-headers ?= "${LINUXLIBCVERSION}"
PREFERRED_VERSION_glibc ?= "${GLIBCVERSION}"
PREFERRED_VERSION_glibc-locale ?= "${GLIBCVERSION}"
PREFERRED_VERSION_glibc-initial ?= "${GLIBCINITVERSION}"
```

## meta-tanowrt/conf/distro/include/toolchain-internal.inc
```bitbake
#
# SPDX-License-Identifier: MIT
# Copyright (c) 2018-2020 Tano Systems LLC. All rights reserved.
#

# Original file from meta-arago-distro

# No special handling is required for locating the internal toolchain, just re-use existing vars
TOOLCHAIN_PATH ?= "${STAGING_BINDIR_TOOLCHAIN}"
TOOLCHAIN_SYSPATH ?= "${TOOLCHAIN_PATH}/${TARGET_SYS}"
EXTERNAL_TOOLCHAIN = "${TOOLCHAIN_PATH}"
```

## meta-tanowrt/conf/distro/tanowrt.conf
```bitbake
#
# SPDX-License-Identifier: MIT
# Copyright (c) 2018-2022 Tano Systems LLC. All rights reserved.
#

require conf/distro/include/tanowrt.inc

# Linguas / locales
IMAGE_LINGUAS ?= "ru-ru.utf-8"
GLIBC_GENERATE_LOCALES ?= "ru_RU.UTF-8"
ENABLE_BINARY_LOCALE_GENERATION ?= "1"
LOCALE_UTF8_ONLY ?= "0"
LOCALE_UTF8_IS_DEFAULT ?= "0"
LOCALE_UTF8_IS_DEFAULT:class-nativesdk ?= "1"

LUCI_LANGUAGES ?= "en ru"
LUCI_INITIAL_LANG ?= "auto"

# Name and version of the distribution
DISTRO_NAME     = "TanoWrt"
DISTRO_VERSION  = "Kirkstone"
DISTRO          = "tanowrt"
DISTRO_CODENAME = "tanowrt"

# OpenWrt version
OPENWRT_VERSION_MANUFACTURER     ?= "Tano Systems LLC"
OPENWRT_VERSION_MANUFACTURER_URL ?= "https://tano-systems.com"
OPENWRT_VERSION_HOME_URL         ?= "https://tano-systems.com"
OPENWRT_VERSION_BUG_URL          ?= "https://github.com/tano-systems/meta-tanowrt/issues"
OPENWRT_VERSION_SUPPORT_URL      ?= "https://github.com/tano-systems/meta-tanowrt/issues"

# Initial timezone
OPENWRT_ZONENAME ?= "Europe/Moscow"
OPENWRT_TIMEZONE ?= "MSK-3"

# LuCI configuration
TANOWRT_LUCI_ENABLE ?= "1"

# Distribution and LuCI version for LuCI
# This data is displayed as Firmware Version in LuCI
LUCI_DISTNAME    ?= "${DISTRO_NAME}"
LUCI_DISTVERSION ?= "${DISTRO_VERSION}"
LUCI_NAME        ?= "LuCI"

# Initial mediaurlbase
LUCI_INITIAL_MEDIAURLBASE ?= "/luci-static/tano"
```

## meta-tanowrt/conf/layer.conf
```bitbake
#
# SPDX-License-Identifier: MIT
# Copyright (c) 2018-2020 Tano Systems LLC. All rights reserved.
#

# Layer version
LAYERVERSION = "1"

# We have a conf and classes directory, append to BBPATH
BBPATH .= ":${LAYERDIR}"

# We have a recipes directory, add to BBFILES
BBFILES += "${LAYERDIR}/recipes*/*/*.bb \
            ${LAYERDIR}/recipes*/*/*.bbappend"

# Backported recipes (may be removed at next update on OE release)
BBFILES += "${LAYERDIR}/layers-backport/meta-oe/recipes*/*/*.bb \
            ${LAYERDIR}/layers-backport/meta-oe/recipes*/*/*.bbappend \
            ${LAYERDIR}/layers-backport/meta-networking/recipes*/*/*.bb \
            ${LAYERDIR}/layers-backport/meta-networking/recipes*/*/*.bbappend \
            ${LAYERDIR}/layers-backport/openembedded-core/recipes*/*/*.bb \
            ${LAYERDIR}/layers-backport/openembedded-core/recipes*/*/*.bbappend"

BBFILE_COLLECTIONS += "meta-tanowrt"
BBFILE_PATTERN_meta-tanowrt := "^${LAYERDIR}/"
BBFILE_PRIORITY_meta-tanowrt = "16"

LICENSE_PATH += "${LAYERDIR}/licenses"

LAYERDEPENDS_meta-tanowrt = "\
	core \
	openembedded-layer \
	networking-layer \
	meta-python \
	swupdate \
"

# Compatible with OE Release 3.3 (Hardknott)
LAYERSERIES_COMPAT_meta-tanowrt = "hardknott"

#
# Dynamic layers
#
BBFILES_DYNAMIC += "\
	qt5-layer:${LAYERDIR}/layers-dynamic/meta-qt5/*/*/*.bb \
	qt5-layer:${LAYERDIR}/layers-dynamic/meta-qt5/*/*/*.bbappend \
"

# Set a variable to get the top of the metadata location
TANOWRT_BASE = '${@os.path.normpath("${LAYERDIR}/")}'
BB_HASHBASE_WHITELIST_append = " TANOWRT_BASE TANOWRT_HSL_BASE TANOWRT_HSL_EXTRAS_BASE "

# Set a variable to get the top of the misc files location
TANOWRT_FILES = '${@os.path.normpath("${LAYERDIR}/misc/")}'
```

## meta-tanowrt/conf/machine/include/qemuall.inc
```bitbake
#
# SPDX-License-Identifier: MIT
# Copyright (c) 2018-2021 Tano Systems LLC. All rights reserved.
#

#
# Kernel
#
KERNEL_IMAGETYPE = "bzImage"
PREFERRED_PROVIDER_virtual/kernel = "linux-tano-yocto"
PREFERRED_VERSION_linux-tano-yocto = "5.10%"
PREFERRED_VERSION_xtables-addons = "3.13%"

LINUXLIBCVERSION = "5.10%"
SDKLINUXLIBCVERSION = "5.10%"

# Set to "1" for kernels 5.6+
TANOWRT_WIREGUARD_IN_KERNEL = "1"

QEMU_X86_TARGETS = "i586 x86-64"

# Enable tty1
PROCD_ENABLED_TTYS ?= "1"

MACHINE_FEATURES_append = " hwrng "

TANOWRT_PARTUUID_BOOT        = "bbefcb9e-ac94-43fc-8be2-0023a70c0722"
TANOWRT_PARTUUID_OVERLAY     = "4473a134-2531-4ab1-a5f9-dfa54376eb78"
TANOWRT_PARTUUID_ROOTDEV_A   = "d4997f99-3f39-4952-9433-602b66222be5"
TANOWRT_PARTUUID_ROOTDEV_B   = "fd4aab45-0ed8-48dc-8b07-6514336e2ac1"
TANOWRT_PARTUUID_KERNELDEV_A = "a1a55b33-b1c9-4226-b2f6-0d7d901f040f"
TANOWRT_PARTUUID_KERNELDEV_B = "d35fdb7b-4042-4f75-a4af-8983f9584b47"

TANOWRT_PARTUUID_VARS = "\
       TANOWRT_PARTUUID_BOOT \
       TANOWRT_PARTUUID_OVERLAY \
       TANOWRT_PARTUUID_ROOTDEV_A \
       TANOWRT_PARTUUID_ROOTDEV_B \
       TANOWRT_PARTUUID_KERNELDEV_A \
       TANOWRT_PARTUUID_KERNELDEV_B \
"

#
# QEMU
#
QB_MEM ?= "-m 512"
```

## meta-tanowrt/conf/machine/include/qemuscreen.inc
```bitbake
#
# SPDX-License-Identifier: MIT
# Copyright (c) 2018-2020 Tano Systems LLC. All rights reserved.
#

#
# Machine/distro features
#

#
# Psplash
#
IMAGE_FEATURES += "splash"
SPLASH = "psplash"

XSERVER_QEMU_ALLX86 = "\
	xf86-video-cirrus \
	xf86-video-vmware \
	xf86-video-modesetting \
	xserver-xorg-module-libint10 \
"

XSERVER:append:qemux86 = " ${XSERVER_QEMU_ALLX86}"
XSERVER:append:qemux86-64 = " ${XSERVER_QEMU_ALLX86}"

#
# Kernel modules
#

#
# QEMU options (runqemu)
#
QB_OPT_APPEND:remove = "-nographic"
QB_OPT_APPEND:append = "\
	-device usb-tablet \
	-serial mon:stdio \
	-serial null \
"

QB_OPT_APPEND:append:qemux86 = " -vga std "
QB_OPT_APPEND:append:qemux86-64 = " -vga std "
QB_OPT_APPEND:append:qemuarm = " -device VGA,edid=on "
QB_OPT_APPEND:append:qemuarm64 = " -device VGA,edid=on "

#
# Enable SDL display in QEMU
#
PACKAGECONFIG:append:pn-qemu-system-native = " sdl"
PACKAGECONFIG:append:pn-nativesdk-qemu = " sdl"
```

## meta-tanowrt/conf/machine/include/qemux86.inc
```bitbake
#
# SPDX-License-Identifier: MIT
# Copyright (c) 2018-2021 Tano Systems LLC. All rights reserved.
#

#
# PACKAGECONFIG's
#
PACKAGECONFIG_append_pn-fstools = " ovl-rootdisk-part "

#
# Kernel
#
PREFERRED_PROVIDER_virtual/kernel_qemux86 = "linux-tano-yocto"
SERIAL_CONSOLES ?= "115200;ttyS0"

KERNEL_CLASSES = "kernel-tn-mkimage"
KERNEL_MKIMAGE_TYPES = "ext4"

#
# Image
#
ROOTFS_IMAGE_FSTYPE = "squashfs-lzo"
IMAGE_FSTYPES = "wic wic.vmdk ${ROOTFS_IMAGE_FSTYPE}"

TANOWRT_ENABLE_OVERLAY_RESIZE = "1"

EFI_PROVIDER = "grub-efi"

WKS_FILE = "tanowrt-image-qemux86.wks.in"
WKS_FILE_DEPENDS = "syslinux syslinux-native e2fsprogs-native dosfstools-native mtools-native squashfs-tools-native"
WIC_CREATE_EXTRA_ARGS = "--no-fstab-update"
WIC_DO_IMAGE_DEPENDS = "\
	${IMAGE_BASENAME}:do_image_squashfs_lzo \
	${EFI_PROVIDER}:do_deploy \
	virtual/grub-bootconf:do_deploy \
"
do_image_wic[depends] += "${WIC_DO_IMAGE_DEPENDS}"

# These variables are used in tanowrt-image-qemux86.wks.in
WKS_IMAGE_ROOTFS_BINARY = "${IMAGE_BASENAME}-${MACHINE}.${ROOTFS_IMAGE_FSTYPE}"
WKS_IMAGE_KERNEL_BINARY = "${KERNEL_IMAGETYPE}-${MACHINE}.ext4"
WKS_IMAGE_GRUB_CONFIG = "grub.cfg"

# Remove /boot from root filesystem
ROOTFS_RM_BOOT_DIR_DISABLE = "0"

# Build ovmf firmware for uefi support in qemu.
EXTRA_IMAGEDEPENDS += "ovmf"

IMAGE_INSTALL_append = "\
	grub-editenv \
"

#
# Initramfs (used for factory installation image)
#
INITRAMFS_IMAGE = "tanowrt-image-initramfs-swu-factory"
INITRAMFS_IMAGE_NAME = "${INITRAMFS_IMAGE}-${MACHINE}"
INITRAMFS_IMAGE_BUNDLE = "0"

INITRD = "${DEPLOY_DIR_IMAGE}/${INITRAMFS_IMAGE_NAME}.cpio.gz"

#
# Machine/distro features
#
MACHINE_FEATURES = "\
	pci \
	apm \
	usbgadget \
	usbhost \
	vfat \
	ext2 \
	ethernet \
	wifi \
	cgroup \
	stp \
	lldp \
	crypto \
	pcbios \
	efi \
	swupdate \
	swupdate-factory \
"

#
# QEMU options (runqemu)
#
QB_MACHINE = "-machine q35"
QB_DEFAULT_FSTYPE = "wic"
QB_SYSTEM_NAME = "qemu-system-i386"
QB_KERNEL_CMDLINE_APPEND = "console=ttyS0,115200 console=tty1"
QB_OPT_APPEND = "-usb -device virtio-rng-pci -nographic -smp 2"
QB_SERIAL_OPT = "-serial stdio"
QB_AUDIO_DRV  = ""
QB_AUDIO_OPT  = ""

# Change bootorder to first boot from hard drive
QB_OPT_APPEND += "-boot order=c,menu=off"

# Add EFI ovmf firmware to qemu
QB_OPT_APPEND += "-drive if=pflash,format=qcow2,file=${DEPLOY_DIR_IMAGE}/ovmf.qcow2"

#
# SWUPDATE
#
SWU_BOOTLOADER = "grub-efi"
SWU_OVERLAY_CONTAINER = "blkdev"
SWU_OVERLAY_FS = "ext4"

SWU_IMAGE_MEDIA_TYPE = "Virtual Drive"

SWU_IMAGE_EXTRA_ARTIFACTS += "kernel bootloader"

SWU_IMAGE_ARTIFACT_kernel[fname] = "${KERNEL_IMAGETYPE}"
SWU_IMAGE_ARTIFACT_kernel[ftype] = "ext4"
SWU_IMAGE_ARTIFACT_kernel[depends] = "virtual/kernel:do_deploy"
SWU_IMAGE_ARTIFACT_kernel[verextract] = "1"
SWU_IMAGE_ARTIFACT_kernel[verextract-cmd] = "strings"
SWU_IMAGE_ARTIFACT_kernel[verextract-filter-cmd] = "grep -m 1 'oe-user@oe-host' | awk '{ print $1 }'"
SWU_IMAGE_ARTIFACT_kernel[sw-desc-type] = "raw"
SWU_IMAGE_ARTIFACT_kernel[sw-desc-device-a] = "/dev/swu-kernel-a"
SWU_IMAGE_ARTIFACT_kernel[sw-desc-device-b] = "/dev/swu-kernel-b"

SWU_IMAGE_ARTIFACT_rootfs[sw-desc-type] = "raw"
SWU_IMAGE_ARTIFACT_rootfs[sw-desc-device-a] = "/dev/swu-rootfs-a"
SWU_IMAGE_ARTIFACT_rootfs[sw-desc-device-b] = "/dev/swu-rootfs-b"

SWU_IMAGE_ARTIFACT_bootloader[name] = "grub"
SWU_IMAGE_ARTIFACT_bootloader[fname] = "grub-efi-${@os.path.splitext(d.getVar('EFI_BOOT_IMAGE', True))[0]}"
SWU_IMAGE_ARTIFACT_bootloader[ftype] = "efi"
SWU_IMAGE_ARTIFACT_bootloader[depends] = "grub-efi:do_deploy"
SWU_IMAGE_ARTIFACT_bootloader[verextract] = "1"
SWU_IMAGE_ARTIFACT_bootloader[verextract-cmd] = "strings"
SWU_IMAGE_ARTIFACT_bootloader[verextract-filter-cmd] = "sed -n '/GNU GRUB  version %s/{n;p;}'"
SWU_IMAGE_ARTIFACT_bootloader[sw-desc-type] = "rawfile"
SWU_IMAGE_ARTIFACT_bootloader[sw-desc-path] = "${EFI_FILES_PATH}/${EFI_BOOT_IMAGE}"

# Extra dependencies for factory installation script
SWU_INSTALL_EXTRA_RDEPENDS += "parted"

# Factory image creation
SWU_FACTORY_WKS_FILE ?= "qemux86-swu-factory.wks.in"
SWU_FACTORY_WKS_FILE_DEPENDS += "cdrtools-native"
SWU_FACTORY_WKS_OUTPUT_EXT = "iso"

SWU_FACTORY_EXTRA_DEPENDS += "\
	${EFI_PROVIDER}:do_deploy \
	virtual/kernel:do_deploy \
	virtual/grub-bootconf:do_deploy \
"

SWU_FACTORY_EXTRA_FILES = "\
	grub-efi-startup.nsh;startup.nsh \
	grub-efi-grubenv \
	grub.cfg;grub-efi-grub.cfg \
"

#
# OpenWrt specific
#
OPENWRT_VERSION_PRODUCT = "qemux86"
OPENWRT_VERSION_HWREV = "v1"
```

## meta-tanowrt/conf/machine/qemuarm-screen.conf
```bitbake
#
# SPDX-License-Identifier: MIT
# Copyright (c) 2018-2020 Tano Systems LLC. All rights reserved.
#

#@TYPE: Machine
#@NAME: arm_versatile_926ejs + screen
#@DESCRIPTION: Machine configuration for the ARMv5 system on QEMU with screen support

MACHINEOVERRIDES =. "qemuarm:"

require conf/machine/qemuarm.conf
require conf/machine/include/qemuscreen.inc

# Machine/distro features
MACHINE_FEATURES += "screen opengl"

# Kernel
KMACHINE = "qemuarm"

# OpenWrt specific
OPENWRT_VERSION_PRODUCT = "qemuarm-screen"
OPENWRT_VERSION_HWREV = "v1"
```

## meta-tanowrt/conf/machine/qemuarm.conf
```bitbake
#
# SPDX-License-Identifier: MIT
# Copyright (c) 2018-2020 Tano Systems LLC. All rights reserved.
#

#@TYPE: Machine
#@NAME: arm_versatile_926ejs
#@DESCRIPTION: Machine configuration for the ARMv5 system on QEMU

#
# CPU
#
require conf/machine/include/qemu.inc
require conf/machine/include/tune-arm926ejs.inc

require conf/machine/include/qemuall.inc

#
# PACKAGECONFIG's
#
PACKAGECONFIG_append_pn-fstools = " ovl-rootdisk-part "

#
# Image
#
IMAGE_FSTYPES = "wic"
IMAGE_CLASSES += "qemuarm-image-helper"
IMAGE_BOOT_FILES = "${KERNEL_IMAGETYPE} ${@parse_dtbs(d)}"

WKS_FILE = "tanowrt-image-qemuarm.wks"
WKS_FILE_DEPENDS = "e2fsprogs-native mtools-native squashfs-tools-native"
WIC_CREATE_EXTRA_ARGS = "--no-fstab-update"

#
# Kernel
#
PREFERRED_PROVIDER_virtual/kernel_qemuarm = "linux-tano-yocto"
SERIAL_CONSOLES ?= "115200;ttyAMA0"
KERNEL_IMAGETYPE = "zImage"
KERNEL_DEVICETREE = "versatile-pb.dtb"

#
# Machine/distro features
#
MACHINE_FEATURES = "pci apm usbgadget usbhost vfat ext2 ethernet wifi cgroup stp lldp crypto"

#
# QEMU options (runqemu)
# ARM Versatile PB (on Cortex-A8)
#
QB_DEFAULT_FSTYPE = "wic"
QB_MACHINE = "-machine versatilepb"
QB_SYSTEM_NAME = "qemu-system-arm"
QB_KERNEL_CMDLINE_APPEND = "root=/dev/sda1 ro highres=off mem=512M console=ttyAMA0,115200 console=tty1"
QB_DTB = "${KERNEL_DEVICETREE}"
QB_SERIAL_OPT = "-serial stdio"

# Add the 'virtio-rng-pci' device otherwise the guest may run out of entropy
QB_RNG = "-object rng-random,filename=/dev/urandom,id=rng0 -device virtio-rng-pci,rng=rng0"

QB_OPT_APPEND = "\
	-usb \
	-nographic \
	-kernel ${DEPLOY_DIR_IMAGE}/${KERNEL_IMAGETYPE} \
	-dtb ${DEPLOY_DIR_IMAGE}/${KERNEL_DEVICETREE} \
	-append '${QB_KERNEL_CMDLINE_APPEND}' \
"

#
# OpenWrt specific
#
OPENWRT_VERSION_PRODUCT = "qemuarm"
OPENWRT_VERSION_HWREV = "v1"
```
