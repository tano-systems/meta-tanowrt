## meta-tanowrt/conf/machine/qemuarm64-screen.conf
```bitbake
#
# SPDX-License-Identifier: MIT
# Copyright (c) 2018-2020 Tano Systems LLC. All rights reserved.
#

#@TYPE: Machine
#@NAME: QEMU ARMv8 machine + screen
#@DESCRIPTION: Machine configuration for the ARMv8 system on QEMU

MACHINEOVERRIDES =. "qemuarm64:"

require conf/machine/qemuarm64.conf
require conf/machine/include/qemuscreen.inc

# Machine/distro features
MACHINE_FEATURES += "screen opengl"

# Kernel
KMACHINE = "qemuarm64"

# OpenWrt specific
OPENWRT_VERSION_PRODUCT = "qemuarm64-screen"
OPENWRT_VERSION_HWREV = "v1"
```

## meta-tanowrt/conf/machine/qemuarm64.conf
```bitbake
#
# SPDX-License-Identifier: MIT
# Copyright (c) 2018-2020 Tano Systems LLC. All rights reserved.
#

#@TYPE: Machine
#@NAME: QEMU ARMv8 machine
#@DESCRIPTION: Machine configuration for running an ARMv8 system on QEMU

#
# CPU
#
require conf/machine/include/arm/arch-armv8a.inc
require conf/machine/include/qemu.inc

require conf/machine/include/qemuall.inc

#
# PACKAGECONFIG's
#
PACKAGECONFIG_append_pn-fstools = " ovl-rootdisk-part "

#
# Image
#
IMAGE_FSTYPES = "wic"
IMAGE_BOOT_FILES = "${KERNEL_IMAGETYPE}"

WKS_FILE = "tanowrt-image-qemuarm64.wks"
WKS_FILE_DEPENDS = "e2fsprogs-native mtools-native squashfs-tools-native"
WIC_CREATE_EXTRA_ARGS = "--no-fstab-update"

#
# Kernel
#
PREFERRED_PROVIDER_virtual/kernel_qemuarm = "linux-tano-yocto"
SERIAL_CONSOLES ?= "115200;ttyAMA0"
KERNEL_IMAGETYPE = "Image"

#
# Machine/distro features
#
MACHINE_FEATURES = "pci apm usbgadget usbhost vfat ext2 ethernet wifi cgroup stp lldp crypto"

#
# QEMU options (runqemu)
#
QEMU_TARGETS = "aarch64"

QB_DEFAULT_FSTYPE = "wic"
QB_CPU = "-cpu cortex-a57"
QB_DRIVE_TYPE = "/dev/sd"
QB_CPU_KVM = "-cpu host -machine gic-version=3"
QB_MACHINE = "-machine virt"
QB_SYSTEM_NAME = "qemu-system-aarch64"
QB_KERNEL_CMDLINE_APPEND = "root=/dev/sda1 ro highres=off mem=256M console=ttyAMA0,115200 console=tty1"
QB_SERIAL_OPT = "-serial stdio"

QB_TAP_OPT = "-netdev tap,id=net0,ifname=@TAP@,script=no,downscript=no"
QB_NETWORK_DEVICE = "-device virtio-net-device,netdev=net0,mac=@MAC@"

# Add the 'virtio-rng-pci' device otherwise the guest may run out of entropy
QB_OPT_APPEND = "\
	-usb \
	-device qemu-xhci \
	-device usb-tablet \
	-device usb-kbd \
	-object rng-random,filename=/dev/urandom,id=rng0 \
	-device virtio-rng-pci,rng=rng0 \
	-nographic \
	-kernel ${DEPLOY_DIR_IMAGE}/${KERNEL_IMAGETYPE} \
	-append '${QB_KERNEL_CMDLINE_APPEND}' \
"

#
# OpenWrt specific
#
OPENWRT_VERSION_PRODUCT = "qemuarm64"
OPENWRT_VERSION_HWREV = "v1"
```

## meta-tanowrt/conf/machine/qemux86-64-screen.conf
```bitbake
#
# SPDX-License-Identifier: MIT
# Copyright (c) 2018-2020 Tano Systems LLC. All rights reserved.
#

#@TYPE: Machine
#@NAME: common_pc + screen
#@DESCRIPTION: Machine configuration for running a common x86-64

MACHINEOVERRIDES =. "qemux86-64:"

require conf/machine/qemux86-64.conf
require conf/machine/include/qemuscreen.inc

# Machine/distro features
MACHINE_FEATURES += "screen opengl"
MACHINE_ESSENTIAL_EXTRA_RDEPENDS += "v86d"

# Kernel
KMACHINE = "qemux86-64"

#
# SWUPDATE
#
SWU_BOARD = "qemux86-64"
SWU_REVISION = "screen-1.0"
SWU_HW_COMPATIBILITY = '"standard-1.0", "screen-1.0"'

#
# OpenWrt specific
#
OPENWRT_VERSION_PRODUCT = "${SWU_BOARD}"
OPENWRT_VERSION_HWREV = "${SWU_REVISION}"
```

## meta-tanowrt/conf/machine/qemux86-64.conf
```bitbake
#@TYPE: Machine
#@NAME: common_pc
#@DESCRIPTION: Machine configuration for running a common x86

#
# CPU
#
require conf/machine/include/qemu.inc
DEFAULTTUNE ?= "core2-64"
require conf/machine/include/tune-core2.inc
require conf/machine/include/qemuboot-x86.inc

require conf/machine/include/qemuall.inc
require conf/machine/include/qemux86.inc

#
# QEMU options (runqemu)
#
QB_DEFAULT_FSTYPE = "wic"
QB_SYSTEM_NAME = "qemu-system-x86_64"

#
# OpenWrt specific
#
OPENWRT_VERSION_PRODUCT = "qemux86-64"
OPENWRT_VERSION_HWREV = "v1"
```

## meta-tanowrt/conf/machine/qemux86-screen.conf
```bitbake
#
# SPDX-License-Identifier: MIT
# Copyright (c) 2018-2020 Tano Systems LLC. All rights reserved.
#

#@TYPE: Machine
#@NAME: common_pc + screen
#@DESCRIPTION: Machine configuration for running a common x86

MACHINEOVERRIDES =. "qemux86:"

require conf/machine/qemux86.conf
require conf/machine/include/qemuscreen.inc

#
# Machine/distro features
#
MACHINE_FEATURES += "screen opengl"
MACHINE_ESSENTIAL_EXTRA_RDEPENDS += "v86d"

#
# Kernel
#
KMACHINE = "qemux86"

#
# SWUPDATE
#
SWU_BOARD = "qemux86"
SWU_REVISION = "screen-1.0"
SWU_HW_COMPATIBILITY = '"standard-1.0", "screen-1.0"'

#
# OpenWrt specific
#
OPENWRT_VERSION_PRODUCT = "${SWU_BOARD}"
OPENWRT_VERSION_HWREV = "${SWU_REVISION}"
```

## meta-tanowrt/conf/machine/qemux86.conf
```bitbake
#
# SPDX-License-Identifier: MIT
# Copyright (c) 2018-2020 Tano Systems LLC. All rights reserved.
#

#@TYPE: Machine
#@NAME: common_pc
#@DESCRIPTION: Machine configuration for the x86 system on QEMU

MACHINEOVERRIDES =. "qemupc:"

#
# CPU
#
require conf/machine/include/qemu.inc
require conf/machine/include/tune-i586.inc
require conf/machine/include/qemuboot-x86.inc

require conf/machine/include/qemuall.inc
require conf/machine/include/qemux86.inc

#
# QEMU options (runqemu)
#
QB_DEFAULT_FSTYPE = "wic"
QB_SYSTEM_NAME = "qemu-system-i386"

#
# SWUPDATE
#
SWU_BOARD = "qemux86"
SWU_REVISION = "standard-1.0"
SWU_HW_COMPATIBILITY = '"standard-1.0", "screen-1.0"'

#
# OpenWrt specific
#
OPENWRT_VERSION_PRODUCT = "${SWU_BOARD}"
OPENWRT_VERSION_HWREV = "${SWU_REVISION}"
```

## meta-tanowrt/wic/tanowrt-image-qemuarm.wks
```
#
# SPDX-License-Identifier: MIT
# Copyright (c) 2019-2020 Tano Systems LLC. All rights reserved.
#

part / --source rootfs --ondisk=mmcblk0 --fstype=squashfs --align=1024
part /overlay --size=64M --ondisk=mmcblk0 --fstype=ext4 --label=rootfs_data --align=1024
```

## meta-tanowrt/wic/tanowrt-image-qemuarm64.wks
```
#
# SPDX-License-Identifier: MIT
# Copyright (c) 2020 Tano Systems LLC. All rights reserved.
#

part / --source rootfs --ondisk=sda --fstype=squashfs --align=1024
part /overlay --size=64M --ondisk=sda --fstype=ext4 --label=rootfs_data --align=1024
```

## meta-tanowrt/wic/tanowrt-image-qemux86.wks
```
#
# SPDX-License-Identifier: MIT
# Copyright (c) 2019-2021 Tano Systems LLC. All rights reserved.
#

#
# +------------+----------+----------+--------------+
# |            | system A | system B |              |
# | Bootloader | rootfs + | rootfs + | Overlay data |
# |            | kernel   | kernel   |              |
# +------------+----------+----------+--------------+
#
part /boot     --source bootimg-efi-ext --sourceparams="loader=grub-efi, no_kernel=1" --ondisk sda --label boot --active --align 1024 --overhead-factor=1.0
part /system_a --source=rawcopy --ondisk=sda --part-name=system_a --align=1024 --size=384M --sourceparams "file=${IMGDEPLOYDIR}/${IMAGE_BASENAME}-${MACHINE}.${ROOTFS_IMAGE_FSTYPE}"
part /system_b --source=rawcopy --ondisk=sda --part-name=system_b --align=1024 --size=384M --sourceparams "file=${IMGDEPLOYDIR}/${IMAGE_BASENAME}-${MACHINE}.${ROOTFS_IMAGE_FSTYPE}"
part /overlay  --size=256M --use-uuid --fstype=ext4 --label=rootfs_data --align=1024

bootloader --ptable gpt --configfile ${DEPLOY_DIR_IMAGE}/grub.cfg
```

## wic/openwrt-image-x86.wks
```
part /boot --source bootimg-pcbios --ondisk sda --label boot --active --align 1024
part / --source rootfs --use-uuid --fstype=ext4 --label rootfs --align 1024

bootloader  --timeout=0  --append="rootwait rootfstype=ext4 console=tty0 console=ttyS0,115200n8"
```

## wic/tanowrt-image-qemuarm.wks
```
part / --source rootfs --ondisk=mmcblk0 --fstype=squashfs --align=1024
part /overlay --size=16M --ondisk=mmcblk0 --fstype=ext4 --label=rootfs_data --align=1024
```
