## meta-tanowrt-hsl-rockchip/recipes-kernel/linux/linux-tano-rockchip-4.19/files/rock-pi-s/defconfig
```kconfig
# CONFIG_LOCALVERSION_AUTO is not set
CONFIG_DEFAULT_HOSTNAME="localhost"
# CONFIG_SWAP is not set
CONFIG_SYSVIPC=y
CONFIG_FHANDLE=y
CONFIG_NO_HZ=y
CONFIG_HIGH_RES_TIMERS=y
CONFIG_LOG_BUF_SHIFT=18
CONFIG_BLK_DEV_INITRD=y
# CONFIG_RD_BZIP2 is not set
# CONFIG_RD_LZMA is not set
# CONFIG_RD_XZ is not set
# CONFIG_RD_LZO is not set
# CONFIG_RD_LZ4 is not set
CONFIG_CC_OPTIMIZE_FOR_SIZE=y
CONFIG_EMBEDDED=y
# CONFIG_SLUB_DEBUG is not set
# CONFIG_COMPAT_BRK is not set
CONFIG_PROFILING=y
CONFIG_JUMP_LABEL=y
CONFIG_MODULES=y
CONFIG_MODULE_UNLOAD=y
# CONFIG_BLK_DEV_BSG is not set
CONFIG_PARTITION_ADVANCED=y
# CONFIG_RK_PARTITION is not set
# CONFIG_IOSCHED_DEADLINE is not set
# CONFIG_IOSCHED_CFQ is not set
CONFIG_ARCH_ROCKCHIP=y
# CONFIG_ARM64_ERRATUM_826319 is not set
# CONFIG_ARM64_ERRATUM_827319 is not set
# CONFIG_ARM64_ERRATUM_824069 is not set
# CONFIG_ARM64_ERRATUM_819472 is not set
# CONFIG_ARM64_ERRATUM_832075 is not set
# CONFIG_ARM64_ERRATUM_845719 is not set
# CONFIG_ARM64_ERRATUM_843419 is not set
# CONFIG_CAVIUM_ERRATUM_22375 is not set
# CONFIG_CAVIUM_ERRATUM_23154 is not set
# CONFIG_CAVIUM_ERRATUM_27456 is not set
CONFIG_SCHED_MC=y
CONFIG_NR_CPUS=4
CONFIG_PREEMPT=y
CONFIG_HZ_1000=y
# CONFIG_SPARSEMEM_VMEMMAP is not set
# CONFIG_COMPACTION is not set
# CONFIG_BOUNCE is not set
CONFIG_DEFAULT_MMAP_MIN_ADDR=32768
# CONFIG_UNMAP_KERNEL_AT_EL0 is not set
# CONFIG_ARM64_HW_AFDBM is not set
# CONFIG_ARM64_PAN is not set
# CONFIG_ARM64_UAO is not set
# CONFIG_EFI is not set
CONFIG_COMPAT=y
CONFIG_PM_DEBUG=y
CONFIG_PM_ADVANCED_DEBUG=y
CONFIG_WQ_POWER_EFFICIENT_DEFAULT=y
CONFIG_CPU_IDLE=y
# CONFIG_CPU_IDLE_GOV_LADDER is not set
CONFIG_ARM_CPUIDLE=y
CONFIG_CPU_FREQ=n
CONFIG_CPU_FREQ_DEFAULT_GOV_INTERACTIVE=n
CONFIG_CPU_FREQ_GOV_USERSPACE=n
CONFIG_CPU_FREQ_GOV_ONDEMAND=n
CONFIG_CPUFREQ_DT=y
CONFIG_ARM_ROCKCHIP_CPUFREQ=n
CONFIG_NET=y
CONFIG_PACKET=y
CONFIG_UNIX=y
CONFIG_NET_KEY=y
CONFIG_INET=y
CONFIG_SYN_COOKIES=y
# CONFIG_INET_XFRM_MODE_TRANSPORT is not set
# CONFIG_INET_XFRM_MODE_TUNNEL is not set
# CONFIG_INET_XFRM_MODE_BEET is not set
# CONFIG_INET_LRO is not set
# CONFIG_INET_DIAG is not set
# CONFIG_INET6_XFRM_MODE_TRANSPORT is not set
# CONFIG_INET6_XFRM_MODE_TUNNEL is not set
# CONFIG_INET6_XFRM_MODE_BEET is not set
# CONFIG_IPV6_SIT is not set
# CONFIG_ANDROID_PARANOID_NETWORK is not set
CONFIG_BT=n
CONFIG_BT_RFCOMM=n
CONFIG_BT_RFCOMM_TTY=n
CONFIG_BT_HIDP=n
CONFIG_BT_HCIUART=n
CONFIG_BT_HCIUART_H4=n
CONFIG_BT_HCIUART_LL=n
CONFIG_RFKILL=n
CONFIG_DEVTMPFS=y
CONFIG_DEVTMPFS_MOUNT=y
# CONFIG_ALLOW_DEV_COREDUMP is not set
CONFIG_NETDEVICES=y
CONFIG_NET_CORE=y
CONFIG_WL_ROCKCHIP=n
CONFIG_WIFI_LOAD_DRIVER_WHEN_KERNEL_BOOTUP=n
CONFIG_AP6XXX=n
# CONFIG_RTL_WIRELESS_SOLUTION is not set
# CONFIG_INPUT_MOUSEDEV is not set
CONFIG_INPUT_EVDEV=y
CONFIG_KEYBOARD_ADC=y
# CONFIG_KEYBOARD_ATKBD is not set
CONFIG_KEYBOARD_GPIO=y
# CONFIG_INPUT_MOUSE is not set
CONFIG_INPUT_MISC=y
CONFIG_INPUT_GPIO_ROTARY_ENCODER=y
# CONFIG_SERIO is not set
CONFIG_VT=y
# CONFIG_LEGACY_PTYS is not set
# CONFIG_DEVKMEM is not set
CONFIG_SERIAL_8250=y
# CONFIG_SERIAL_8250_DEPRECATED_OPTIONS is not set
CONFIG_SERIAL_8250_CONSOLE=y
CONFIG_SERIAL_8250_NR_UARTS=5
CONFIG_SERIAL_8250_RUNTIME_UARTS=5
CONFIG_SERIAL_8250_DW=y
CONFIG_HW_RANDOM=y
CONFIG_HW_RANDOM_ROCKCHIP=y
CONFIG_I2C=y
CONFIG_I2C_CHARDEV=y
CONFIG_I2C_MUX=y
CONFIG_I2C_RK3X=y
CONFIG_SPI=y
CONFIG_SPI_ROCKCHIP=y
CONFIG_SPI_SPIDEV=y
CONFIG_GPIO_SYSFS=y
CONFIG_SYSCON_REBOOT_MODE=y
CONFIG_POWER_AVS=y
CONFIG_ROCKCHIP_IODOMAIN=y
CONFIG_HWMON=y
CONFIG_THERMAL=y
CONFIG_THERMAL_WRITABLE_TRIPS=y
CONFIG_THERMAL_DEFAULT_GOV_POWER_ALLOCATOR=y
CONFIG_THERMAL_GOV_USER_SPACE=y
CONFIG_CPU_THERMAL=y
CONFIG_DEVFREQ_THERMAL=y
CONFIG_ROCKCHIP_THERMAL=y
CONFIG_WATCHDOG=y
CONFIG_DW_WATCHDOG=y
CONFIG_REGULATOR=y
CONFIG_REGULATOR_FIXED_VOLTAGE=y
CONFIG_REGULATOR_GPIO=y
# CONFIG_REGULATOR_PWM is not set
# CONFIG_SOUND is not set
# CONFIG_SND is not set
# CONFIG_HID_GENERIC is not set
CONFIG_MMC=y
CONFIG_MMC_BLOCK_MINORS=32
# CONFIG_MMC_BLOCK_BOUNCE is not set
CONFIG_MMC_DW=y
CONFIG_MMC_DW_ROCKCHIP=y
CONFIG_NEW_LEDS=y
CONFIG_LEDS_CLASS=y
CONFIG_LEDS_GPIO=y
CONFIG_LEDS_IS31FL32XX=y
CONFIG_LEDS_TRIGGERS=y
CONFIG_LEDS_TRIGGER_TIMER=y
CONFIG_LEDS_TRIGGER_ONESHOT=y
CONFIG_LEDS_TRIGGER_HEARTBEAT=y
CONFIG_LEDS_TRIGGER_DEFAULT_ON=y
CONFIG_LEDS_TRIGGER_MULTI_CTRL=y
CONFIG_LEDS_TRIGGER_DISK=y
CONFIG_LEDS_TRIGGER_CPU=y
CONFIG_LEDS_TRIGGER_ACTIVITY=y
CONFIG_RTC_CLASS=y
CONFIG_RTC_DRV_RK_TIMER=y
CONFIG_DMADEVICES=y
CONFIG_PL330_DMA=y
CONFIG_STAGING=y
# CONFIG_ANDROID_TIMED_OUTPUT is not set
# CONFIG_FIQ_DEBUGGER is not set
# CONFIG_FIQ_DEBUGGER_NO_SLEEP is not set
# CONFIG_FIQ_DEBUGGER_CONSOLE is not set
# CONFIG_FIQ_DEBUGGER_CONSOLE_DEFAULT_ENABLE is not set
# CONFIG_FIQ_DEBUGGER_TRUST_ZONE is not set
CONFIG_RK_CONSOLE_THREAD=y
# CONFIG_COMMON_CLK_XGENE is not set
# CONFIG_ARM_ARCH_TIMER_EVTSTREAM is not set
# CONFIG_IOMMU_SUPPORT is not set
# CONFIG_CPU_PX30 is not set
CONFIG_CPU_RK3308=y
# CONFIG_CPU_RK3328 is not set
# CONFIG_CPU_RK3368 is not set
# CONFIG_CPU_RK3399 is not set
CONFIG_ROCKCHIP_PM_DOMAINS=y
CONFIG_ROCKCHIP_PVTM=y
CONFIG_ROCKCHIP_SUSPEND_MODE=y
CONFIG_PM_DEVFREQ=y
CONFIG_DEVFREQ_GOV_USERSPACE=y
CONFIG_ARM_ROCKCHIP_DMC_DEVFREQ=y
CONFIG_PM_DEVFREQ_EVENT=y
CONFIG_DEVFREQ_EVENT_ROCKCHIP_NOCP=y
CONFIG_IIO=y
CONFIG_IIO_BUFFER=y
CONFIG_IIO_KFIFO_BUF=y
CONFIG_IIO_TRIGGER=y
CONFIG_ROCKCHIP_SARADC=y
CONFIG_PWM=y
CONFIG_PWM_ROCKCHIP=y
CONFIG_PHY_ROCKCHIP_INNO_USB2=y
CONFIG_PHY_ROCKCHIP_USB=y
CONFIG_ANDROID=y
CONFIG_NVMEM=y
CONFIG_ROCKCHIP_OTP=y
# CONFIG_RK_FLASH is not set
# CONFIG_RK_NANDC_NAND is not set
# CONFIG_RK_SFC_NAND is not set
# CONFIG_RK_SFC_NOR is not set
CONFIG_ROCKCHIP_SIP=y
CONFIG_EXT2_FS=y
CONFIG_EXT4_FS=y
# CONFIG_DNOTIFY is not set
CONFIG_FAT_FS=y
CONFIG_VFAT_FS=y
CONFIG_NTFS_FS=m
CONFIG_TMPFS=y
CONFIG_SQUASHFS=y
CONFIG_SQUASHFS_DECOMP_MULTI_PERCPU=y
CONFIG_SQUASHFS_4K_DEVBLK_SIZE=y
# CONFIG_PSTORE is not set
# CONFIG_PSTORE_CONSOLE is not set
# CONFIG_PSTORE_RAM is not set
# CONFIG_NETWORK_FILESYSTEMS is not set
CONFIG_PRINTK_TIME=y
CONFIG_DEBUG_INFO=y
CONFIG_DEBUG_FS=y
CONFIG_MAGIC_SYSRQ=y
CONFIG_MAGIC_SYSRQ_DEFAULT_ENABLE=0
CONFIG_LOCKUP_DETECTOR=y
CONFIG_BOOTPARAM_HARDLOCKUP_PANIC=y
CONFIG_BOOTPARAM_SOFTLOCKUP_PANIC=y
CONFIG_BOOTPARAM_HUNG_TASK_PANIC=y
CONFIG_PANIC_ON_OOPS=y
CONFIG_PANIC_TIMEOUT=1
# CONFIG_SCHED_DEBUG is not set
# CONFIG_DEBUG_PREEMPT is not set
CONFIG_RCU_CPU_STALL_TIMEOUT=60
# CONFIG_FTRACE is not set
CONFIG_STRICT_DEVMEM=y
CONFIG_DEBUG_SET_MODULE_RONX=y
# CONFIG_CRYPTO_ECHAINIV is not set
CONFIG_CRYPTO_CRC32C=y
# CONFIG_CRYPTO_HW is not set
CONFIG_ARM64_CRYPTO=y
CONFIG_CRYPTO_SHA1_ARM64_CE=y
CONFIG_CRYPTO_SHA2_ARM64_CE=y
CONFIG_CRYPTO_GHASH_ARM64_CE=y
CONFIG_CRYPTO_POLY_HASH_ARM64_CE=y
CONFIG_CRYPTO_AES_ARM64_CE_CCM=y
CONFIG_CRYPTO_AES_ARM64_CE_BLK=y
CONFIG_CRYPTO_AES_ARM64_NEON_BLK=y
CONFIG_CRYPTO_CRC32_ARM64=y
CONFIG_WIREGUARD=m

CONFIG_NUMA=y

# CONFIG_FIQ_DEBUGGER is not set
# CONFIG_RK_FLASH is not set
# CONFIG_ROCKCHIP_MTD_VENDOR_STORAGE is not set

CONFIG_BRIDGE=y
CONFIG_BRIDGE_IGMP_SNOOPING=y
CONFIG_BRIDGE_VLAN_FILTERING=y
CONFIG_VLAN_8021Q=y
CONFIG_LLC2=y
CONFIG_STP=y

# Ethernet support
CONFIG_ETHERNET=y
CONFIG_NET_VENDOR_STMICRO=y
CONFIG_STMMAC_ETH=y
CONFIG_STMMAC_PLATFORM=y
CONFIG_DWMAC_ROCKCHIP=y
CONFIG_MDIO=y

# RTC Global
CONFIG_RTC_LIB=y
CONFIG_RTC_CLASS=y
CONFIG_RTC_SYSTOHC=y
CONFIG_RTC_HCTOSYS=y
CONFIG_RTC_INTF_SYSFS=y
CONFIG_RTC_INTF_DEV=y

# RTC Haoyu H8563S
CONFIG_RTC_DRV_HYM8563=y

# Graphics
# CONFIG_DRM is not set
# CONFIG_DRM_BRIDGE is not set
# CONFIG_DRM_PANEL_BRIDGE is not set
# CONFIG_DRM_KMS_HELPER is not set
# CONFIG_DRM_KMS_FB_HELPER is not set
# CONFIG_DRM_FBDEV_EMULATION is not set
# CONFIG_DRM_FBDEV_OVERALLOC is not set
# CONFIG_DRM_FBDEV_LEAK_PHYS_SMEM is not set
# CONFIG_DRM_DP_CEC is not set
# CONFIG_DRM_GEM_CMA_HELPER is not set
# CONFIG_DRM_KMS_CMA_HELPER is not set
# CONFIG_ROCKCHIP_RGBis not set
# CONFIG_ROCKCHIP_RGA2 is not set
CONFIG_DUMMY_CONSOLE=y

# CONFIG_FB is not set
# CONFIG_FB_CFB_FILLRECT is not set
# CONFIG_FB_CFB_COPYAREA is not set
# CONFIG_FB_CFB_IMAGEBLIT is not set
# CONFIG_FB_SYS_FILLRECT is not set
# CONFIG_FB_SYS_COPYAREA is not set
# CONFIG_FB_SYS_IMAGEBLIT is not set
# CONFIG_FB_SYS_FOPS is not set
# CONFIG_FB_DEFERRED_IO is not set
# CONFIG_FB_BACKLIGHT is not set
# CONFIG_FB_MODE_HELPERS is not set

# CONFIG_FB_SIMPLE is not set
# CONFIG_VIDEOMODE_HELPERS is not set

# CONFIG_FRAMEBUFFER_CONSOLE is not set
# CONFIG_FRAMEBUFFER_CONSOLE_DETECT_PRIMARY is not set
# CONFIG_FRAMEBUFFER_CONSOLE_ROTATION is not set
# CONFIG_FRAMEBUFFER_CONSOLE_DEFERRED_TAKEOVER is not set

CONFIG_SCSI_MOD=y
# CONFIG_RAID_ATTRS is not set
CONFIG_SCSI=y
CONFIG_SCSI_DMA=y
CONFIG_SCSI_MQ_DEFAULT=y
CONFIG_SCSI_PROC_FS=y
CONFIG_SCSI_SCAN_ASYNC=y

CONFIG_BLK_DEV=y
CONFIG_BLK_DEV_LOOP=y
CONFIG_BLK_DEV_LOOP_MIN_COUNT=8
CONFIG_BLK_DEV_RAM=y
CONFIG_BLK_DEV_RAM_COUNT=1
CONFIG_BLK_DEV_RAM_SIZE=4096
CONFIG_BLK_DEV_SD=y
CONFIG_BLK_DEV_SR=y

# USB
CONFIG_USB_SUPPORT=y
CONFIG_USB_EHCI_HCD=y
CONFIG_USB_EHCI_HCD_PLATFORM=y
CONFIG_USB_OHCI_HCD=y
CONFIG_USB_OHCI_HCD_PLATFORM=y
CONFIG_USB_HIDDEV=y
CONFIG_USB_STORAGE=y

CONFIG_USB_DWC2=y
CONFIG_USB_GADGET=y
CONFIG_USB_GADGET_DEBUG_FILES=y
CONFIG_USB_GADGET_VBUS_DRAW=500
CONFIG_USB_CONFIGFS=y
CONFIG_USB_CONFIGFS_F_FS=y
CONFIG_USB_CONFIGFS_UEVENT=y
CONFIG_USB_ETH=m
CONFIG_USB_ETH_RNDIS=m

CONFIG_SWIOTLB=y

CONFIG_INLINE_READ_LOCK=y
CONFIG_INLINE_READ_LOCK_BH=y
CONFIG_INLINE_READ_LOCK_IRQ=y
CONFIG_INLINE_READ_LOCK_IRQSAVE=y
CONFIG_INLINE_READ_UNLOCK_BH=y
CONFIG_INLINE_READ_UNLOCK_IRQRESTORE=y
CONFIG_INLINE_SPIN_LOCK=y
CONFIG_INLINE_SPIN_LOCK_BH=y
CONFIG_INLINE_SPIN_LOCK_IRQ=y
CONFIG_INLINE_SPIN_LOCK_IRQSAVE=y
CONFIG_INLINE_SPIN_TRYLOCK=y
CONFIG_INLINE_SPIN_TRYLOCK_BH=y
CONFIG_INLINE_SPIN_UNLOCK_BH=y
CONFIG_INLINE_SPIN_UNLOCK_IRQRESTORE=y
CONFIG_INLINE_WRITE_LOCK=y
CONFIG_INLINE_WRITE_LOCK_BH=y
CONFIG_INLINE_WRITE_LOCK_IRQ=y
CONFIG_INLINE_WRITE_LOCK_IRQSAVE=y
CONFIG_INLINE_WRITE_UNLOCK_BH=y
CONFIG_INLINE_WRITE_UNLOCK_IRQRESTORE=y

CONFIG_CMA=y
CONFIG_DMA_CMA=y
CONFIG_CMA_SIZE_MBYTES=32
```

## meta-tanowrt-hsl-rpi/conf/layer.conf
```bitbake
#
# SPDX-License-Identifier: MIT
# Copyright (c) 2020 Tano Systems LLC. All rights reserved.
#

# Layer version
LAYERVERSION = "1"

# We have a conf and classes directory, append to BBPATH
BBPATH .= ":${LAYERDIR}"

# We have a recipes directory, add to BBFILES
BBFILES += "${LAYERDIR}/recipes*/*/*.bb \
            ${LAYERDIR}/recipes*/*/*.bbappend"

BBFILE_COLLECTIONS += "meta-tanowrt-hsl-rpi"
BBFILE_PATTERN_meta-tanowrt-hsl-rpi := "^${LAYERDIR}/"
BBFILE_PRIORITY_meta-tanowrt-hsl-rpi = "17"

LICENSE_PATH += "${LAYERDIR}/licenses"

LAYERDEPENDS_meta-tanowrt-hsl-rpi = "\
	meta-tanowrt \
	raspberrypi \
	core \
	openembedded-layer \
	networking-layer \
	meta-python \
	multimedia-layer \
"

LAYERSERIES_COMPAT_meta-tanowrt-hsl-rpi = "dunfell"

# Set a variable to get the top of the metadata location
TANOWRT_HSL_BASE = '${@os.path.normpath("${LAYERDIR}/")}'
```

## meta-tanowrt-hsl-rpi/conf/machine/include/rpi3.inc
```bitbake
#
# SPDX-License-Identifier: MIT
# Copyright (c) 2020-2021 Tano Systems LLC. All rights reserved.
#
MACHINEOVERRIDES =. "rpi3:raspberrypi3:"
require conf/machine/raspberrypi3.conf

PACKAGECONFIG_append_pn-fstools = " ovl-f2fs ovl-rootdisk-part "

IMAGE_CLASSES += "sdimage-rpi-helper"
IMAGE_FSTYPES = "wic"
WKS_FILE = "sdimage-rpi.wks"
WIC_CREATE_EXTRA_ARGS = "--no-fstab-update"

PREFERRED_PROVIDER_virtual/kernel = "linux-tano-rpi"
PREFERRED_VERSION_linux-tano-rpi = "5.10.%"
LINUXLIBCVERSION = "5.10%"
SDKLINUXLIBCVERSION = "5.10%"
WIREGUARD_PATCH_RPI_4_19 = "0"

# Set to "1" for kernels 5.6+
TANOWRT_WIREGUARD_IN_KERNEL = "1"

# Switch from linux-firmware-rpidistro to cypress-firmware
MACHINE_EXTRA_RRECOMMENDS_remove = "\
    linux-firmware-rpidistro-bcm43430 \
    linux-firmware-rpidistro-bcm43455 \
"

MACHINE_EXTRA_RRECOMMENDS_append = "\
    cypress-firmware-43430-sdio \
    cypress-firmware-43455-sdio \
    cypress-nvram-43430-sdio-rpi-3b \
    cypress-nvram-43455-sdio-rpi-3b-plus \
"

MACHINE_EXTRA_RDEPENDS += "linux-backports"
LINUX_BACKPORTS_CONFIGS = "brcmfmac brcmsmac"

RPI_KERNEL_DEVICETREE_OVERLAYS = " \
    overlays/at86rf233.dtbo \
    overlays/disable-bt.dtbo \
    overlays/dwc2.dtbo \
    overlays/gpio-key.dtbo \
    overlays/hifiberry-amp.dtbo \
    overlays/hifiberry-dac.dtbo \
    overlays/hifiberry-dacplus.dtbo \
    overlays/hifiberry-digi.dtbo \
    overlays/i2c-rtc.dtbo \
    overlays/iqaudio-dac.dtbo \
    overlays/iqaudio-dacplus.dtbo \
    overlays/miniuart-bt.dtbo \
    overlays/mcp2515-can0.dtbo \
    overlays/pitft22.dtbo \
    overlays/pitft28-resistive.dtbo \
    overlays/pitft28-capacitive.dtbo \
    overlays/pitft35-resistive.dtbo \
    overlays/pps-gpio.dtbo \
    overlays/rpi-ft5406.dtbo \
    overlays/rpi-poe.dtbo \
    overlays/vc4-kms-v3d.dtbo \
    overlays/vc4-fkms-v3d.dtbo \
    overlays/w1-gpio-pullup.dtbo \
    overlays/w1-gpio.dtbo \
    overlays/gpio-ir.dtbo \
    overlays/gpio-ir-tx.dtbo \
"

# Load vc4 module before psplash
KERNEL_MODULE_AUTOLOAD_append = " vc4"
KERNEL_MODULE_AUTOLOAD_EARLY_append = " vc4"

SERIAL_CONSOLES = ""
KERNEL_SERIAL = ""

SPLASH = "psplash"
IMAGE_FEATURES += "splash"

RPI_USE_U_BOOT = "1"

# Used in rpi-cmdline recipe
CMDLINE_ROOTFS = "root=/dev/mmcblk0p2 ro rootfstype=squashfs rootwait"

GPU_MEM ?= "256"
ENABLE_UART ?= "1"
ENABLE_SPI_BUS ?= "1"
ENABLE_I2C ?= "1"

MACHINE_FEATURES += "ethernet"
MACHINE_FEATURES += "wifi"
MACHINE_FEATURES += "cgroup"
MACHINE_FEATURES += "lldp"
MACHINE_FEATURES += "watchdog"
MACHINE_FEATURES += "opengl"
MACHINE_FEATURES += "crypto"
MACHINE_FEATURES += "hwrng"
MACHINE_FEATURES += "alsa"

PACKAGECONFIG_append_pn-collectd = " cpufreq "
PACKAGE_ARCH_pn-collectd = "${MACHINE_ARCH}"

# No qemu support, yet
MACHINE_FEATURES_remove = "qemu-usermode"

MACHINE_EXTRA_RDEPENDS += "raspi-gpio"

MACHINE_EXTRA_RDEPENDS += "\
	${@bb.utils.contains('RPI_USE_U_BOOT', '1', 'libubootenv', '', d)}"

#
# OpenWrt specific
#
OPENWRT_VERSION_PRODUCT = "Raspberry Pi 3 Model B+"
OPENWRT_VERSION_HWREV = "v1"
```

## meta-tanowrt-hsl-rpi/conf/machine/rpi3-sd.conf
```bitbake
#@TYPE: Machine
#@NAME: RaspberryPi 3 Model B+ Development Board (32bit)
#@DESCRIPTION: Machine configuration for the RaspberryPi 3 in 32 bits mode

require conf/machine/include/rpi3.inc

RPI_KERNEL_DEVICETREE = " \
    bcm2710-rpi-3-b.dtb \
    bcm2710-rpi-3-b-plus.dtb \
    bcm2837-rpi-3-b.dtb \
    bcm2837-rpi-3-b-plus.dtb \
"

TANOWRT_ENABLE_OVERLAY_RESIZE = "1"
```

## meta-tanowrt-hsl-rpi/wic/sdimage-rpi.wks
```
#
# short-description: Create SD card image with a boot partition
#
# long-description: Creates a partitioned SD card image:
#   - Boot files are located in the first vfat partition.
#   - Rootfs are located in the second squashfs parition.
#   - Third ext4 partition is for the overlay filesystem and
#     will be created automatically at first boot.
#
part --source bootimg-partition --fstype=vfat --label boot --ondisk mmcblk0 --active --align 4096 --size 20
part / --source rootfs --ondisk mmcblk0 --fstype=squashfs --align 4096
part /overlay --size=32M --use-uuid --fstype=ext4 --label=rootfs_data --align=1024
```
