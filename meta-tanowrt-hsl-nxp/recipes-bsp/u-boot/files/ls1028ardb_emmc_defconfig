## meta-tanowrt-hsl-rockchip/conf/machine/include/hsl-rockchip-swu-estorage.inc
```bitbake
#
# SPDX-License-Identifier: MIT
# Copyright (c) 2022 Tano Systems LLC. All rights reserved.
#

#
# SWUpdate
#
SWU_UBOOT_CONFIG ?= "emmc"
SWU_UBOOT_CONFIG_FACTORY ?= "sdcard"
SWU_IMAGE_DEV ?= "/dev/mmcblk0"
SWU_IMAGE_MEDIA_TYPE ?= "eMMC"
SWU_OVERLAY_CONTAINER ?= "blkdev"
SWU_OVERLAY_FS ?= "ext4"

OPENWRT_VERSION_PRODUCT_EXTRA = " (eMMC)"

MACHINE_FEATURES_append = " swupdate-factory"

WKS_IMAGE_IDBLOCK_BINARY = "${RK_IMAGE_IDBLOCK}-${MACHINE}-${SWU_UBOOT_CONFIG}"
WKS_IMAGE_UBOOT_INITIAL_ENV_BINARY = "u-boot-initial-env-${MACHINE}-${SWU_UBOOT_CONFIG}.bin"

# Do not need auto overlay resizing for eMMC
TANOWRT_ENABLE_OVERLAY_RESIZE = "0"

#
# Initramfs (used for factory installation image)
#
INITRAMFS_IMAGE = "tanowrt-image-initramfs-swu-factory"
INITRAMFS_IMAGE_NAME = "${INITRAMFS_IMAGE}-${MACHINE}"
INITRAMFS_IMAGE_BUNDLE = "0"

SWU_INSTALL_EXTRA_RDEPENDS += "gptfdisk parted mmc-utils"

SWU_IMAGE_ARTIFACT_idblock[fname] = "idblock.img-${MACHINE}-${SWU_UBOOT_CONFIG}"
SWU_IMAGE_ARTIFACT_idblock[ftype] = ""
SWU_IMAGE_ARTIFACT_idblock[sw-desc-type] = "raw"
SWU_IMAGE_ARTIFACT_idblock[sw-desc-device] = "${SWU_IMAGE_DEV}"
SWU_IMAGE_ARTIFACT_idblock[sw-desc-offset] = "${RK_IDBLOCK_OFFSET}"

SWU_IMAGE_ARTIFACT_uboot[ftype] = "bin-${SWU_UBOOT_CONFIG}"
SWU_IMAGE_ARTIFACT_uboot[sw-desc-type] = "raw"
SWU_IMAGE_ARTIFACT_uboot[sw-desc-device] = "${SWU_IMAGE_DEV}p1"

SWU_IMAGE_ARTIFACT_startup[sw-desc-type] = "raw"
SWU_IMAGE_ARTIFACT_startup[sw-desc-device] = "${SWU_IMAGE_DEV}"
SWU_IMAGE_ARTIFACT_startup[sw-desc-offset] = "${RK_STARTUP_OFFSET}"

SWU_IMAGE_ARTIFACT_kernel[ftype] = "ext4"
SWU_IMAGE_ARTIFACT_kernel[sw-desc-device-a] = "${SWU_IMAGE_DEV}p2"
SWU_IMAGE_ARTIFACT_kernel[sw-desc-device-b] = "${SWU_IMAGE_DEV}p4"
SWU_IMAGE_ARTIFACT_kernel[sw-desc-type] = "raw"

SWU_IMAGE_ARTIFACT_rootfs[sw-desc-device-a] = "${SWU_IMAGE_DEV}p3"
SWU_IMAGE_ARTIFACT_rootfs[sw-desc-device-b] = "${SWU_IMAGE_DEV}p5"


# Factory image creation
SWU_FACTORY_WKS_FILE ?= "sdimage-rockchip-swu-factory.wks.in"
SWU_FACTORY_EXTRA_DEPENDS += "\
	u-boot-startup-script:do_deploy \
	virtual/bootloader:do_deploy \
	virtual/kernel:do_deploy \
"
SWU_FACTORY_EXTRA_FILES = "\
	u-boot-initial-env-${SWU_UBOOT_CONFIG}.bin;u-boot-initial-env.bin \
"

# These variables are used in sdimage-rockchip-swu-factory.wks.in
WKS_FACTORY_IMAGE_IDBLOCK_BINARY = "idblock.img-${MACHINE}-${SWU_UBOOT_CONFIG_FACTORY}"
WKS_FACTORY_IMAGE_STARTUP_BINARY = "startup-factory-${MACHINE}.img"
WKS_FACTORY_IMAGE_KERNEL_BINARY = "fitImage-${INITRAMFS_IMAGE}-${MACHINE}.ext4"
WKS_FACTORY_IMAGE_UBOOT_BINARY = "${UBOOT_BINARY}-${SWU_UBOOT_CONFIG_FACTORY}"
WKS_FACTORY_IMAGE_UBOOT_INITIAL_ENV_BINARY = "u-boot-initial-env-${MACHINE}-${SWU_UBOOT_CONFIG_FACTORY}.bin"
```

## meta-tanowrt-hsl-rockchip/conf/machine/include/hsl-rockchip-swu-sd.inc
```bitbake
#
# SPDX-License-Identifier: MIT
# Copyright (c) 2022 Tano Systems LLC. All rights reserved.
#

#
# SWUpdate
#

OPENWRT_VERSION_PRODUCT_EXTRA = " (SD)"

WKS_IMAGE_IDBLOCK_BINARY = "${RK_IMAGE_IDBLOCK}-${MACHINE}-sdcard"
WKS_IMAGE_UBOOT_INITIAL_ENV_BINARY = "u-boot-initial-env-${MACHINE}-sdcard.bin"

SWU_OVERLAY_CONTAINER = "blkdev"
SWU_OVERLAY_FS = "ext4"

SWU_IMAGE_DEV ?= "/dev/mmcblk1"
SWU_IMAGE_MEDIA_TYPE ?= "SD Card"

SWU_IMAGE_ARTIFACT_idblock[fname] = "idblock.img-${MACHINE}-sdcard"
SWU_IMAGE_ARTIFACT_idblock[ftype] = ""
SWU_IMAGE_ARTIFACT_idblock[sw-desc-type] = "raw"
SWU_IMAGE_ARTIFACT_idblock[sw-desc-device] = "${SWU_IMAGE_DEV}"
SWU_IMAGE_ARTIFACT_idblock[sw-desc-offset] = "${RK_IDBLOCK_OFFSET}"

SWU_IMAGE_ARTIFACT_uboot[ftype] = "bin-sdcard"
SWU_IMAGE_ARTIFACT_uboot[sw-desc-type] = "raw"
SWU_IMAGE_ARTIFACT_uboot[sw-desc-device] = "${SWU_IMAGE_DEV}p1"

SWU_IMAGE_ARTIFACT_startup[sw-desc-type] = "raw"
SWU_IMAGE_ARTIFACT_startup[sw-desc-device] = "${SWU_IMAGE_DEV}"
SWU_IMAGE_ARTIFACT_startup[sw-desc-offset] = "${RK_STARTUP_OFFSET}"

SWU_IMAGE_ARTIFACT_kernel[ftype] = "ext4"
SWU_IMAGE_ARTIFACT_kernel[sw-desc-device-a] = "${SWU_IMAGE_DEV}p2"
SWU_IMAGE_ARTIFACT_kernel[sw-desc-device-b] = "${SWU_IMAGE_DEV}p4"
SWU_IMAGE_ARTIFACT_kernel[sw-desc-type] = "raw"

SWU_IMAGE_ARTIFACT_rootfs[sw-desc-device-a] = "${SWU_IMAGE_DEV}p3"
SWU_IMAGE_ARTIFACT_rootfs[sw-desc-device-b] = "${SWU_IMAGE_DEV}p5"
```

## meta-tanowrt-hsl-rockchip/conf/machine/include/hsl-rockchip-swu-sdnand.inc
```bitbake
#
# SPDX-License-Identifier: MIT
# Copyright (c) 2022 Tano Systems LLC. All rights reserved.
#

SWU_UBOOT_CONFIG = "sdnand"
SWU_UBOOT_CONFIG_FACTORY = "sdcard"

require hsl-rockchip-swu-estorage.inc

SWU_IMAGE_MEDIA_TYPE = "SDNAND"
OPENWRT_VERSION_PRODUCT_EXTRA = " (SD NAND)"
```

## meta-tanowrt-hsl-rockchip/conf/machine/include/rock-pi-s.inc
```bitbake
# Copyright (c) 2019, Fuzhou Rockchip Electronics Co., Ltd
# Copyright (c) 2022, Tano Systems LLC
# Released under the MIT license (see COPYING.MIT for the terms)

MACHINEOVERRIDES =. "rock-pi-s:"

require conf/machine/include/hsl-rk3308.inc

SERIAL_CONSOLES = "1500000;ttyS0"

KERNEL_DEVICETREE = "rockchip/rk3308-rock-pi-s.dtb"

RK_WIFIBT_FIRMWARES = ""

MACHINE_EXTRA_RDEPENDS_append = " \
	i2c-tools \
"

# Enable multilib support
require conf/multilib.conf
MULTILIBS = "multilib:lib32"
DEFAULTTUNE_virtclass-multilib-lib32 = "armv7vethf-neon"

RKBIN_DDR_UART_UPDATE = "1"
RKBIN_DDR_UART_ID = "0"
RKBIN_DDR_UART_IOMUX = "0"
RKBIN_DDR_UART_BAUDRATE = "1500000"

OPENWRT_VERSION_PRODUCT_EXTRA ?= ""
OPENWRT_VERSION_PRODUCT = "Radxa ROCK Pi S${OPENWRT_VERSION_PRODUCT_EXTRA}"
OPENWRT_VERSION_HWREV = "v1.3"

TANOWRT_ENABLE_OVERLAY_RESIZE = "1"
```

## meta-tanowrt-hsl-rockchip/conf/machine/rock-pi-s-sd.conf
```bitbake
#@TYPE: Machine
#@Name: Radxa ROCK Pi S (SD)
#@DESCRIPTION: Machine configuration for ROCK Pi S running on SD card

require include/rock-pi-s.inc
require include/hsl-rockchip-swu.inc
require include/hsl-rockchip-swu-sd.inc

#
# Bootloader
#
UBOOT_CONFIG = "sdcard"
UBOOT_CONFIG[sdcard] = "rock-pi-s-sd_defconfig,,uboot.img"

#
# Image
#
TANOWRT_PARTUUID_BOOT        = "284e6970-1353-4ab1-9959-584e8863b32c"
TANOWRT_PARTUUID_OVERLAY     = "30d7ecd4-1208-4e58-b8c8-7c4f818be190"
TANOWRT_PARTUUID_ROOTDEV_A   = "b626e226-cafe-480e-be29-2ed7e6e53d37"
TANOWRT_PARTUUID_ROOTDEV_B   = "46c9c7cc-b228-48e9-9327-0bff70755f40"
TANOWRT_PARTUUID_KERNELDEV_A = "cb17165c-29fa-4643-a4ea-dfbe9426d5db"
TANOWRT_PARTUUID_KERNELDEV_B = "b3f26b3e-5c50-49b2-a265-9284dd5257c9"

#
# SWUpdate
#
SWU_BOARD = "rock-pi-s-sd"
SWU_REVISION = "1.0"
```

## meta-tanowrt-hsl-rockchip/conf/machine/rock-pi-s-sdnand.conf
```bitbake
#@TYPE: Machine
#@Name: Radxa ROCK Pi S (SD NAND)
#@DESCRIPTION: Machine configuration for ROCK Pi S running on SD NAND flash

require include/rock-pi-s.inc
require include/hsl-rockchip-swu.inc
require include/hsl-rockchip-swu-sdnand.inc

#
# Bootloader
#
UBOOT_CONFIG = "sdcard sdnand"
UBOOT_CONFIG[sdcard] = "rock-pi-s-sd_defconfig,,uboot.img"
UBOOT_CONFIG[sdnand] = "rock-pi-s-sdnand_defconfig,,uboot.img"

#
# Image
#
TANOWRT_PARTUUID_BOOT        = "dc8f9328-92f5-497e-a845-6f564ef32034"
TANOWRT_PARTUUID_OVERLAY     = "8b06d263-67ab-452e-a126-cc8345d60f9c"
TANOWRT_PARTUUID_ROOTDEV_A   = "d3aa42ba-48e8-4d08-9676-f630d3746140"
TANOWRT_PARTUUID_ROOTDEV_B   = "ec087a31-9005-49df-b77b-d7c4312a0511"
TANOWRT_PARTUUID_KERNELDEV_A = "a0a965a8-8328-4540-8543-786c9e88b7b8"
TANOWRT_PARTUUID_KERNELDEV_B = "ec341c88-9b34-4027-9e7e-33c5900c95f6"

#
# SWUpdate
#
SWU_BOARD = "rock-pi-s-sdnand"
SWU_REVISION = "1.0"
```
