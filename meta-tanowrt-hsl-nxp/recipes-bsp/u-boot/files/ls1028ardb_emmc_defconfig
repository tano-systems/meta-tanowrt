## meta-tanowrt-hsl-nxp/recipes-bsp/u-boot/files/ls1028ardb_emmc_defconfig
```kconfig
CONFIG_ARM=y
CONFIG_TARGET_LS1028ARDB=y
CONFIG_FSL_LS_PPA=y
CONFIG_SPL_LIBCOMMON_SUPPORT=y
CONFIG_SPL_LIBGENERIC_SUPPORT=y
CONFIG_SPL_MMC_SUPPORT=y
CONFIG_SPL_SERIAL_SUPPORT=y
CONFIG_SPL_DRIVERS_MISC_SUPPORT=y
CONFIG_SPL_WATCHDOG_SUPPORT=y
CONFIG_DEFAULT_DEVICE_TREE="fsl-ls1028a-rdb"
# CONFIG_SYS_MALLOC_F is not set
CONFIG_FIT=y
CONFIG_FIT_VERBOSE=y
CONFIG_EFI_PARTITION=y
CONFIG_OF_BOARD_SETUP=y
CONFIG_EMMC_BOOT=y
CONFIG_OF_STDOUT_VIA_ALIAS=y
CONFIG_BOOTDELAY=3
CONFIG_USE_BOOTCOMMAND=y
CONFIG_BOOTCOMMAND="mmc dev 1; mmc read ${scriptaddr} 0x1c00 0x100; source ${scriptaddr}"
# CONFIG_USE_BOOTARGS is not set
CONFIG_HUSH_PARSER=y
CONFIG_SPL=y
CONFIG_SPL_BOARD_INIT=y
CONFIG_SYS_FSL_SDHC_CLK_DIV=1
CONFIG_SYS_MMCSD_RAW_MODE_U_BOOT_USE_SECTOR=y
CONFIG_SYS_MMCSD_RAW_MODE_U_BOOT_SECTOR=0x8b0
CONFIG_SPL_ENV_SUPPORT=y
CONFIG_SPL_MPC8XXX_INIT_DDR_SUPPORT=y
CONFIG_CMD_GREPENV=y
CONFIG_CMD_GPT=y
CONFIG_CMD_I2C=y
CONFIG_CMD_MMC=y
CONFIG_CMD_PCI=y
CONFIG_CMD_SF=y
CONFIG_CMD_USB=y
CONFIG_CMD_SETEXPR=y
CONFIG_CMD_MII=y
CONFIG_CMD_PING=y
CONFIG_CMD_CACHE=y
CONFIG_CMD_EXT2=y
CONFIG_CMD_FAT=y
CONFIG_CMD_SOURCE=y
CONFIG_OF_CONTROL=y
CONFIG_ENV_IS_IN_MMC=y
CONFIG_SYS_REDUNDAND_ENVIRONMENT=y
CONFIG_NET_RANDOM_ETHADDR=y
CONFIG_NETCONSOLE=y
CONFIG_DM=y
CONFIG_SCSI_AHCI=y
CONFIG_FSL_CAAM=y
CONFIG_DM_MMC=y
CONFIG_DM_SPI_FLASH=y
CONFIG_SPI_FLASH=y
CONFIG_SPI_FLASH_SPANSION=y
CONFIG_SPI_FLASH_STMICRO=y
# CONFIG_SPI_FLASH_USE_4K_SECTORS is not set
CONFIG_PHYLIB=y
CONFIG_PHY_ATHEROS=y
CONFIG_DM_ETH=y
CONFIG_PHY_GIGE=y
CONFIG_E1000=y
CONFIG_FSL_ENETC=y
CONFIG_PCI=y
CONFIG_DM_PCI=y
CONFIG_DM_PCI_COMPAT=y
CONFIG_PCIE_LAYERSCAPE=y
CONFIG_SCSI=y
CONFIG_SYS_FSL_SDHC_CLK_DIV=1
CONFIG_SYS_NS16550=y
CONFIG_DM_SPI=y
CONFIG_FSL_DSPI=y
CONFIG_NXP_FSPI=y
CONFIG_FSPI_AHB_EN_4BYTE=y
CONFIG_USB=y
CONFIG_DM_USB=y
CONFIG_USB_XHCI_HCD=y
CONFIG_USB_XHCI_DWC3=y
CONFIG_USB_STORAGE=y
CONFIG_VIDEO=y
CONFIG_EFI_LOADER_BOUNCE_BUFFER=y
CONFIG_DM_SCSI=y
CONFIG_SATA_CEVA=y
CONFIG_AHCI=y
CONFIG_DISTRO_DEFAULTS=y
CONFIG_CMD_DHCP=y
CONFIG_VIDEO_IMX_HDP_LOAD=y
CONFIG_OF_LIBFDT_OVERLAY=y

CONFIG_SYS_LS_PPA_FW_IN_MMC=y
CONFIG_SYS_LS_PPA_FW_ADDR=0x00340000
```

## meta-tanowrt-hsl-rockchip/conf/layer.conf
```bitbake
# Layer version
LAYERVERSION = "1"

# We have a conf and classes directory, append to BBPATH
BBPATH .= ":${LAYERDIR}"

# We have a recipes directory, add to BBFILES
BBFILES += "${LAYERDIR}/recipes*/*/*.bb \
            ${LAYERDIR}/recipes*/*/*.bbappend"

BBFILE_COLLECTIONS += "meta-tanowrt-hsl-rockchip"
BBFILE_PATTERN_meta-tanowrt-hsl-rockchip := "^${LAYERDIR}/"
BBFILE_PRIORITY_meta-tanowrt-hsl-rockchip = "17"

LAYERDEPENDS_meta-tanowrt-hsl-rockchip = "\
	meta-tanowrt \
	rockchip \
	core \
	openembedded-layer \
	networking-layer \
	meta-python \
	multimedia-layer \
"

LAYERSERIES_COMPAT_meta-tanowrt-hsl-rockchip = "hardknott"

# Set a variable to get the top of the metadata location
TANOWRT_HSL_BASE = '${@os.path.normpath("${LAYERDIR}/")}'

NON_MULTILIB_RECIPES += "virtual/bootloader"

#
# Dynamic layers
#
BBFILES_DYNAMIC += "\
	qt5-layer:${LAYERDIR}/layers-dynamic/meta-qt5/*/*/*.bb \
	qt5-layer:${LAYERDIR}/layers-dynamic/meta-qt5/*/*/*.bbappend \
"
```

## meta-tanowrt-hsl-rockchip/conf/machine/boardcon-em3568-emmc.conf
```bitbake
#@TYPE: Machine
#@Name: Boardcon EM3568 SBC (eMMC)
#@DESCRIPTION: Machine configuration for Boardcon EM3568 Single-Board Computer running on internal eMMC flash

require include/boardcon-em3568.inc
require include/hsl-rockchip-swu.inc
require include/hsl-rockchip-swu-emmc.inc

MACHINEOVERRIDES =. "boardcon-emmc:"

#
# Bootloader
#
UBOOT_CONFIG = "sdcard emmc"
UBOOT_CONFIG[sdcard] = "boardcon-em3568-sd_defconfig,,uboot.img"
UBOOT_CONFIG[emmc] = "boardcon-em3568-emmc_defconfig,,uboot.img"

#
# Image
#
TANOWRT_PARTUUID_BOOT        = "dc8f9328-92f5-497e-a845-6f564ef32034"
TANOWRT_PARTUUID_OVERLAY     = "8b06d263-67ab-452e-a126-cc8345d60f9c"
TANOWRT_PARTUUID_ROOTDEV_A   = "d3aa42ba-48e8-4d08-9676-f630d3746140"
TANOWRT_PARTUUID_ROOTDEV_B   = "ec087a31-9005-49df-b77b-d7c4312a0511"
TANOWRT_PARTUUID_KERNELDEV_A = "a0a965a8-8328-4540-8543-786c9e88b7b8"
TANOWRT_PARTUUID_KERNELDEV_B = "ec341c88-9b34-4027-9e7e-33c5900c95f6"

#
# SWUpdate
#
SWU_BOARD = "boardcon-em3568-emmc"
SWU_REVISION = "1.0"
```

## meta-tanowrt-hsl-rockchip/conf/machine/boardcon-em3568-sd.conf
```bitbake
#@TYPE: Machine
#@Name: Boardcon EM3568 SBC (SD)
#@DESCRIPTION: Machine configuration for Boardcon EM3568 Single-Board Computer running on SD card

require include/boardcon-em3568.inc
require include/hsl-rockchip-swu.inc
require include/hsl-rockchip-swu-sd.inc

MACHINEOVERRIDES =. "boardcon-sd:"

#
# Bootloader
#
UBOOT_CONFIG = "sdcard"
UBOOT_CONFIG[sdcard] = "boardcon-em3568-sd_defconfig,,uboot.img"

#
# Image
#
TANOWRT_PARTUUID_BOOT        = "284e6970-1353-4ab1-9959-584e8863b32c"
TANOWRT_PARTUUID_OVERLAY     = "30d7ecd4-1208-4e58-b8c8-7c4f818be190"
TANOWRT_PARTUUID_ROOTDEV_A   = "b626e226-cafe-480e-be29-2ed7e6e53d37"
TANOWRT_PARTUUID_ROOTDEV_B   = "46c9c7cc-b228-48e9-9327-0bff70755f40"
TANOWRT_PARTUUID_KERNELDEV_A = "cb17165c-29fa-4643-a4ea-dfbe9426d5db"
TANOWRT_PARTUUID_KERNELDEV_B = "b3f26b3e-5c50-49b2-a265-9284dd5257c9"

#
# SWUpdate
#
SWU_BOARD = "boardcon-em3568-sd"
SWU_REVISION = "1.0"
```

## meta-tanowrt-hsl-rockchip/conf/machine/include/boardcon-em3566.inc
```bitbake
# Copyright (c) 2019, Fuzhou Rockchip Electronics Co., Ltd
# Copyright (c) 2022, Tano Systems LLC
# Released under the MIT license (see COPYING.MIT for the terms)

MACHINEOVERRIDES =. "boardcon-em356x:"
MACHINEOVERRIDES =. "boardcon-em3566:"

require conf/machine/include/hsl-rk356x.inc
require conf/machine/include/boardcon-em356x.inc

RK_WIFIBT_FIRMWARES = ""

KERNEL_DEVICETREE = "rockchip/boardcon-em3566.dtb"

RKBIN_DDR_UART_UPDATE = "1"
RKBIN_DDR_UART_ID = "4"
RKBIN_DDR_UART_IOMUX = "0"
RKBIN_DDR_UART_BAUDRATE = "1500000"

OPENWRT_VERSION_PRODUCT_EXTRA ?= ""
OPENWRT_VERSION_PRODUCT = "Boardcon EM3566 SBC${OPENWRT_VERSION_PRODUCT_EXTRA}"
OPENWRT_VERSION_HWREV = "v2"

TANOWRT_ENABLE_OVERLAY_RESIZE = "1"
```

## meta-tanowrt-hsl-rockchip/conf/machine/include/boardcon-em3568.inc
```bitbake
# Copyright (c) 2019, Fuzhou Rockchip Electronics Co., Ltd
# Copyright (c) 2022, Tano Systems LLC
# Released under the MIT license (see COPYING.MIT for the terms)

MACHINEOVERRIDES =. "boardcon-em356x:"
MACHINEOVERRIDES =. "boardcon-em3568:"

require conf/machine/include/hsl-rk356x.inc
require conf/machine/include/boardcon-em356x.inc

RK_WIFIBT_FIRMWARES = " \
	rkwifibt-firmware-rtl8723du-bt \
"

MACHINE_FEATURES += "stp"

KERNEL_DEVICETREE = "rockchip/boardcon-em3568.dtb"

RKBIN_DDR_UART_UPDATE = "1"
RKBIN_DDR_UART_ID = "2"
RKBIN_DDR_UART_IOMUX = "0"
RKBIN_DDR_UART_BAUDRATE = "1500000"

OPENWRT_VERSION_PRODUCT_EXTRA ?= ""
OPENWRT_VERSION_PRODUCT = "Boardcon EM3568 SBC${OPENWRT_VERSION_PRODUCT_EXTRA}"
OPENWRT_VERSION_HWREV = "v2"

TANOWRT_ENABLE_OVERLAY_RESIZE = "1"
```

## meta-tanowrt-hsl-rockchip/conf/machine/include/boardcon-em356x.inc
```bitbake
# Copyright (c) 2022, Tano Systems LLC
# Released under the MIT license (see COPYING.MIT for the terms)

MACHINE_EXTRA_RRECOMMENDS:append = " \
	drm-cursor \
"

MACHINE_EXTRA_RDEPENDS:append = " \
	i2c-tools \
"

# Enable multilib support
require conf/multilib.conf
MULTILIBS = "multilib:lib32"
DEFAULTTUNE:virtclass-multilib-lib32 = "armv7vethf-neon"
```

## meta-tanowrt-hsl-rockchip/conf/machine/include/hsl-rk3308.inc
```bitbake
# Copyright (c) 2019, Fuzhou Rockchip Electronics Co., Ltd
# Copyright (c) 2022, Tano Systems LLC
# Released under the MIT license (see COPYING.MIT for the terms)

SOC_FAMILY ?= "rk3308"

DEFAULTTUNE ?= "cortexa35-crypto"
require conf/machine/include/arm/armv8a/tune-cortexa35.inc
require conf/machine/include/hsl-rockchip-arm64-common.inc

# 4.19
PREFERRED_PROVIDER_virtual/kernel = "linux-tano-rockchip"
PREFERRED_VERSION_linux-tano-rockchip = "4.19%"
LINUXLIBCVERSION = "4.19-custom%"
TANOWRT_WIREGUARD_IN_KERNEL = "1"
```

## meta-tanowrt-hsl-rockchip/conf/machine/include/hsl-rk356x.inc
```bitbake
# Copyright (c) 2020, Rockchip Electronics Co., Ltd
# Copyright (c) 2022-2023, Tano Systems LLC
# Released under the MIT license (see COPYING.MIT for the terms)

SOC_FAMILY ?= "rk3568"

MACHINE_FEATURES:append = "\
	pci \
"

require conf/machine/include/arm/armv8-2a/tune-cortexa55.inc
require conf/machine/include/hsl-rockchip-arm64-common.inc

PREFERRED_PROVIDER_virtual/egl ?= "rockchip-libmali"
PREFERRED_PROVIDER_virtual/libgles1 ?= "rockchip-libmali"
PREFERRED_PROVIDER_virtual/libgles2 ?= "rockchip-libmali"
PREFERRED_PROVIDER_virtual/libgles3 ?= "rockchip-libmali"
PREFERRED_PROVIDER_virtual/libopencl ?= "rockchip-libmali"
PREFERRED_PROVIDER_virtual/libgbm ?= "rockchip-libmali"
PACKAGECONFIG:pn-wayland ?= "${@bb.utils.contains('DISTRO_FEATURES', 'wayland', 'no-egl', '', d)}"

DEPENDS:append:pn-mesa-gl = " rockchip-libmali"

PREFERRED_PROVIDER_virtual/libgl ?= "mesa-gl"
PREFERRED_PROVIDER_virtual/mesa ?= "mesa-gl"

MALI_GPU := "bifrost-g52"
MALI_VERSION := "g2p0"

RK_ISP_VERSION := "2.1"

# 4.19
#PREFERRED_PROVIDER_virtual/kernel = "linux-tano-rockchip"
#PREFERRED_VERSION_linux-tano-rockchip = "4.19%"
#LINUXLIBCVERSION = "4.19-custom%"
#TANOWRT_WIREGUARD_IN_KERNEL = "1"

# 4.19-rt
#PREFERRED_PROVIDER_virtual/kernel = "linux-tano-rockchip-rt"
#PREFERRED_VERSION_linux-tano-rockchip-rt = "4.19%"
#LINUXLIBCVERSION = "4.19-custom%"
#TANOWRT_WIREGUARD_IN_KERNEL = "1"

# 5.10
PREFERRED_PROVIDER_virtual/kernel = "linux-tano-rockchip"
PREFERRED_VERSION_linux-tano-rockchip = "5.10%"
LINUXLIBCVERSION = "5.10-custom%"
TANOWRT_WIREGUARD_IN_KERNEL = "1"
```

## meta-tanowrt-hsl-rockchip/conf/machine/include/hsl-rockchip-arm64-common.inc
```bitbake
# Copyright (c) 2019, Fuzhou Rockchip Electronics Co., Ltd
# Copyright (c) 2022, Tano Systems LLC
# Released under the MIT license (see COPYING.MIT for the terms)

require conf/machine/include/hsl-rockchip-common.inc

SERIAL_CONSOLES = "1500000;ttyFIQ0"

RK_USE_COMPRESSED_KERNEL = "0"
```

## meta-tanowrt-hsl-rockchip/conf/machine/include/hsl-rockchip-common.inc
```bitbake
# Copyright (c) 2019, Fuzhou Rockchip Electronics Co., Ltd
# Copyright (c) 2022-2023, Tano Systems LLC
# Released under the MIT license (see COPYING.MIT for the terms)

require conf/machine/include/soc-family.inc

MACHINE_EXTRA_RRECOMMENDS:append = " \
	${RK_WIFIBT_FIRMWARES} \
	kernel-modules \
"

RK_ISP_VERSION := ""

SERIAL_CONSOLES ?= "115200;ttyFIQ0"
KERNEL_IMAGETYPE ?= "Image"
KBUILD_DEFCONFIG ?= ""
MACHINEOVERRIDES .= ":rockchip"

# Custom kernel might not support newest python
PACKAGECONFIG:remove:pn-perf = "scripting"

PREFERRED_RPROVIDER_lib32-initd-functions = "lib32-initscripts"

MACHINE_FEATURES = "\
	apm \
	alsa \
	vfat \
	ext2 \
	ext4 \
	usbhost \
	usbgadget \
	ethernet \
	screen \
	cgroup \
	touchscreen \
	lldp \
	watchdog \
	crypto \
	hwrng \
"

MACHINE_EXTRA_RDEPENDS:append = " \
	udev-conf-rockchip \
"

#
# Bootloader
#
PREFERRED_PROVIDER_u-boot ?= "u-boot-tano-rockchip"
PREFERRED_PROVIDER_virtual/bootloader ?= "${PREFERRED_PROVIDER_u-boot}"

UBOOT_INITIAL_ENV   = "u-boot-initial-env"
UBOOT_ENV_SIZE      = "0x8000"
UBOOT_ENV_REDUNDANT = "1"

UBOOT_SUFFIX = "bin"
UBOOT_BINARY = "u-boot-${MACHINE}.${UBOOT_SUFFIX}"

KERNEL_ENTRYPOINT = "0x00280000"
KERNEL_LOADADDRESS = "0x00280000"
UBOOT_DTB_LOADADDRESS = "0x0a100000"
UBOOT_DTBO_LOADADDRESS = "0x0a200000"

UBOOT_BINARYNAME ?= "${@os.path.splitext(d.getVar("UBOOT_BINARY"))[0]}"
UBOOT_IMAGE ?= "u-boot-${MACHINE}-${PV}-${PR}.${UBOOT_SUFFIX}"
UBOOT_SYMLINK ?= "u-boot-${MACHINE}.${UBOOT_SUFFIX}"
UBOOT_MAKE_TARGET ?= "all"

#
# Kernel
#
PREFERRED_PROVIDER_virtual/kernel = "linux-tano-rockchip"

PREFERRED_VERSION_linux-tano-rockchip = "5.10%"
LINUXLIBCVERSION = "5.10-custom%"

KERNEL_IMAGETYPE = "fitImage"
KERNEL_IMAGETYPES = "fitImage"
KERNEL_CLASSES = "kernel-tn-fitimage kernel-tn-mkimage"
KERNEL_MKIMAGE_TYPES = "ext4"

#
# Image
#
ROOTFS_IMAGE_FSTYPE = "squashfs-lzo"

TANOWRT_PARTUUID_VARS = "\
	TANOWRT_PARTUUID_BOOT \
	TANOWRT_PARTUUID_OVERLAY \
	TANOWRT_PARTUUID_ROOTDEV_A \
	TANOWRT_PARTUUID_ROOTDEV_B \
	TANOWRT_PARTUUID_KERNELDEV_A \
	TANOWRT_PARTUUID_KERNELDEV_B \
"

IMAGE_FSTYPES += "${ROOTFS_IMAGE_FSTYPE} wic"
IMAGE_CLASSES += "wic-sdcard-img"
WKS_FILE ?= "sdimage-rockchip-gptdisk.wks.in"

WIC_CREATE_EXTRA_ARGS = "--no-fstab-update"
WIC_DO_IMAGE_DEPENDS = "\
	${IMAGE_BASENAME}:do_image_squashfs_lzo \
	u-boot-startup-script:do_deploy \
	virtual/bootloader:do_deploy \
	virtual/kernel:do_deploy \
"

do_image_wic[depends] += "${WIC_DO_IMAGE_DEPENDS}"

WKS_IMAGE_IDBLOCK_BINARY = "${RK_IMAGE_IDBLOCK}-${MACHINE}-sdcard"
WKS_IMAGE_UBOOT_INITIAL_ENV_BINARY = "u-boot-initial-env-${MACHINE}-sdcard.bin"
WKS_IMAGE_ROOTFS_BINARY = "${IMAGE_BASENAME}-${MACHINE}.${ROOTFS_IMAGE_FSTYPE}"
WKS_IMAGE_KERNEL_BINARY = "${KERNEL_IMAGETYPE}-${MACHINE}.ext4"
WKS_IMAGE_UBOOT_BINARY = "${UBOOT_BINARY}"
WKS_IMAGE_STARTUP_BINARY = "startup-${MACHINE}.img"

# Remove /boot from root filesystem
ROOTFS_RM_BOOT_DIR_DISABLE = "0"

RK_IMAGE_IDBLOCK ?= "idblock.img"
RK_IMAGE_LOADER ?= "loader.bin"

RK_IDBLOCK_OFFSET ?= "32768"
RK_STARTUP_OFFSET ?= "4063232"

PACKAGECONFIG:append:pn-fstools = " ovl-rootdisk-part "
PACKAGECONFIG:append:pn-collectd = " thermal "
PACKAGE_ARCH:pn-collectd = "${MACHINE_ARCH}"

PACKAGE_ARCH:pn-netifd = "${MACHINE_ARCH}"
PACKAGE_ARCH:pn-dnsmasq = "${MACHINE_ARCH}"

TANOWRT_NETIFD_CONFIGURE_INTERFACES = "lan usb0"
TANOWRT_NETIFD_CONFIGURE_INTERFACE_lan = "proto=dhcp device=br-lan peerdns=1"
TANOWRT_NETIFD_CONFIGURE_INTERFACE_usb0 = "proto=static device=usb0 force_link=0 ipaddr=192.168.128.1 netmask=255.255.255.0"

TANOWRT_DNSMASQ_CONFIGURE_INTERFACES = "lan usb0"
TANOWRT_DNSMASQ_CONFIGURE_INTERFACE_lan = "ignore=1"
TANOWRT_DNSMASQ_CONFIGURE_INTERFACE_usb0 = "start=100 limit=1 interface=usb0 leasetime=15m"
```

## meta-tanowrt-hsl-rockchip/conf/machine/include/hsl-rockchip-swu-emmc.inc
```bitbake
#
# SPDX-License-Identifier: MIT
# Copyright (c) 2022 Tano Systems LLC. All rights reserved.
#

SWU_UBOOT_CONFIG = "emmc"
SWU_UBOOT_CONFIG_FACTORY = "sdcard"

require hsl-rockchip-swu-estorage.inc

SWU_IMAGE_MEDIA_TYPE = "eMMC"
OPENWRT_VERSION_PRODUCT_EXTRA = " (eMMC)"
```
