## meta-tanowrt-hsl-swi/conf/layer.conf
```bitbake
#
# SPDX-License-Identifier: MIT
# Copyright (c) 2020 Tano Systems LLC. All rights reserved.
#

# Layer version
LAYERVERSION = "1"

# We have a conf and classes directory, append to BBPATH
BBPATH .= ":${LAYERDIR}"

# We have a recipes directory, add to BBFILES
BBFILES += "${LAYERDIR}/recipes*/*/*.bb \
            ${LAYERDIR}/recipes*/*/*.bbappend"

BBFILE_COLLECTIONS += "meta-tanowrt-hsl-swi"
BBFILE_PATTERN_meta-tanowrt-hsl-swi := "^${LAYERDIR}/"

# meta-swi-* priorities is from 8 to 30
BBFILE_PRIORITY_meta-tanowrt-hsl-swi = "31"

LICENSE_PATH += "${LAYERDIR}/licenses"

LAYERDEPENDS_meta-tanowrt-hsl-swi = "\
	meta-tanowrt \
	swi \
	swi-mdm9xxx \
	swi-mdm9x28 \
"

LAYERSERIES_COMPAT_meta-tanowrt-hsl-swi = "kirkstone"

# Set a variable to get the top of the metadata location
TANOWRT_HSL_BASE = '${@os.path.normpath("${LAYERDIR}/")}'

# We do not use original swi kernel recipes
BBMASK += "recipes-kernel/linux/linux-quic_git.bb"
BBMASK += "recipes-kernel/embms-kernel/embms-kernel_git.bb"
BBMASK += "recipes-kernel/linux-msm/linux-msm_git.bb"

# We do not use original swi lk recipes
BBMASK += "meta-swi-mdm9x28/recipes-bsp/lk/lk_1.3.0.bbappend"
BBMASK += "meta-swi-mdm9xxx/recipes-bsp/lk/lk_1.3.0.bb"

# bbappend for rng-tools has a dependency on sysvinit or systemd
BBMASK += "common/recipes-support/rng-tools/"

# Do not use bbappend for dropbear from meta-swi
BBMASK += "common/recipes-core/dropbear/"

# Do not use bbappends for dnsmasq from SWI
BBMASK += "common/recipes-support/dnsmasq/"
BBMASK += "meta-swi-mdm9xxx/recipes-support/dnsmasq/"

# Do not use base-files bbappend from mdm9x28 layer
BBMASK += "meta-swi-mdm9x28/recipes-core/base-files/"

# Do not install tzdata from swi layers (this breaks tanowrt tzdata)
BBMASK += "common/recipes-extended/tzdata/"

# No need for patch from meta-swi for bridge-utils.
# We are using a newer version of bridge-utils for which a patch is not required.
BBMASK += "common/recipes-support/bridge-utils/"

# meta-swi/common has invalid patches for cryptsetup >=2.1.0
BBMASK += "common/recipes-support/cryptsetup/"

# Do not use original recipes for Legato Framework
# TanoWrt adapted recipes in meta-tanowrt-hsl-swi-extras layer
BBMASK += "common/recipes-legato/legato-af/legato-af_git.bb"
BBMASK += "common/recipes-legato/legato-af/legato-tools_git.bb"
BBMASK += "common/recipes-legato/legato-image/legato-iamge.bb"
BBMASK += "meta-swi-mdm9xxx/recipes-legato/legato-af/"
BBMASK += "meta-swi-mdm9x28/recipes-legato/legato-af/"
BBMASK += "meta-swi-mdm9x28-bin/recipes/legato-af/"

# This recipes is not exists in kirkstone release
BBMASK += "meta-swi/common/recipes-core/readline/readline_5.2.bbappend"

# The initscripts recipe has declarations that produce warnings
# in the kirkstone release. This package is not used in TanoWrt
BBMASK += "meta-swi/common/recipes-core/initscripts/initscripts_1.0.bbappend"
BBMASK += "meta-swi/meta-swi-mdm9xxx/recipes-core/initscripts/initscripts_1.0.bbappend"

# Do not use busybox customizations from SWI common layer
BBMASK += "meta-swi/common/recipes-core/busybox/"
```

## meta-tanowrt-hsl-swi/conf/machine/include/tano-swi-mdm9x28-wp.inc
```bitbake
#
# SPDX-License-Identifier: MIT
# Copyright (c) 2020 Tano Systems LLC. All rights reserved.
#

# meta-swi/meta-swi-mdm9x28/
require conf/machine/swi-mdm9x28-wp.conf

MACHINEOVERRIDES =. "swi-mdm9x28-wp:"

#
# Image
#
IMAGE_FSTYPES = "squashfs 4k.ubifs"

# Bootloader
EXTRA_IMAGEDEPENDS += "lk"

# For userapp (UAPP) MTD partition UBI image.
UBI_USERAPP_PATH ?= "${IMGDEPLOYDIR}/${IMAGE_NAME}.userapp"
UBI_USERAPP_SIZE ?= "124MiB"

PACKAGECONFIG_append_pn-collectd = " cpufreq "
PACKAGE_ARCH_pn-collectd = "${MACHINE_ARCH}"

#
# Kernel
#
SERIAL_CONSOLE = "115200 ttyS0"

#
# QEMU options (runqemu)
#
# No qemu support, yet
MACHINE_FEATURES_remove = "qemu-usermode"
QEMU_TARGETS = "arm"

ENABLE_IMA = "false"
ENABLE_FX30 = "false"
IMA_KERNEL_CMDLINE_OPTIONS = ""

# GPLv2 readline
PREFERRED_VERSION_readline = "8.%"

LEGATO_BUILD ?= "false"

# Note: Supports only single target per machine
LEGATO_ROOTFS_TARGETS = "wp76xx"

KERNEL_BOOT_OPTIONS = "earlyprintk=serial,ttyHSL1,115200 loglevel=7 \
  rootwait rootflags=bulk_read root=/dev/ubiblock0_0 ro rootfstype=squashfs \
  ubi.mtd=13,4096 ubi.block=0,rootfs \
  ubi.mtd=16,4096 \
  rootfs_partition=system rootfs_volume=rootfs \
  overlay_partition=userapp overlay_volume=userapp_vol0 \
  console=ttyHSL1,115200 ima_ready=${ENABLE_IMA} \
"

MACHINE_FEATURES_append = " hwrng "

PACKAGECONFIG_remove_pn-procd = "ujail"
```
