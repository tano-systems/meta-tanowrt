## conf/machine/qemux86-64.conf
```bitbake
#@TYPE: Machine
#@NAME: common_pc
#@DESCRIPTION: Machine configuration for running a common x86-64

#
# CPU
#
require conf/machine/include/qemu.inc
DEFAULTTUNE ?= "core2-64"
require conf/machine/include/tune-core2.inc
require conf/machine/include/qemuboot-x86.inc

require conf/machine/include/qemuall.inc

#
# Image
#
IMAGE_FSTYPES = "ext4 wic.vmdk"
WKS_FILE = "openwrt-image-x86.wks"
WKS_FILE_DEPENDS = "syslinux syslinux-native dosfstools-native mtools-native"

#
# Kernel
#
PREFERRED_PROVIDER_virtual/kernel_qemux86-64 = "linux-yocto"
SERIAL_CONSOLES ?= "115200;ttyS0 115200;ttyS1"

#
# Machine/distro features
#
MACHINE_FEATURES = "kernel26 apm usbgadget usbhost vfat ext2 ethernet wifi cgroup"

#
# QEMU options (runqemu)
#
QEMU_TARGETS = "x86_64"

QB_DEFAULT_FSTYPE = "ext4"
QB_SYSTEM_NAME = "qemu-system-x86_64"
QB_KERNEL_CMDLINE_APPEND = "console=ttyS0,115200 console=tty0 console=tty"
QB_OPT_APPEND = "-show-cursor -usb -device usb-tablet -device virtio-rng-pci -nographic"
QB_SERIAL_OPT = "-serial stdio"
QB_AUDIO_DRV  = ""
QB_AUDIO_OPT  = ""

#
# OpenWrt specific
#
OPENWRT_VERSION_PRODUCT = "qemux86-64"
OPENWRT_VERSION_HWREV = "v1"
```

## conf/machine/qemux86.conf
```bitbake
#@TYPE: Machine
#@NAME: common_pc
#@DESCRIPTION: Machine configuration for running a common x86

#
# CPU
#
require conf/machine/include/qemu.inc
require conf/machine/include/tune-i586.inc
require conf/machine/include/qemuboot-x86.inc

require conf/machine/include/qemuall.inc

#
# PACKAGECONFIG's
#
PACKAGECONFIG_append_pn-fstools = " ovl-rootdisk-part "

#
# Kernel
#
PREFERRED_PROVIDER_virtual/kernel_qemux86 = "linux-tano-yocto"
SERIAL_CONSOLES ?= "115200;ttyS0"

#
# Image
#
IMAGE_FSTYPES = "wic wic.vmdk"
WKS_FILE = "openwrt-image-qemux86.wks"
WKS_FILE_DEPENDS = "syslinux syslinux-native e2fsprogs-native dosfstools-native mtools-native squashfs-tools-native"
WIC_CREATE_EXTRA_ARGS = "--no-fstab-update"

#
# Machine/distro features
#
MACHINE_FEATURES = "kernel26 apm usbgadget usbhost vfat ext2 ethernet wifi cgroup"

#
# QEMU options (runqemu)
#
QEMU_TARGETS = "i386"

QB_DEFAULT_FSTYPE = "wic"
QB_SYSTEM_NAME = "qemu-system-i386"
QB_KERNEL_CMDLINE_APPEND = "console=ttyS0,115200 console=tty1"
QB_OPT_APPEND = "-usb -device virtio-rng-pci -nographic -smp 2"
QB_SERIAL_OPT = "-serial stdio"
QB_AUDIO_DRV  = ""
QB_AUDIO_OPT  = ""

#
# OpenWrt specific
#
OPENWRT_VERSION_PRODUCT = "qemux86"
OPENWRT_VERSION_HWREV = "v1"
```

## hw-layers/meta-tano-openwrt-ti/conf/distro/include/tano-openwrt-hw.inc
```bitbake
#
# Dynamic includes
#
include ${@bb.utils.contains('BBFILE_COLLECTIONS', 'meta-arago-distro', 'conf/distro/include/dynamic/meta-arago-distro.inc', '__not_existsing__.inc', d)}
```

## hw-layers/meta-tano-openwrt-ti/conf/layer.conf
```bitbake
# Layer version
LAYERVERSION = "1"

# We have a conf and classes directory, append to BBPATH
BBPATH .= ":${LAYERDIR}"

# We have a recipes directory, add to BBFILES
BBFILES += "${LAYERDIR}/recipes*/*/*.bb ${LAYERDIR}/recipes*/*/*.bbappend"

BBFILE_COLLECTIONS += "meta-tano-openwrt-ti"
BBFILE_PATTERN_meta-tano-openwrt-ti := "^${LAYERDIR}/"
BBFILE_PRIORITY_meta-tano-openwrt-ti = "17"

LICENSE_PATH += "${LAYERDIR}/licenses"

LAYERDEPENDS_meta-tano-openwrt-ti = "\
	tano-openwrt-layer \
	meta-arago-distro \
	meta-ti \
"

# Compatible with OE Release 2.4 (Rocko)
LAYERSERIES_COMPAT_meta-tano-openwrt-ti = "rocko"

#
# Dynamic layers
#
BBFILES_DYNAMIC += "\
	meta-arago-extras:${LAYERDIR}/dynamic-layers/meta-arago-extras/*/*/*.bb \
	meta-arago-extras:${LAYERDIR}/dynamic-layers/meta-arago-extras/*/*/*.bbappend \
"

# Set a variable to get the top of the metadata location
TANO_OPENWRT_HW_BASE = '${@os.path.normpath("${LAYERDIR}/")}'
```

## meta-tanowrt-hsl-atmel/conf/layer.conf
```bitbake
# Layer version
LAYERVERSION = "1"

# We have a conf and classes directory, append to BBPATH
BBPATH .= ":${LAYERDIR}"

# We have a recipes directory, add to BBFILES
BBFILES += "${LAYERDIR}/recipes*/*/*.bb \
            ${LAYERDIR}/recipes*/*/*.bbappend"

BBFILE_COLLECTIONS += "meta-tanowrt-hsl-atmel"
BBFILE_PATTERN_meta-tanowrt-hsl-atmel := "^${LAYERDIR}/"
BBFILE_PRIORITY_meta-tanowrt-hsl-atmel = "17"

LAYERDEPENDS_meta-tanowrt-hsl-atmel = "\
	meta-tanowrt \
	atmel \
	core \
	openembedded-layer \
	networking-layer \
	meta-python \
	multimedia-layer \
"

LAYERSERIES_COMPAT_meta-tanowrt-hsl-atmel = "hardknott"

# Set a variable to get the top of the metadata location
TANOWRT_HSL_BASE = '${@os.path.normpath("${LAYERDIR}/")}'
```

## meta-tanowrt-hsl-atmel/conf/machine/at91-sama5d2-xplained-emmc.conf
```bitbake
#@TYPE: Machine
#@Name: Atmel SAMA5D2 Xplained (eMMC)
#@DESCRIPTION: Machine configuration for Atmel SAMA5D2 Xplained board running on internal eMMC

MACHINEOVERRIDES =. "at91-sama5d2-xplained:"
MACHINEOVERRIDES =. "at91-sama5d2-emmc:"

require include/at91-sama5d2-xplained.inc
require include/at91-sama5d2-xplained-emmc.inc

#
# Bootloader
#
UBOOT_CONFIG[sdcard] = "sama5d2-xplained_sdcard_defconfig,,u-boot.bin"
UBOOT_CONFIG[emmc]   = "sama5d2-xplained_emmc_defconfig,,u-boot.bin"

#
# SWUpdate
#
SWU_BOARD = "at91-sama5d2-xplained-emmc"
SWU_REVISION = "1.0"
```
