## conf/distro/include/tano-openwrt.inc
```bitbake
require conf/distro/include/tano-openwrt-toolchain.inc
require conf/distro/include/tano-openwrt-sdk.inc

IMAGE_CLASSES += "openwrt-image-types"

# Virtual runtimes
VIRTUAL-RUNTIME_dev_manager = "procd"
VIRTUAL-RUNTIME_login_manager = "busybox"
VIRTUAL-RUNTIME_init_manager = "procd"
VIRTUAL-RUNTIME_kmod_manager = "ubox"
VIRTUAL-RUNTIME_syslog = "ubox"
VIRTUAL-RUNTIME_base-utils = "busybox"
VIRTUAL-RUNTIME_network_manager = "netifd"

# Start with default set of distro features
DISTRO_FEATURES = "${DISTRO_FEATURES_DEFAULT} ${DISTRO_FEATURES_LIBC}"

# Set procd as init manager
DISTRO_FEATURES_append = " procd"

# Remove sysvinit and systemd from DISTRO_FEATURES
DISTRO_FEATURES_BACKFILL_CONSIDERED_append = " sysvinit systemd"

# Clean DISTRO_FEATURES
DISTRO_FEATURES_remove = "\
    wayland \
    wifi \
    pci \
    3g \
    nfc \
    pulseaudio \
    bluetooth \
    irda \
    pcmcia \
    bluez5 \
    largefile \
    sysvinit \
    systemd \
    pam \
    x11 \
    opengl \
"

# Rootfs customization
ROOTFS_RO_UNNEEDED = "update-rc.d ${ROOTFS_BOOTSTRAP_INSTALL}"
FORCE_RO_REMOVE = "1"

# Licenses
LICENSE_FLAGS_WHITELIST = "commercial_gst-ffmpeg commercial_gstreamer1.0-libav"

# Disable polkit's systemd configuration from meta-oe
POLKITAUTH = ""

# Set ENTERPRISE_DISTRO flag to ensure that recipes that have been flagged
# do not attempt to enable features that have potential commercial
# licensing issues.
ENTERPRISE_DISTRO = "1"

# Image
IMAGE_FSTYPES_remove = "tar.xz.md5"

# Root home path
ROOT_HOME ??= "/root"

# Set preferred Qt version
QT_PROVIDER ?= "qt5"

require conf/distro/include/tano-openwrt-packageconfig.inc
require conf/distro/include/tano-openwrt-prefs.inc
require conf/distro/include/tano-openwrt-srcipk.inc
require conf/distro/include/tano-openwrt-repairs.inc
require conf/distro/include/tano-openwrt-arago.inc
```

## conf/distro/include/tanowrt-repairs.inc
```bitbake
#
# Repairs for "No recipes available for" warnings
#

# Hide bootchart2 recipe from oe layer
BBMASK += "bootchart2_0.14.8.bb"

# Hide hostpad and wpa-supplicant
BBMASK += "recipes-connectivity/hostapd/"
BBMASK += "recipes-connectivity/wpa-supplicant/"
```

## conf/distro/include/tanowrt-sdk.inc
```bitbake
# SDK paths and names
SDK_NAME_PREFIX = "tano"
SDK_VERSION = "${DISTRO_VERSION}"
SDK_VENDOR = "-${SDK_NAME_PREFIX}"
SDK_NAME = "${SDK_NAME_PREFIX}-${SDK_VERSION}"
SDKPATH_REAL ?= "/usr/local/${SDK_NAME_PREFIX}-${SDK_VERSION}"
SDKPATH ?= "${@"/tmp/"+"x"*96+"/"+"y"*96}"
```

## conf/distro/include/tcmode-internal-linaro.inc
```bitbake
#
# Configuration to use an internal Linaro binary toolchain
#
TARGET_VENDOR = ""

require conf/distro/include/tcmode-default.inc
```

## conf/distro/include/toolchain-external.inc
```bitbake
# Original file from meta-arago-distro

# Locate the toolchain automatically from PATH
TOOLCHAIN_SYSPATH := "${@os.path.abspath(os.path.dirname(bb.utils.which(d.getVar('PATH', d, 1), d.getVar('TOOLCHAIN_PREFIX', d, 1)+'cpp'))+'/../'+d.getVar('TOOLCHAIN_SYS', d, 1))}"
TOOLCHAIN_PATH := "${@bool(d.getVar('TOOLCHAIN_SYSPATH', d, 1)) and (os.path.exists(d.getVar('TOOLCHAIN_SYSPATH', d, 1)) and os.path.dirname(d.getVar('TOOLCHAIN_SYSPATH', d, 1)) or bb.fatal('No valid toolchain in PATH')) or ''}"
EXTERNAL_TOOLCHAIN = "${TOOLCHAIN_PATH}"
```

## conf/distro/include/toolchain-gcc.inc
```bitbake
# Original file from meta-arago-distro

# Select internal gcc toolchain to be built from sources
TCMODE = "default"
TCLIBC = "glibc"

LIBCEXTENSION = "${@['', '-gnu'][(d.getVar('ABIEXTENSION', True) or '') != '']}"

# Match some of the external vars
TOOLCHAIN_SYS := "${TARGET_SYS}"
TOOLCHAIN_PREFIX := "${TARGET_PREFIX}"

PREFERRED_PROVIDER_gcc-cross-canadian-${TRANSLATED_TARGET_ARCH} ?= "gcc-cross-canadian-${TRANSLATED_TARGET_ARCH}"
PREFERRED_PROVIDER_binutils-cross-canadian-${TRANSLATED_TARGET_ARCH} ?= "binutils-cross-canadian-${TRANSLATED_TARGET_ARCH}"
PREFERRED_PROVIDER_gdb-cross-canadian-${TRANSLATED_TARGET_ARCH} = "gdb-cross-canadian-${TRANSLATED_TARGET_ARCH}"

# Set Cross and SDK toolchain preferences
SDKGCCVERSION ?= "6.2%"
SDKBINUVERSION ?= "2.27%"
SDKGLIBCVERSION ?= "2.24%"
SDKLINUXLIBCVERSION ?= "4.9%"

PREFERRED_VERSION_gcc-crosssdk-${SDK_SYS} ?= "${SDKGCCVERSION}"
PREFERRED_VERSION_gcc-crosssdk-initial-${SDK_SYS} ?= "${SDKGCCVERSION}"
PREFERRED_VERSION_binutils-crosssdk-${SDK_SYS} ?= "${SDKBINUVERSION}"

PREFERRED_VERSION_nativesdk-gcc-runtime ?= "${SDKGCCVERSION}"
PREFERRED_VERSION_nativesdk-libgcc ?= "${SDKGCCVERSION}"
PREFERRED_VERSION_nativesdk-libgcc-initial ?= "${SDKGCCVERSION}"
PREFERRED_VERSION_nativesdk-linux-libc-headers ?= "${SDKLINUXLIBCVERSION}"
PREFERRED_VERSION_nativesdk-glibc ?= "${SDKGLIBCVERSION}"
PREFERRED_VERSION_nativesdk-glibc-initial ?= "${SDKGLIBCVERSION}"

# Set target toolchain preferences to match Cross/SDK by default
# Can be overwritten globally, if needed
GCCVERSION ?= "6.2%"
BINUVERSION ?= "2.27%"
GLIBCVERSION ?= "2.24%"
GLIBCINITVERSION ?= "2.24%"
LINUXLIBCVERSION ?= "4.9%"

PREFERRED_VERSION_gcc ?= "${GCCVERSION}"
PREFERRED_VERSION_binutils ?= "${BINUVERSION}"
PREFERRED_VERSION_linux-libc-headers ?= "${LINUXLIBCVERSION}"
PREFERRED_VERSION_glibc ?= "${GLIBCVERSION}"
PREFERRED_VERSION_glibc-locale ?= "${GLIBCVERSION}"
PREFERRED_VERSION_glibc-initial ?= "${GLIBCINITVERSION}"
```

## conf/distro/include/toolchain-linaro.inc
```bitbake
# Select external binary prebuilt Linaro toolchain
TCMODE = "external-linaro"
TCLIBC = "external-linaro-toolchain"

ELT_TARGET_SYS_ARMV5 ?= "arm-linux-gnueabi"
ELT_TARGET_SYS_ARMV7 ?= "arm-linux-gnueabihf"
ELT_TARGET_SYS_ARMV8 ?= "aarch64-linux-gnu"

ELT_TARGET_SYS_arm = "${ELT_TARGET_SYS_ARMV5}"
ELT_TARGET_SYS_armv7a = "${ELT_TARGET_SYS_ARMV7}"
ELT_TARGET_SYS_aarch64 = "${ELT_TARGET_SYS_ARMV8}"

TARGET_VENDOR = ""

TOOLCHAIN_BASE ?= "/opt"
TOOLCHAIN_PATH_ARMV5 ?= "${TOOLCHAIN_BASE}/gcc-linaro-7.2.1-ti2018.00-armv5-x86_64_${ELT_TARGET_SYS_ARMV5}"
TOOLCHAIN_PATH_ARMV7 ?= "${TOOLCHAIN_BASE}/gcc-linaro-7.2.1-2017.11-x86_64_${ELT_TARGET_SYS_ARMV7}"
TOOLCHAIN_PATH_ARMV8 ?= "${TOOLCHAIN_BASE}/gcc-linaro-7.2.1-2017.11-x86_64_${ELT_TARGET_SYS_ARMV8}"

DEF_TOOLCHAIN_PATH_arm = "${TOOLCHAIN_PATH_ARMV5}"
DEF_TOOLCHAIN_PATH_armv7a = "${TOOLCHAIN_PATH_ARMV7}"
DEF_TOOLCHAIN_PATH_aarch64 = "${TOOLCHAIN_PATH_ARMV8}"

TOOLCHAIN_PATH ?= "${DEF_TOOLCHAIN_PATH}"

TOOLCHAIN_SYS := "${ELT_TARGET_SYS}"
TOOLCHAIN_PREFIX := "${TOOLCHAIN_SYS}-"

PREFERRED_PROVIDER_virtual/${TARGET_PREFIX}gcc-intermediate = "external-linaro-toolchain"

PREFERRED_PROVIDER_gcc-cross-canadian-${TRANSLATED_TARGET_ARCH} ?= "external-linaro-sdk-toolchain"
PREFERRED_PROVIDER_binutils-cross-canadian-${TRANSLATED_TARGET_ARCH} ?= "external-linaro-sdk-toolchain"
#PREFERRED_PROVIDER_gdb-cross-canadian-${TRANSLATED_TARGET_ARCH} = "external-linaro-sdk-toolchain"

# Special case for gdb to be built as part of canadian-cross-sdk, instead of packaged from external toolchain
bindir_pn-gdb-cross-canadian-${TRANSLATED_TARGET_ARCH} = "${exec_prefix}/bin"
PREFERRED_PROVIDER_gdb-cross-canadian-${TRANSLATED_TARGET_ARCH} = "gdb-cross-canadian-${TRANSLATED_TARGET_ARCH}"

# Set up runtime preferences
PREFERRED_PROVIDER_libgcc = "external-linaro-toolchain"
PREFERRED_PROVIDER_gcc-runtime = "external-linaro-toolchain"

# Set Cross and SDK toolchain preferences
SDKGCCVERSION ?= "linaro-7.2%"
SDKGDBVERSION ?= "8.0"
SDKBINUVERSION ?= "linaro-2.27%"
SDKGLIBCVERSION ?= "2.26%"
SDKLINUXLIBCVERSION ?= "4.14%"

PREFERRED_VERSION_gcc-crosssdk-${SDK_SYS} ?= "${SDKGCCVERSION}"
PREFERRED_VERSION_gcc-crosssdk-initial-${SDK_SYS} ?= "${SDKGCCVERSION}"
PREFERRED_VERSION_gdb-crosssdk-${SDK_SYS} ?= "${SDKGDBVERSION}"
PREFERRED_VERSION_gdb-cross-canadian-${TRANSLATED_TARGET_ARCH} ?= "${SDKGDBVERSION}"
PREFERRED_VERSION_binutils-crosssdk-${SDK_SYS} ?= "${SDKBINUVERSION}"

PREFERRED_VERSION_nativesdk-gcc-runtime ?= "${SDKGCCVERSION}"
PREFERRED_VERSION_nativesdk-libgcc ?= "${SDKGCCVERSION}"
PREFERRED_VERSION_nativesdk-libgcc-initial ?= "${SDKGCCVERSION}"
PREFERRED_VERSION_nativesdk-linux-libc-headers ?= "${SDKLINUXLIBCVERSION}"
PREFERRED_VERSION_nativesdk-glibc ?= "${SDKGLIBCVERSION}"
PREFERRED_VERSION_nativesdk-glibc-locale ?= "${SDKGLIBCVERSION}"
PREFERRED_VERSION_nativesdk-glibc-initial ?= "${SDKGLIBCVERSION}"

# Set target toolchain preferences to match Cross/SDK by default
# Can be overwritten globally, if needed
GCCVERSION ?= "linaro-7.2%"
GDBVERSION ?= "8.0"
BINUVERSION ?= "linaro-2.27%"
GLIBCVERSION ?= "2.26%"

PREFERRED_VERSION_gcc ?= "${GCCVERSION}"
PREFERRED_VERSION_gdb ?= "${GDBVERSION}"
PREFERRED_VERSION_binutils ?= "${BINUVERSION}"
PREFERRED_VERSION_glibc ?= "${GLIBCVERSION}"
PREFERRED_VERSION_glibc-locale ?= "${GLIBCVERSION}"
PREFERRED_VERSION_glibc-initial ?= "${GLIBCVERSION}"

# Licenses set for main components of the toolchain:
# (g)libc is always LGPL version 2 (or later)
# gcc has switched from GPL version 2 (or later) to version 3 (or later) after 4.2.1,
#    see this announcement - http://gcc.gnu.org/ml/gcc-announce/2007/msg00003.html
# libgcc and libstdc++ always had exceptions to GPL called Runtime Library Exception, but
#    it was based on GPL version 2 (or later), until new GPL version 3 (or later) exception
#    was introduced on 27 Jan 2009 - http://gcc.gnu.org/ml/gcc-announce/2009/msg00000.html
#    and http://www.gnu.org/licenses/gcc-exception.html, which was several days after
#    gcc 4.3.3 was released - http://gcc.gnu.org/releases.html
# gdb/gdbserver version 6.6 was the last one under GPL version 2 (or later), according
#    to the release schedule - http://www.gnu.org/software/gdb/schedule/
# binutils version 2.17 was the last one under GPL version 2 (or later), according
#    to the published releases - http://ftp.gnu.org/gnu/binutils/

python external_linaro_toolchain_license_handler () {
	if not isinstance(e, bb.event.ConfigParsed):
		return
	d = e.data
	ld = d.createCopy()
	ld.finalize()

	lc_libc = "LGPL-2.1"
	lc_gcc = ["GPL-3.0", "GPL-2.0"][elt_get_gcc_version(ld) <= "4.2.1"]
	lc_rle = ["GPL-3.0-with-GCC-exception", "GPL-2.0-with-GCC-exception"][elt_get_gcc_version(ld) <= "4.3.3"]
	lc_gdb = ["GPL-3.0", "GPL-2.0"][elt_get_gdb_version(ld) <= "6.6"]
#	lc_bfd = ["GPL-3.0", "GPL-2.0"][elt_get_bfd_version(ld) <= "2.17"]

	d.setVar('ELT_LIC_LIBC', lc_libc)
	d.setVar('ELT_LIC_GCC', lc_gcc)
	d.setVar('ELT_LIC_RLE', lc_rle)
	d.setVar('ELT_LIC_GDB', lc_gdb)
#	d.setVar('ELT_LIC_BFD', lc_bfd)

	d.setVar('ELT_LICENSE', "%s&%s&%s&%s" % (lc_libc, lc_gcc, lc_rle, lc_gdb))
}
addhandler external_linaro_toolchain_license_handler
```

## conf/distro/tano-openwrt.conf
```bitbake
require conf/distro/include/tano-openwrt.inc

# Name and version of the distribution
DISTRO_NAME     = "Tano Distribution"
DISTRO_VERSION  = "2018.05"
DISTRO_FEED_URI = "http://tano-systems.com"
DISTRO          = "tano-openwrt"
DISTRO_CODENAME = "tano-openwrt"

# OpenWrt version
OPENWRT_VERSION_MANUFACTURER     ?= "Tano Systems"
OPENWRT_VERSION_MANUFACTURER_URL ?= "http://tano-systems.com/"
OPENWRT_VERSION_BUG_URL          ?= ""
OPENWRT_VERSION_SUPPORT_URL      ?= ""

# Initial timezone
OPENWRT_ZONENAME ?= "Europe/Moscow"
OPENWRT_TIMEZONE ?= "MSK-3"

# LuCI configuration

# Distribution and LuCI version for LuCI
# This data is displayed as Firmware Version in LuCI
LUCI_DISTNAME    ?= "${DISTRO_NAME}"
LUCI_DISTVERSION ?= "${DISTRO_VERSION}"
LUCI_NAME        ?= "LuCI"
LUCI_VERSION     ?= "Tano"

# Languages to install
LUCI_LANGUAGES ?= "en ru de"

# Initial startup language
LUCI_INITIAL_LANG ?= "ru"
```

## conf/layer.conf
```bitbake
# Layer version
LAYERVERSION = "1"

# We have a conf and classes directory, append to BBPATH
BBPATH .= ":${LAYERDIR}"

# We have a recipes directory, add to BBFILES
BBFILES += "${LAYERDIR}/recipes*/*/*.bb \
            ${LAYERDIR}/recipes*/*/*.bbappend"

# Backported recipes (may be removed at next update on OE release)
BBFILES += "${LAYERDIR}/layers-backport/meta-oe/recipes*/*/*.bb \
            ${LAYERDIR}/layers-backport/meta-oe/recipes*/*/*.bbappend \
            ${LAYERDIR}/layers-backport/meta-networking/recipes*/*/*.bb \
            ${LAYERDIR}/layers-backport/meta-networking/recipes*/*/*.bbappend \
            ${LAYERDIR}/layers-backport/openembedded-core/recipes*/*/*.bb \
            ${LAYERDIR}/layers-backport/openembedded-core/recipes*/*/*.bbappend"

BBFILE_COLLECTIONS += "tano-openwrt-layer"
BBFILE_PATTERN_tano-openwrt-layer := "^${LAYERDIR}/"
BBFILE_PRIORITY_tano-openwrt-layer = "16"

LICENSE_PATH += "${LAYERDIR}/licenses"

LAYERDEPENDS_tano-openwrt-layer = "\
	core \
	openembedded-layer \
	networking-layer \
	meta-python \
"

# Compatible with OE Release 2.7 (Warrior)
LAYERSERIES_COMPAT_tano-openwrt-layer = "warrior"

#
# Dynamic layers
#
BBFILES_DYNAMIC += ""

# Set a variable to get the top of the metadata location
TANO_OPENWRT_BASE = '${@os.path.normpath("${LAYERDIR}/")}'
TANOWRT_BASE = "${TANO_OPENWRT_BASE}"
```

## conf/machine/include/qemuall.inc
```bitbake
#
# Kernel
#
KERNEL_IMAGETYPE = "bzImage"
PREFERRED_PROVIDER_virtual/kernel = "linux-tano-yocto"
PREFERRED_VERSION_linux-tano-yocto = "4.19%"
PREFERRED_VERSION_xtables-addons = "3.3"

LINUXLIBCVERSION = "4.19%"
SDKLINUXLIBCVERSION = "4.19%"

QEMU_X86_TARGETS = "i586 x86-64"
```

## conf/machine/include/qemuscreen.inc
```bitbake
#
# Machine/distro features
#
IMAGE_FEATURES += "splash"

#
# Psplash
#
SPLASH = "psplash-tano"

#
# XServer
#
PREFERRED_PROVIDER_virtual/xserver ?= "xserver-xorg"
PREFERRED_PROVIDER_virtual/libgl ?= "mesa"
PREFERRED_PROVIDER_virtual/libgles1 ?= "mesa"
PREFERRED_PROVIDER_virtual/libgles2 ?= "mesa"

XSERVER = "xserver-xorg \
           ${@bb.utils.contains('DISTRO_FEATURES', 'opengl', 'mesa-driver-swrast xserver-xorg-extension-glx', '', d)} \
           xf86-video-cirrus \
           xf86-video-fbdev \
           xf86-video-vmware \
           xf86-video-modesetting \
           xserver-xorg-module-libint10 \
           "

#
# Kernel modules
#
UVESA_MODE = "1280x720-32"

KERNEL_MODULE_AUTOLOAD += "uvesafb"
KERNEL_MODULE_AUTOLOAD_EARLY += "uvesafb"
KERNEL_MODULE_PROBECONF += "uvesafb"
module_conf_uvesafb = "options uvesafb mode_option=${UVESA_MODE}"

#
# QEMU options (runqemu)
#
QB_OPT_APPEND  = "-show-cursor -usb -device usb-tablet -device virtio-rng-pci -smp 2"
QB_OPT_APPEND += "-vga vmware -serial mon:stdio -serial null"

# Enable SDL display in QEMU
PACKAGECONFIG_append_pn-qemu-system-native = " sdl"
PACKAGECONFIG_append_pn-nativesdk-qemu = " sdl"
```

## conf/machine/qemuarm.conf
```bitbake
#@TYPE: Machine
#@NAME: arm_versatile_926ejs
#@DESCRIPTION: arm_versatile_926ejs

#
# CPU
#
require conf/machine/include/qemu.inc
require conf/machine/include/tune-arm926ejs.inc

require conf/machine/include/qemuall.inc

#
# Image
#
IMAGE_FSTYPES = "ext4"

#
# Kernel
#
KERNEL_IMAGETYPE = "zImage"
PREFERRED_PROVIDER_virtual/kernel = "linux-yocto"
PREFERRED_PROVIDER_virtual/kernel_qemuarm = "linux-yocto"
PREFERRED_VERSION_linux-yocto = "4.12%"
PREFERRED_VERSION_xtables-addons = "3.0"
SERIAL_CONSOLES ?= "115200;ttyAMA0 115200;ttyAMA1"

LINUXLIBCVERSION = "4.12%"
SDKLINUXLIBCVERSION = "4.12%"

#
# Machine/distro features
#
MACHINE_FEATURES = "kernel26 apm usbgadget usbhost vfat ext2 ethernet"

#
# QEMU options (runqemu)
# ARM Versatile PB (on Cortex-A8)
#
QEMU_TARGETS = "arm"

QB_DEFAULT_FSTYPE = "ext4"
QB_MACHINE = "-machine versatilepb"
QB_SYSTEM_NAME = "qemu-system-arm"
QB_KERNEL_CMDLINE_APPEND = "console=ttyAMA0,115200 console=tty0 console=tty"

# Add the 'virtio-rng-pci' device otherwise the guest may run out of entropy
QB_OPT_APPEND = "-show-cursor -usb -device usb-tablet -device virtio-rng-pci -nographic"
QB_DTB = "zImage-versatile-pb.dtb"
QB_SERIAL_OPT = "-serial stdio"

#
# OpenWrt specific
#
OPENWRT_VERSION_PRODUCT = "qemuarm"
OPENWRT_VERSION_HWREV = "v1"
```
