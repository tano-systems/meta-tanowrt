## conf/distro/include/tano-openwrt-arago.inc
```bitbake
BUILD_VARIANT = "${@['prod','rt','systest'][int(d.getVar('ARAGO_RT_ENABLE', True))+int(d.getVar('ARAGO_SYSTEST_ENABLE', True))*2]}"
FEEDURIPREFIX ?= "packages/${DISTRO}-morty/${BUILD_VARIANT}/"

OPKG_ARGS_remove = "--prefer-arch-to-version"

TI_MIRROR = "http://software-dl.ti.com/processor-sdk-mirror/sources/"
MIRRORS += " \
ftp://.*/.*       http://arago-project.org/files/sources/ \n \
https?$://.*/.*   http://arago-project.org/files/sources/ \n \
bzr://.*/.*      ${TI_MIRROR} \n \
cvs://.*/.*      ${TI_MIRROR} \n \
git://.*/.*      ${TI_MIRROR} \n \
gitsm://.*/.*    ${TI_MIRROR} \n \
hg://.*/.*       ${TI_MIRROR} \n \
osc://.*/.*      ${TI_MIRROR} \n \
p4://.*/.*       ${TI_MIRROR} \n \
npm://.*/.*      ${TI_MIRROR} \n \
ftp://.*/.*      ${TI_MIRROR} \n \
https?$://.*/.*  ${TI_MIRROR} \n \
svn://.*/.*      ${TI_MIRROR} \n \
"

#VIRTUAL-RUNTIME_initscripts = "${@base_conditional("ARAGO_SYSVINIT", "1", "initscripts", "systemd-compat-units", d)}"
#VIRTUAL-RUNTIME_initramfs = "${@base_conditional("ARAGO_SYSVINIT", "1", "sysvinit-initramfs", "systemd-initramfs", d)}"

ARAGO_RT_ENABLE ?= "0"
ARAGO_KERNEL_SUFFIX_append = "${@base_conditional("ARAGO_RT_ENABLE", "1", "-rt", "", d)}"

# Set systest kernel suffix
ARAGO_SYSTEST_ENABLE ?= "0"
```

## conf/distro/include/tano-openwrt-mirrors.inc
```bitbake
GIT_OPENWRT_ORG = "git.openwrt.org"

#
# Official and non-official mirrors on GitHub for some OpenWrt repositories (git.openwrt.org)
# * [official]     git://github.com/openwrt/
# * [non-official] git://github.com/git-openwrt-org-mirror/
#
MIRRORS_prepend = "\
	git://${GIT_OPENWRT_ORG}/openwrt/openwrt.git  git://github.com/openwrt/openwrt.git \n\
	git://${GIT_OPENWRT_ORG}/project/luci.git     git://github.com/openwrt/luci.git \n\
	git://${GIT_OPENWRT_ORG}/(.*)/(.*)            git://github.com/git-openwrt-org-mirror/BASENAME \n\
	gitsm://${GIT_OPENWRT_ORG}/(.*)/(.*)          gitsm://github.com/git-openwrt-org-mirror/BASENAME \n\
	https://${GIT_OPENWRT_ORG}/(.*)/(.*)          https://github.com/git-openwrt-org-mirror/BASENAME \n\
"
```

## conf/distro/include/tano-openwrt-packageconfig.inc
```bitbake
PACKAGECONFIG_pn-libwebsockets = "\
	client \
	server \
	ssl \
	libuv \
	${@bb.utils.filter('ipv6', '${DISTRO_FEATURES}', d)} \
"

# Distro-specific package configuration
PACKAGECONFIG_pn-weston = "egl kms launch clients"
PACKAGECONFIG_append_pn-systemd = " coredump"

# Configure Qt5 flags (GLES is still required for qtdeclarative and qtwebkit)
PACKAGECONFIG_GL_pn-qtbase = "gles2 linuxfb"
PACKAGECONFIG_DISTRO_pn-qtbase = "icu examples accessibility"
PACKAGECONFIG_FONTS_pn-qtbase = "fontconfig"

# Add gstreamer in package configuration to enable video
PACKAGECONFIG_append_pn-qtmultimedia  = " gstreamer"

# Prefer OpenSSL over GnuTLS for curl due to TSU exemptions
PACKAGECONFIG_pn-curl = "${@bb.utils.contains("DISTRO_FEATURES", "ipv6", "ipv6", "", d)} ssl zlib"

# No GFX on Keystone
PACKAGECONFIG_remove_pn-gstreamer1.0-plugins-bad_keystone = "wayland egl gles2"

PACKAGECONFIG_pn-glmark2 = "drm-gles2 wayland-gles2"

# Enable UI and scripting for perf
PERF_FEATURES_ENABLE ?= "perf-scripting perf-tui"
```

## conf/distro/include/tano-openwrt-prefs.inc
```bitbake
# Set preferred Qt5 versions. Different namespace from Qt4, so no conflict
include conf/distro/include/qt5-versions.inc

# Versions
PREFERRED_VERSION_iptables = "1.6.2"
PREFERRED_VERSION_usbutils = "007"
PREFERRED_VERSION_libwebsockets = "2.4.2%"
PREFERRED_VERSION_wireguard = "0.0.20190702"
PREFERRED_VERSION_qrencode = "4.0.2"

# Providers
PREFERRED_PROVIDER_psplash = "psplash-tn"
PREFERRED_PROVIDER_os-release = "tano-version"
PREFERRED_PROVIDER_jpeg = "libjpeg-turbo"
```

## conf/distro/include/tano-openwrt-repairs.inc
```bitbake
#
# Repairs for "No recipes available for" warnings
#
BBMASK += "gstreamer1.0-plugins-base_1.8.3.bbappend"
BBMASK += "python3-native_3.5.2.bbappend"
BBMASK += "weston_1..0.bbappend"
BBMASK += "linux-ti-staging_4.14.bbappend"
BBMASK += "gnome-settings-daemon_2.32.1.bbappend"
```
