## meta-tanowrt-hsl-atmel/conf/machine/at91-sama5d2-xplained-sd.conf
```bitbake
#@TYPE: Machine
#@Name: Atmel SAMA5D2 Xplained (SD)
#@DESCRIPTION: Machine configuration for Atmel SAMA5D2 Xplained board running on SD card

MACHINEOVERRIDES =. "at91-sama5d2-xplained:"
MACHINEOVERRIDES =. "at91-sama5d2-sd:"

require include/at91-sama5d2-xplained.inc
require include/at91-sama5d2-xplained-sd.inc

#
# Bootloader
#
UBOOT_CONFIG[sdcard] = "sama5d2-xplained_sdcard_defconfig,,u-boot.bin"

#
# SWUpdate
#
SWU_BOARD = "at91-sama5d2-xplained-sd"
SWU_REVISION = "1.0"
```

## meta-tanowrt-hsl-atmel/conf/machine/at91-sama5d3-xplained-nand.conf
```bitbake
#@TYPE: Machine
#@Name: Atmel SAMA5D3 Xplained (NAND)
#@DESCRIPTION: Machine configuration for Atmel SAMA5D3 Xplained board running on internal NAND

MACHINEOVERRIDES =. "at91-sama5d3-xplained:"
MACHINEOVERRIDES =. "at91-sama5d3-nand:"

require include/at91-sama5d3-xplained.inc
require include/at91-sama5d3-xplained-nand.inc

#
# Bootloader
#
UBOOT_CONFIG[sdcard] = "sama5d3-xplained_sdcard_defconfig,,u-boot.bin"
UBOOT_CONFIG[nand]   = "sama5d3-xplained_nand_defconfig,,u-boot.bin"

#
# SWUpdate
#
SWU_BOARD = "at91-sama5d3-xplained-nand"
SWU_REVISION = "1.0"
```

## meta-tanowrt-hsl-atmel/conf/machine/at91-sama5d3-xplained-sd.conf
```bitbake
#@TYPE: Machine
#@Name: Atmel SAMA5D3 Xplained (SD)
#@DESCRIPTION: Machine configuration for Atmel SAMA5D3 Xplained board running on SD card

MACHINEOVERRIDES =. "at91-sama5d3-xplained:"
MACHINEOVERRIDES =. "at91-sama5d3-sd:"

require include/at91-sama5d3-xplained.inc
require include/at91-sama5d3-xplained-sd.inc

#
# Bootloader
#
UBOOT_CONFIG[sdcard] = "sama5d3-xplained_sdcard_defconfig,,u-boot.bin"

#
# SWUpdate
#
SWU_BOARD = "at91-sama5d3-xplained-sd"
SWU_REVISION = "1.0"
```

## meta-tanowrt-hsl-atmel/conf/machine/evb-ksz9477-nand.conf
```bitbake
#@TYPE: Machine
#@Name: Microchip EVB-KSZ9477 (NAND)
#@DESCRIPTION: Machine configuration for Microchip EVB-KSZ9477 board running on internal NAND flash

MACHINEOVERRIDES =. "evb-ksz9477:"
MACHINEOVERRIDES =. "evb-ksz-sama5d3:evb-ksz-sama5d3-nand:"
MACHINEOVERRIDES =. "evb-ksz:evb-ksz-nand:"

require include/evb-ksz9477.inc
require include/evb-ksz-nand.inc

#
# Bootloader
#
UBOOT_CONFIG[sdcard] = "evb-ksz9477_sdcard_defconfig,,u-boot.bin"
UBOOT_CONFIG[nand]   = "evb-ksz9477_nandflash_defconfig,,u-boot.bin"

#
# SWUpdate
#
SWU_BOARD = "evb-ksz9477-nand"
SWU_REVISION = "1.0"
```

## meta-tanowrt-hsl-atmel/conf/machine/evb-ksz9477-sd.conf
```bitbake
#@TYPE: Machine
#@Name: Microchip EVB-KSZ9477 (SD)
#@DESCRIPTION: Machine configuration for Microchip EVB-KSZ9477 board running on SD card

MACHINEOVERRIDES =. "evb-ksz9477:"
MACHINEOVERRIDES =. "evb-ksz-sama5d3:evb-ksz-sama5d3-sd:"
MACHINEOVERRIDES =. "evb-ksz:evb-ksz-sd:"

require include/evb-ksz9477.inc
require include/evb-ksz-sd.inc

#
# Bootloader
#
UBOOT_CONFIG[sdcard] = "evb-ksz9477_sdcard_defconfig,,u-boot.bin"

#
# SWUpdate
#
SWU_BOARD = "evb-ksz9477-sd"
SWU_REVISION = "1.0"
```

## meta-tanowrt-hsl-atmel/conf/machine/evb-ksz9563-nand.conf
```bitbake
#@TYPE: Machine
#@Name: Microchip EVB-KSZ9563 (NAND)
#@DESCRIPTION: Machine configuration for Microchip SAMA5D3 EDS with EVB-KSZ9563 running on internal NAND flash

MACHINEOVERRIDES =. "evb-ksz9563:"
MACHINEOVERRIDES =. "evb-ksz-sama5d3:evb-ksz-sama5d3-nand:"
MACHINEOVERRIDES =. "evb-ksz:evb-ksz-nand:"

require include/evb-ksz9563.inc
require include/evb-ksz-nand.inc

#
# Bootloader
#
UBOOT_CONFIG[sdcard] = "evb-ksz9563_sdcard_defconfig,,u-boot.bin"
UBOOT_CONFIG[nand]   = "evb-ksz9563_nandflash_defconfig,,u-boot.bin"

#
# SWUpdate
#
SWU_BOARD = "evb-ksz9563-nand"
SWU_REVISION = "1.0"
```

## meta-tanowrt-hsl-atmel/conf/machine/evb-ksz9563-sd.conf
```bitbake
#@TYPE: Machine
#@Name: Microchip EVB-KSZ9563 (SD)
#@DESCRIPTION: Machine configuration for Microchip SAMA5D3 EDS with EVB-KSZ9563 running on SD card

MACHINEOVERRIDES =. "evb-ksz9563:"
MACHINEOVERRIDES =. "evb-ksz-sama5d3:evb-ksz-sama5d3-sd:"
MACHINEOVERRIDES =. "evb-ksz:evb-ksz-sd:"

require include/evb-ksz9563.inc
require include/evb-ksz-sd.inc

#
# Bootloader
#
UBOOT_CONFIG[sdcard] = "evb-ksz9563_sdcard_defconfig,,u-boot.bin"

#
# SWUpdate
#
SWU_BOARD = "evb-ksz9563-sd"
SWU_REVISION = "1.0"
```

## meta-tanowrt-hsl-atmel/conf/machine/include/at91-sama5d2-xplained-emmc.inc
```bitbake
#
# SPDX-License-Identifier: MIT
# Copyright (c) 2022 Tano Systems LLC. All rights reserved.
#

require swu-atmel-emmc.inc

# AT91Bootstrap on Serial Flash
SWU_IMAGE_BOOT_DEV = "/dev/mtdblock0"

# U-Boot, kernel, rootfs on eMMC
SWU_IMAGE_DEV = "/dev/mmcblk0"

MACHINE_FEATURES += "swupdate-factory"

#
# Bootloader
#
UBOOT_CONFIG = "sdcard emmc"

AT91BOOTSTRAP_BUILD_CONFIG = "sdcard emmc"
AT91BOOTSTRAP_BUILD_CONFIG[sdcard] = "sd_uboot_defconfig"
AT91BOOTSTRAP_BUILD_CONFIG[emmc]   = "emmc_uboot_defconfig"

#
# Kernel
#
KERNEL_CLASSES += "kernel-tn-mkimage"
KERNEL_MKIMAGE_TYPES = "ext4"

#
# OpenWrt specific
#
OPENWRT_VERSION_PRODUCT:append = " (eMMC)"

#
# Initramfs (used for factory installation image)
#
INITRAMFS_IMAGE = "tanowrt-image-initramfs-swu-factory"
INITRAMFS_IMAGE_NAME = "${INITRAMFS_IMAGE}-${MACHINE}"
INITRAMFS_IMAGE_BUNDLE = "0"

PACKAGECONFIG:append:pn-fstools = " ovl-rootdisk-part "

# Factory image creation
SWU_FACTORY_WKS_FILE ?= "sdimage-at91-swu-factory.wks.in"
SWU_FACTORY_EXTRA_DEPENDS += "\
	at91bootstrap:do_deploy \
	u-boot-startup-script:do_deploy \
	virtual/bootloader:do_deploy \
	virtual/kernel:do_deploy \
"

SWU_FACTORY_BOOT_FILES = "\
	at91bootstrap.bin-sdcard;boot.bin \
	u-boot.bin-sdcard;u-boot.bin \
	fitImage-${INITRAMFS_IMAGE_NAME}-${MACHINE};fitImage \
"

SWU_FACTORY_EXTRA_FILES = "\
	${SWU_FACTORY_BOOT_FILES} \
	u-boot-initial-env-emmc.bin;u-boot-initial-env.bin \
"

# These variables are used in sdimage-at91-swu-factory.wks
WKS_FACTORY_IMAGE_STARTUP_BINARY = "startup-factory.img"
WKS_FACTORY_IMAGE_UBOOT_INITIAL_ENV_BINARY = "u-boot-initial-env-${MACHINE}-sdcard.bin"
```

## meta-tanowrt-hsl-atmel/conf/machine/include/at91-sama5d2-xplained.inc
```bitbake
#
# SPDX-License-Identifier: MIT
# Copyright (c) 2022 Tano Systems LLC. All rights reserved.
#

require sama5d2.inc
require swu-atmel.inc

MACHINE_FEATURES = "\
	apm \
	alsa \
	vfat \
	ext2 \
	ext4 \
	usbhost \
	usbgadget \
	ethernet \
	screen \
	cgroup \
	touchscreen \
	lldp \
	watchdog \
	crypto \
	swupdate \
"

#
# Kernel
#
KERNEL_IMAGETYPE = "fitImage"
KERNEL_CLASSES = "kernel-tn-fitimage"

KERNEL_ENTRYPOINT = "0x22000000"
KERNEL_LOADADDRESS = "0x22000000"

#
# Bootloader
#
UBOOT_MACHINE = ""

UBOOT_ENTRYPOINT = "0x20008000"
UBOOT_LOADADDRESS = "0x20008000"
UBOOT_ENV_SIZE = "0x20000"
UBOOT_ENV_REDUNDANT = "1"

UBOOT_DTB_LOADADDRESS  = "0x23e00000"
UBOOT_DTBO_LOADADDRESS = "0x23f00000"
UBOOT_DTBO_OFFSET      = "0x00010000"
UBOOT_RD_LOADADDRESS   = "0x25000000"
UBOOT_RD_ENTRYPOINT    = "0x25000000"

UBOOT_INITIAL_ENV = "u-boot-initial-env"

AT91BOOTSTRAP_MACHINE = ""

#
# Image
#
ROOTFS_IMAGE_FSTYPE = "squashfs-lzo"
IMAGE_FSTYPES = "${ROOTFS_IMAGE_FSTYPE}"

# used by sysvinit_2
SERIAL_CONSOLES = "115200;ttyS0"

#
# Kernel
#
KERNEL_DEVICETREE = "\
	at91-sama5d2_xplained.dtb \
"

#
# OpenWrt specific
#
OPENWRT_VERSION_PRODUCT = "Atmel SAMA5D2 Xplained"
OPENWRT_VERSION_HWREV = "1.0"
```

## meta-tanowrt-hsl-atmel/conf/machine/include/at91-sama5d3-xplained-sd.inc
```bitbake
#
# SPDX-License-Identifier: MIT
# Copyright (c) 2022 Tano Systems LLC. All rights reserved.
#

require swu-atmel-sd.inc

SWU_IMAGE_DEV = "/dev/mmcblk1"

#
# Bootloader
#
UBOOT_CONFIG = "sdcard"

AT91BOOTSTRAP_BUILD_CONFIG = "sdcard"
AT91BOOTSTRAP_BUILD_CONFIG[sdcard] = "sd_uboot_defconfig"

#
# Kernel
#
KERNEL_CLASSES += "kernel-tn-mkimage"
KERNEL_MKIMAGE_TYPES = "ext4"

#
# Image
#
IMAGE_CLASSES += "wic-sdcard-img"
IMAGE_FSTYPES += "wic"
WKS_FILE = "sdimage-at91-swu-a-b.wks.in"
WIC_CREATE_EXTRA_ARGS = "--no-fstab-update"

IMAGE_BOOT_FILES = "\
	boot.bin-sdcard;boot.bin \
	u-boot.bin-sdcard;u-boot.bin \
"

PACKAGECONFIG_append_pn-fstools = " ovl-rootdisk-part "

TANOWRT_ENABLE_OVERLAY_RESIZE = "1"

WKS_IMAGE_KERNEL_BINARY = "fitImage-${MACHINE}.ext4"
WKS_IMAGE_ROOTFS_BINARY = "${IMAGE_BASENAME}-${MACHINE}.${ROOTFS_IMAGE_FSTYPE}"
WKS_IMAGE_STARTUP_BINARY = "startup-${MACHINE}.img"
WKS_IMAGE_UBOOT_INITIAL_ENV_BINARY = "u-boot-initial-env-${MACHINE}-sdcard.bin"

WKS_PART_SIZE_MIB_KERNEL = "64"
WKS_PART_SIZE_MIB_ROOTFS = "384"

WIC_DO_IMAGE_DEPENDS = "\
	${IMAGE_BASENAME}:do_image_squashfs_lzo \
	at91bootstrap:do_deploy \
	u-boot-startup-script:do_deploy \
	virtual/bootloader:do_deploy \
	virtual/kernel:do_deploy \
"
do_image_wic[depends] += "${WIC_DO_IMAGE_DEPENDS}"

#
# OpenWrt specific
#
OPENWRT_VERSION_PRODUCT_append = " (SD)"
```

## meta-tanowrt-hsl-atmel/conf/machine/include/evb-ksz-nand.inc
```bitbake
#
# SPDX-License-Identifier: MIT
# Copyright (c) 2021 Tano Systems LLC. All rights reserved.
#

require swu-atmel-nand.inc

MACHINE_FEATURES += "swupdate-factory"

#
# Bootloader
#
UBOOT_CONFIG = "sdcard nand"

AT91BOOTSTRAP_BUILD_CONFIG = "sdcard nand"
AT91BOOTSTRAP_BUILD_CONFIG[sdcard] = "sd_uboot_defconfig"
AT91BOOTSTRAP_BUILD_CONFIG[nand]   = "nf_uboot_defconfig"

AT91BOOTSTRAP_PMECC_HEADER = "1"
AT91BOOTSTRAP_PMECC_HEADER_BOARD = "sama5d3"

#
# OpenWrt specific
#
OPENWRT_VERSION_PRODUCT_append = " (NAND)"

#
# Initramfs (used for factory installation image)
#
INITRAMFS_IMAGE = "tanowrt-image-initramfs-swu-factory"
INITRAMFS_IMAGE_NAME = "${INITRAMFS_IMAGE}-${MACHINE}"
INITRAMFS_IMAGE_BUNDLE = "0"

# Factory image creation
SWU_FACTORY_WKS_FILE ?= "sdimage-at91-swu-factory.wks.in"
SWU_FACTORY_EXTRA_DEPENDS += "\
	at91bootstrap:do_deploy \
	u-boot-startup-script:do_deploy \
	virtual/bootloader:do_deploy \
	virtual/kernel:do_deploy \
"

SWU_FACTORY_BOOT_FILES = "\
	at91bootstrap.bin-sdcard;boot.bin \
	u-boot.bin-sdcard;u-boot.bin \
	fitImage-${INITRAMFS_IMAGE_NAME}-${MACHINE};fitImage \
"

SWU_FACTORY_EXTRA_FILES = "\
	${SWU_FACTORY_BOOT_FILES} \
	u-boot-initial-env-nand.bin;u-boot-initial-env.bin \
"

# These variables are used in sdimage-at91-swu-factory.wks
WKS_FACTORY_IMAGE_STARTUP_BINARY = "startup-factory.img"
WKS_FACTORY_IMAGE_UBOOT_INITIAL_ENV_BINARY = "u-boot-initial-env-${MACHINE}-sdcard.bin"
```

## meta-tanowrt-hsl-atmel/conf/machine/include/evb-ksz-sama5d3.inc
```bitbake
#
# SPDX-License-Identifier: MIT
# Copyright (c) 2021 Tano Systems LLC. All rights reserved.
#

require sama5d3.inc
require evb-ksz.inc
```

## meta-tanowrt-hsl-atmel/conf/machine/include/evb-ksz.inc
```bitbake
#
# SPDX-License-Identifier: MIT
# Copyright (c) 2021 Tano Systems LLC. All rights reserved.
#

require swu-atmel.inc

MACHINE_FEATURES = "\
	apm \
	alsa \
	vfat \
	ext2 \
	ext4 \
	usbhost \
	usbgadget \
	ethernet \
	screen \
	cgroup \
	touchscreen \
	lldp \
	stp \
	watchdog \
	crypto \
	swupdate \
"

#
# Kernel
#
KERNEL_IMAGETYPE = "fitImage"
KERNEL_CLASSES = "kernel-tn-fitimage"

KERNEL_ENTRYPOINT = "0x22000000"
KERNEL_LOADADDRESS = "0x22000000"

#
# Bootloader
#
UBOOT_MACHINE = ""

UBOOT_ENTRYPOINT = "0x20008000"
UBOOT_LOADADDRESS = "0x20008000"
UBOOT_ENV_SIZE = "0x20000"
UBOOT_ENV_REDUNDANT = "1"

UBOOT_DTB_LOADADDRESS  = "0x23e00000"
UBOOT_DTBO_LOADADDRESS = "0x23f00000"
UBOOT_DTBO_OFFSET      = "0x00010000"
UBOOT_RD_LOADADDRESS   = "0x25000000"
UBOOT_RD_ENTRYPOINT    = "0x25000000"

UBOOT_INITIAL_ENV = "u-boot-initial-env"

AT91BOOTSTRAP_MACHINE = ""

#
# Image
#
ROOTFS_IMAGE_FSTYPE = "squashfs-lzo"
IMAGE_FSTYPES = "${ROOTFS_IMAGE_FSTYPE}"

# used by sysvinit_2
SERIAL_CONSOLES = "115200;ttyS0"

MACHINE_ESSENTIAL_EXTRA_RRECOMMENDS = " ksz-regs-bin "
```

## meta-tanowrt-hsl-atmel/conf/machine/include/evb-ksz9477.inc
```bitbake
#
# SPDX-License-Identifier: MIT
# Copyright (c) 2021 Tano Systems LLC. All rights reserved.
#

require evb-ksz-sama5d3.inc

#
# Kernel
#
KERNEL_DEVICETREE = "\
	at91-evb-ksz9477.dtb \
	at91-evb-ksz9477-sfp.dtb \
"

#
# OpenWrt specific
#
OPENWRT_VERSION_PRODUCT = "Microchip EVB-KSZ9477"
OPENWRT_VERSION_HWREV = "1.0"
```

## meta-tanowrt-hsl-atmel/conf/machine/include/evb-ksz9563.inc
```bitbake
#
# SPDX-License-Identifier: MIT
# Copyright (c) 2021 Tano Systems LLC. All rights reserved.
#

require evb-ksz-sama5d3.inc

#
# Kernel
#
KERNEL_DEVICETREE = "\
	at91-evb-ksz9563.dtb \
"

#
# OpenWrt specific
#
OPENWRT_VERSION_PRODUCT = "Microchip SAMA5D3 EDS with EVB-KSZ9563"
OPENWRT_VERSION_HWREV = "1.0"
```

## meta-tanowrt-hsl-atmel/conf/machine/include/sama5.inc
```bitbake
# Atmel SAMA5 defaults
require conf/machine/include/soc-family.inc
require conf/machine/include/arm/armv7a/tune-cortexa5.inc

# Add bootloaders to the images of every machine
EXTRA_IMAGEDEPENDS += "at91bootstrap virtual/bootloader"

SOC_FAMILY = "sama5"

PREFERRED_PROVIDER_virtual/kernel:sama5 = "linux-tano-at91"
PREFERRED_PROVIDER_virtual/bootloader:sama5 ?= "u-boot-tano-at91"
PREFERRED_PROVIDER_u-boot:sama5 ?= "u-boot-tano-at91"

PREFERRED_VERSION_linux-tano-at91 = "4.19%"

PREFERRED_PROVIDER_jpeg ?= "jpeg"
PREFERRED_PROVIDER_jpeg-native ?= "jpeg-native"

SERIAL_CONSOLES ?= "115200;ttyS0"
WIC_CREATE_EXTRA_ARGS ?= "--no-fstab-update"
```

## meta-tanowrt-hsl-atmel/conf/machine/include/swu-atmel-emmc.inc
```bitbake
#
# SPDX-License-Identifier: MIT
# Copyright (c) 2022 Tano Systems LLC. All rights reserved.
#

#
# SWUpdate
#
SWU_OVERLAY_CONTAINER = "blkdev"
SWU_OVERLAY_FS = "ext4"

SWU_IMAGE_DEV = "/dev/mmcblk1"
SWU_IMAGE_BOOT_DEV = "/dev/mtdblock0"
SWU_IMAGE_MEDIA_TYPE = "eMMC"

SWU_IMAGE_ARTIFACT_at91bootstrap[ftype] = "bin-emmc"
SWU_IMAGE_ARTIFACT_at91bootstrap[sw-desc-type] = "raw"
SWU_IMAGE_ARTIFACT_at91bootstrap[sw-desc-path] = ""
SWU_IMAGE_ARTIFACT_at91bootstrap[sw-desc-device] = "${SWU_IMAGE_BOOT_DEV}"
SWU_IMAGE_ARTIFACT_at91bootstrap[sw-desc-offset] = "0"

SWU_IMAGE_ARTIFACT_uboot[ftype] = "bin-emmc"
SWU_IMAGE_ARTIFACT_uboot[sw-desc-type] = "rawfile"
SWU_IMAGE_ARTIFACT_uboot[sw-desc-path] = "/boot/u-boot.bin"
SWU_IMAGE_ARTIFACT_uboot[sw-desc-device] = "/dev/null"
SWU_IMAGE_ARTIFACT_uboot[sw-desc-offset] = "0"

SWU_IMAGE_ARTIFACT_startup[sw-desc-type] = "raw"
SWU_IMAGE_ARTIFACT_startup[sw-desc-device] = "${SWU_IMAGE_DEV}"
SWU_IMAGE_ARTIFACT_startup[sw-desc-offset] = "262144"

SWU_IMAGE_ARTIFACT_kernel[ftype] = "ext4"
SWU_IMAGE_ARTIFACT_kernel[sw-desc-device-a] = "${SWU_IMAGE_DEV}p2"
SWU_IMAGE_ARTIFACT_kernel[sw-desc-device-b] = "${SWU_IMAGE_DEV}p5"
SWU_IMAGE_ARTIFACT_kernel[sw-desc-type] = "raw"

SWU_IMAGE_ARTIFACT_rootfs[sw-desc-device-a] = "${SWU_IMAGE_DEV}p3"
SWU_IMAGE_ARTIFACT_rootfs[sw-desc-device-b] = "${SWU_IMAGE_DEV}p6"

SWU_INSTALL_EXTRA_RDEPENDS += "gptfdisk parted mmc-utils"
```
