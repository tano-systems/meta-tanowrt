## meta-tanowrt-hsl-atmel/conf/machine/include/swu-atmel-nand.inc
```bitbake
#
# SPDX-License-Identifier: MIT
# Copyright (c) 2021 Tano Systems LLC. All rights reserved.
#

#
# SWUpdate
#
SWU_OVERLAY_CONTAINER = "ubivol"
SWU_OVERLAY_FS = "ubifs"

SWU_UBI_MTD_BLACKLIST = "0 1 2 3 6"

# Extra dependencies for factory installation script
SWU_INSTALL_EXTRA_RDEPENDS = "\
	mtd-utils \
	mtd-utils-ubifs \
"

SWU_IMAGE_MEDIA_TYPE = "NAND"

SWU_IMAGE_ARTIFACT_at91bootstrap[ftype] = "bin-nand-pmecc"
SWU_IMAGE_ARTIFACT_at91bootstrap[sw-desc-type] = "raw"
SWU_IMAGE_ARTIFACT_at91bootstrap[sw-desc-path] = "/"
SWU_IMAGE_ARTIFACT_at91bootstrap[sw-desc-device] = "/dev/mtdblock0"
SWU_IMAGE_ARTIFACT_at91bootstrap[sw-desc-offset] = "0"

SWU_IMAGE_ARTIFACT_uboot[ftype] = "bin-nand"
SWU_IMAGE_ARTIFACT_uboot[sw-desc-type] = "raw"
SWU_IMAGE_ARTIFACT_uboot[sw-desc-path] = "/"
SWU_IMAGE_ARTIFACT_uboot[sw-desc-device] = "/dev/mtdblock1"
SWU_IMAGE_ARTIFACT_uboot[sw-desc-offset] = "0"

SWU_IMAGE_ARTIFACT_startup[sw-desc-type] = "raw"
SWU_IMAGE_ARTIFACT_startup[sw-desc-device] = "/dev/mtdblock2"
SWU_IMAGE_ARTIFACT_startup[sw-desc-offset] = "0"

SWU_IMAGE_ARTIFACT_kernel[ftype] = "bin"
SWU_IMAGE_ARTIFACT_kernel[sw-desc-type] = "ubivol"
SWU_IMAGE_ARTIFACT_kernel[sw-desc-device-a] = "mtd4"
SWU_IMAGE_ARTIFACT_kernel[sw-desc-device-b] = "mtd5"
SWU_IMAGE_ARTIFACT_kernel[sw-desc-extra] = "\
	volume = "kernel"; \
	data = "dynamic"; \
	properties: { \
		volume-id = "0"; \
		always-remove = "true"; \
		auto-resize = "true"; \
	} \
"

SWU_IMAGE_ARTIFACT_rootfs[sw-desc-type] = "ubivol"
SWU_IMAGE_ARTIFACT_rootfs[sw-desc-device-a] = "mtd4"
SWU_IMAGE_ARTIFACT_rootfs[sw-desc-device-b] = "mtd5"
SWU_IMAGE_ARTIFACT_rootfs[sw-desc-extra] = "\
	volume = "rootfs"; \
	data = "dynamic"; \
	properties: { \
		volume-id = "1"; \
		always-remove = "true"; \
		auto-resize = "true"; \
	} \
"
```

## meta-tanowrt-hsl-atmel/conf/machine/include/swu-atmel-sd.inc
```bitbake
#
# SPDX-License-Identifier: MIT
# Copyright (c) 2021 Tano Systems LLC. All rights reserved.
#

#
# SWUpdate
#
SWU_OVERLAY_CONTAINER = "blkdev"
SWU_OVERLAY_FS = "ext4"

SWU_IMAGE_DEV = "/dev/mmcblk0"
SWU_IMAGE_MEDIA_TYPE = "SD Card"

SWU_IMAGE_ARTIFACT_at91bootstrap[ftype] = "bin-sdcard"
SWU_IMAGE_ARTIFACT_at91bootstrap[sw-desc-type] = "rawfile"
SWU_IMAGE_ARTIFACT_at91bootstrap[sw-desc-path] = "/boot/boot.bin"
SWU_IMAGE_ARTIFACT_at91bootstrap[sw-desc-device] = "/dev/null"
SWU_IMAGE_ARTIFACT_at91bootstrap[sw-desc-offset] = "0"

SWU_IMAGE_ARTIFACT_uboot[ftype] = "bin-sdcard"
SWU_IMAGE_ARTIFACT_uboot[sw-desc-type] = "rawfile"
SWU_IMAGE_ARTIFACT_uboot[sw-desc-path] = "/boot/u-boot.bin"
SWU_IMAGE_ARTIFACT_uboot[sw-desc-device] = "/dev/null"
SWU_IMAGE_ARTIFACT_uboot[sw-desc-offset] = "0"

SWU_IMAGE_ARTIFACT_startup[sw-desc-type] = "rawfile"
SWU_IMAGE_ARTIFACT_startup[sw-desc-device] = "${SWU_IMAGE_DEV}"
SWU_IMAGE_ARTIFACT_startup[sw-desc-offset] = "262144"

SWU_IMAGE_ARTIFACT_kernel[ftype] = "ext4"
SWU_IMAGE_ARTIFACT_kernel[sw-desc-device-a] = "${SWU_IMAGE_DEV}p2"
SWU_IMAGE_ARTIFACT_kernel[sw-desc-device-b] = "${SWU_IMAGE_DEV}p5"
SWU_IMAGE_ARTIFACT_kernel[sw-desc-type] = "raw"

SWU_IMAGE_ARTIFACT_rootfs[sw-desc-device-a] = "${SWU_IMAGE_DEV}p3"
SWU_IMAGE_ARTIFACT_rootfs[sw-desc-device-b] = "${SWU_IMAGE_DEV}p6"
```

## meta-tanowrt-hsl-atmel/conf/machine/include/swu-atmel.inc
```bitbake
#
# SPDX-License-Identifier: MIT
# Copyright (c) 2021 Tano Systems LLC. All rights reserved.
#

#
# SWUpdate
#
SWU_BOOTLOADER = "uboot"

SWU_IMAGE_EXTRA_ARTIFACTS += "at91bootstrap uboot startup kernel"

SWU_IMAGE_ARTIFACT_at91bootstrap[fname] = "at91bootstrap"
SWU_IMAGE_ARTIFACT_at91bootstrap[depends] = "at91bootstrap:do_deploy"
SWU_IMAGE_ARTIFACT_at91bootstrap[verextract] = "1"
SWU_IMAGE_ARTIFACT_at91bootstrap[verextract-cmd] = "strings"
SWU_IMAGE_ARTIFACT_at91bootstrap[verextract-filter-cmd] = "grep 'AT91Bootstrap' | awk '{ print $2 }'"

SWU_IMAGE_ARTIFACT_uboot[fname] = "u-boot-${MACHINE}"
SWU_IMAGE_ARTIFACT_uboot[depends] = "virtual/bootloader:do_deploy"
SWU_IMAGE_ARTIFACT_uboot[verextract] = "1"
SWU_IMAGE_ARTIFACT_uboot[verextract-cmd] = "strings"
SWU_IMAGE_ARTIFACT_uboot[verextract-filter-cmd] = "grep -m 2 'U-Boot 20' | tail -n1 | awk '{print $2}'"

SWU_IMAGE_ARTIFACT_startup[fname] = "startup"
SWU_IMAGE_ARTIFACT_startup[ftype] = "img"
SWU_IMAGE_ARTIFACT_startup[depends] = "u-boot-startup-script:do_deploy"
SWU_IMAGE_ARTIFACT_startup[verextract] = "1"
SWU_IMAGE_ARTIFACT_startup[verextract-input] = "${DEPLOY_DIR_IMAGE}/startup-${MACHINE}.img.version"

SWU_IMAGE_ARTIFACT_kernel[fname] = "fitImage"
SWU_IMAGE_ARTIFACT_kernel[depends] = "virtual/kernel:do_deploy"
SWU_IMAGE_ARTIFACT_kernel[verextract] = "1"
SWU_IMAGE_ARTIFACT_kernel[verextract-cmd] = "strings"
SWU_IMAGE_ARTIFACT_kernel[verextract-filter-cmd] = "grep -e 'U-Boot fitImage for TanoWrt/.*/${MACHINE}' | awk -F '/' '{ print $2 }'"

SWU_IMAGE_ARTIFACT_rootfs[sw-desc-type] = "raw"
```

## meta-tanowrt-hsl-atmel/recipes-bsp/at91bootstrap/at91bootstrap/at91-sama5d3-xplained/nf_uboot_defconfig
```kconfig
CONFIG_SAMA5D3X=y
CONFIG_CPU_CLK_528MHZ=y
CONFIG_RAM_256MB=y
# CONFIG_PMECC_AUTO_DETECT is not set
CONFIG_PMECC_CORRECT_BITS_4=y
CONFIG_IMG_SIZE="0x000c0000"
CONFIG_DEBUG=y
```

## meta-tanowrt-hsl-atmel/recipes-bsp/at91bootstrap/at91bootstrap/evb-ksz-sama5d3/nf_uboot_defconfig
```kconfig
CONFIG_SAMA5D3_XPLAINED=y
CONFIG_CPU_CLK_528MHZ=y
CONFIG_RAM_256MB=y
CONFIG_NANDFLASH=y
# CONFIG_PMECC_AUTO_DETECT is not set
CONFIG_PMECC_CORRECT_BITS_4=y
CONFIG_IMG_SIZE="0x000c0000"
CONFIG_DEBUG=y
CONFIG_SCLK=y
CONFIG_PM_EXTERNAL_DEVICES=y
CONFIG_MAC0_PHY=y
CONFIG_MAC1_PHY=y
CONFIG_ACT8865=y
CONFIG_PMIC_ON_TWI1=y
CONFIG_DISABLE_WATCHDOG=n
```

## meta-tanowrt-hsl-atmel/recipes-bsp/u-boot/u-boot-tano-at91/evb-ksz9563/evb-ksz9563_nandflash_defconfig
```kconfig
CONFIG_ARM=y
CONFIG_ARCH_CPU_INIT=y
CONFIG_ARCH_AT91=y
CONFIG_SYS_TEXT_BASE=0x26f00000
CONFIG_TARGET_SAMA5D3_XPLAINED=y
CONFIG_SPL_GPIO_SUPPORT=y
CONFIG_SPL_LIBCOMMON_SUPPORT=y
CONFIG_SPL_LIBGENERIC_SUPPORT=y
CONFIG_SYS_MALLOC_F_LEN=0x2000
CONFIG_SPL_SERIAL_SUPPORT=y
CONFIG_SPL_DRIVERS_MISC_SUPPORT=y
CONFIG_NR_DRAM_BANKS=1
CONFIG_SPL=y
CONFIG_DEBUG_UART_BOARD_INIT=y
CONFIG_DEBUG_UART_BASE=0xffffee00
CONFIG_DEBUG_UART_CLOCK=132000000
CONFIG_DEBUG_UART=y
CONFIG_SPL_TEXT_BASE=0x300000
CONFIG_ENV_VARS_UBOOT_CONFIG=y
CONFIG_FIT=y
CONFIG_NAND_BOOT=y
CONFIG_BOOTDELAY=3
# CONFIG_USE_BOOTARGS is not set
# CONFIG_DISPLAY_BOARDINFO is not set
CONFIG_USE_BOOTCOMMAND=y
CONFIG_BOOTCOMMAND="nand read 0x21000000 0x180000 0x40000; source 0x21000000"
CONFIG_SPL_SEPARATE_BSS=y
CONFIG_SPL_NAND_SUPPORT=y
CONFIG_HUSH_PARSER=y
# CONFIG_CMD_BOOTZ is not set
# CONFIG_CMD_FLASH is not set
# CONFIG_CMD_LOADS is not set
CONFIG_CMD_MMC=y
CONFIG_CMD_NAND=y
CONFIG_CMD_NAND_TRIMFFS=y
CONFIG_CMD_USB=y
CONFIG_CMD_DHCP=y
CONFIG_CMD_MII=y
CONFIG_CMD_PING=y
CONFIG_CMD_EXT4=y
CONFIG_CMD_EXT4_WRITE=y
CONFIG_CMD_FAT=y
CONFIG_CMD_MTDPARTS=y
CONFIG_MTDIDS_DEFAULT="nand0=atmel_nand"
CONFIG_MTDPARTS_DEFAULT="mtdparts=atmel_nand:0x00040000(at91bootstrap),0x00140000(uboot),0x0040000(startup),0x0040000(ubootenv),0x06800000(system_a),0x06800000(system_b),0x02e00000(rootfs_data)"
CONFIG_CMD_UBI=y
CONFIG_CMD_SOURCE=y
CONFIG_CMD_SETEXPR=y
CONFIG_OF_CONTROL=y
CONFIG_SPL_OF_CONTROL=y
CONFIG_DEFAULT_DEVICE_TREE="at91-sama5d3_xplained"
CONFIG_OF_SPL_REMOVE_PROPS="interrupts interrupt-parent dmas dma-names"
CONFIG_ENV_IS_IN_NAND=y
CONFIG_ENV_SIZE=0x20000
CONFIG_ENV_OFFSET=0x1c0000
CONFIG_ENV_OFFSET_REDUND=0x1e0000
CONFIG_SYS_REDUNDAND_ENVIRONMENT=y
CONFIG_SYS_RELOC_GD_ENV_ADDR=y
CONFIG_SYS_EXTRA_OPTIONS="ENV_OVERWRITE"
CONFIG_DM=y
CONFIG_SPL_DM=y
CONFIG_SPL_DM_SEQ_ALIAS=y
CONFIG_CLK=y
CONFIG_SPL_CLK=y
CONFIG_CLK_AT91=y
CONFIG_AT91_UTMI=y
CONFIG_AT91_H32MX=y
CONFIG_DM_GPIO=y
CONFIG_AT91_GPIO=y
CONFIG_DM_MMC=y
CONFIG_GENERIC_ATMEL_MCI=y
CONFIG_MTD=y
CONFIG_NAND_ATMEL=y
CONFIG_PMECC_CAP=4
CONFIG_SPL_GENERATE_ATMEL_PMECC_HEADER=y
CONFIG_DM_ETH=y
CONFIG_MACB=y
CONFIG_PINCTRL=y
CONFIG_SPL_PINCTRL=y
CONFIG_PINCTRL_AT91=y
CONFIG_DM_SERIAL=y
CONFIG_DEBUG_UART_ATMEL=y
CONFIG_DEBUG_UART_ANNOUNCE=y
CONFIG_ATMEL_USART=y
CONFIG_TIMER=y
CONFIG_SPL_TIMER=y
CONFIG_ATMEL_PIT_TIMER=y
CONFIG_USB=y
CONFIG_DM_USB=y
CONFIG_USB_EHCI_HCD=y
CONFIG_USB_STORAGE=y
CONFIG_W1=y
CONFIG_W1_GPIO=y
CONFIG_W1_EEPROM=y
CONFIG_W1_EEPROM_DS24XXX=y
CONFIG_FAT_WRITE=y
CONFIG_OF_LIBFDT_OVERLAY=y
CONFIG_WATCHDOG=y
CONFIG_WATCHDOG_TIMEOUT_MSECS=15000
CONFIG_WDT=y
CONFIG_WDT_AT91=y
```

## meta-tanowrt-hsl-baikal/conf/layer.conf
```bitbake
#
# SPDX-License-Identifier: MIT
# Copyright (c) 2021 Tano Systems LLC. All rights reserved.
#

# Layer version
LAYERVERSION = "1"

# We have a conf and classes directory, append to BBPATH
BBPATH .= ":${LAYERDIR}"

# We have a recipes directory, add to BBFILES
BBFILES += "${LAYERDIR}/recipes*/*/*.bb \
            ${LAYERDIR}/recipes*/*/*.bbappend"

BBFILE_COLLECTIONS += "meta-tanowrt-hsl-baikal"
BBFILE_PATTERN_meta-tanowrt-hsl-baikal := "^${LAYERDIR}/"
BBFILE_PRIORITY_meta-tanowrt-hsl-baikal = "17"

LICENSE_PATH += "${LAYERDIR}/licenses"

LAYERDEPENDS_meta-tanowrt-hsl-baikal = "\
	meta-tanowrt \
"

LAYERSERIES_COMPAT_meta-tanowrt-hsl-baikal = "hardknott"

# Set a variable to get the top of the metadata location
TANOWRT_HSL_BASE = '${@os.path.normpath("${LAYERDIR}/")}'
```

## meta-tanowrt-hsl-baikal/conf/machine/include/baikal-be-m1000.inc
```bitbake
#
# SPDX-License-Identifier: MIT
# Copyright (c) 2021 Tano Systems LLC. All rights reserved.
#

require conf/machine/include/baikal-m.inc

MACHINEOVERRIDES =. "baikal-be-m1000:"

#
# Image generation
#

#
# Kernel
#
PREFERRED_PROVIDER_virtual/kernel = "linux-tano-baikal"
PREFERRED_VERSION_linux-tano-baikal = "5.4%"
LINUXLIBCVERSION = "5.4%"
SDKLINUXLIBCVERSION = "5.4%"

KERNEL_IMAGETYPE = "Image"

KERNEL_CLASSES = "kernel-tn-mkimage"
KERNEL_MKIMAGE_TYPES = "ext4"
KERNEL_MKIMAGE_INCLUDE_DEVICETREE = "1"

KERNEL_DEFCONFIG ?= "defconfig"

#
# Other
#

# Enable irqbalance
IRQBALANCE_CONFIG_ENABLED = "1"
MACHINE_EXTRA_RDEPENDS_append = " irqbalance "

# RTC hwclock parameters
OPENWRT_HWCLOCK_DEV       = "/dev/rtc0"
OPENWRT_HWCLOCK_LOCALTIME = "1"
```
